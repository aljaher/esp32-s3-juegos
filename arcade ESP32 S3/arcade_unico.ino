/*
  ARCADE para ESP32-S3 Super Mini + pantalla redonda GC9A01A (240x240)
  Juegos: PAC-MAN, TETRIS, INVADERS y DINO RUN, con menu de caratulas.
  ---------------------------------------------------------------------
  Librerias (Gestor de librerias): Adafruit GFX Library, Adafruit GC9A01A
  Placa: ESP32S3 Dev Module (USB CDC On Boot: Enabled si quieres Serial)

  CABLEADO
    Pantalla : SCK=12  MOSI(SDA)=11  CS=10  DC=8  RST=9  VCC=3V3  GND  BLK=3V3
    Botones  : UP=1  DOWN=2  LEFT=3  RIGHT=4  OK=5   (un lado del boton al pin, otro a GND)
    Buzzer   : pasivo en el pin 6 (otro lado a GND)
    RC522    : SCK=12 y MOSI=11 (los de la pantalla)  MISO=13  SDA/SS=7  RST=43  3.3V  GND   (>>> NUEVO)

  CONTROLES
    Arcade   : IZQUIERDA / DERECHA cambian de caratula, OK entra al juego
    Menu del juego (todos igual): ARRIBA/ABAJO mover, OK o DERECHA elegir, IZQUIERDA vuelve al arcade
    Opciones : ARRIBA/ABAJO elegir fila, IZQ/DER cambiar valor, OK en VOLVER sale
               (SONIDO, SKIN y DIF valen para todos los juegos)
    Juego    : 4 direcciones para mover, OK = pausa (en pausa: OK sigue, IZQ sale al menu del juego)
    AGREGAR  : ultima caratula. Acerca una etiqueta NFC (WiFi o juego). ARRIBA = borrar juegos, IZQ = salir
*/
#include <Arduino.h>
#include <SPI.h>
#include <Preferences.h>
#include <Adafruit_GFX.h>
#include <Adafruit_GC9A01A.h>
// >>> NUEVO: RFID/NFC + WiFi
#include <WiFi.h>
#include <WiFiClientSecure.h>
#include <HTTPClient.h>
#include <LittleFS.h>
#include <time.h>

// ===== inicio de tipos.h =====
// Tipos compartidos (van en un .h para que el IDE de Arduino los conozca antes de generar prototipos)

#include <stdint.h>

struct Note { uint16_t f, ms; };   // nota: frecuencia (Hz, 0 = silencio) y duracion (ms)

// ===== fin de tipos.h =====


// ============================== PINES ==============================
#define TFT_SCK   12
#define TFT_MOSI  11
#define TFT_CS    10
#define TFT_DC     8
#define TFT_RST    9
#define PIN_UP     1
#define PIN_DOWN   2
#define PIN_LEFT   3
#define PIN_RIGHT  4
#define PIN_OK     5
#define PIN_BUZZ   6
// >>> NUEVO: lector RC522 (comparte SCK y MOSI con la pantalla)
#define RC_SS      7
#define RC_MISO   13
#define RC_RST    43

// ============================== COLORES / SKINS ==============================
#define C565(r,g,b) ((uint16_t)((((r)&0xF8)<<8)|(((g)&0xFC)<<3)|(((b)&0xFF)>>3)))
const uint16_t C_BLACK = 0x0000;
const uint16_t C_WHITE = 0xFFFF;
const uint16_t C_RED   = C565(255, 0, 0);
const uint16_t C_EYE   = C565(20, 20, 255);

struct Skin {
  const char* name;
  uint16_t wallLine, wallFill, pac, dot, door, text, fright, frightFlash;
  uint16_t ghost[4];
};

const Skin SKINS[] = {
  {"CLASSIC", C565(33,33,255), C565(0,0,50),  C565(255,255,0),  C565(255,184,174), C565(255,184,222), C565(255,255,0),
   C565(33,33,255), C565(255,255,255), {C565(255,0,0), C565(255,184,255), C565(0,255,255), C565(255,184,82)}},
  {"NEON",    C565(255,0,200), C565(35,0,45), C565(0,255,120),  C565(0,255,255),   C565(255,255,0),   C565(0,255,255),
   C565(120,0,255), C565(255,255,255), {C565(255,60,60), C565(255,160,0), C565(180,80,255), C565(60,160,255)}},
  {"RETRO",   C565(0,255,0),   C565(0,35,0),  C565(210,255,210),C565(0,190,0),     C565(0,255,0),     C565(0,255,0),
   C565(0,90,0), C565(210,255,210), {C565(0,255,120), C565(140,255,0), C565(0,200,80), C565(80,255,170)}},
  {"FUEGO",   C565(255,120,0), C565(45,10,0), C565(255,230,80), C565(255,200,150), C565(255,80,80),   C565(255,160,0),
   C565(90,0,160), C565(255,255,255), {C565(255,40,40), C565(255,0,130), C565(170,0,255), C565(255,170,0)}},
  {"ARDUINO", C565(0,151,157), C565(0,28,30), C565(255,255,255),C565(0,200,205),   C565(255,140,0),   C565(0,200,205),
   C565(60,60,200), C565(255,255,255), {C565(0,151,157), C565(255,255,255), C565(255,140,0), C565(120,220,225)}},
};
const uint8_t NUM_SKINS = sizeof(SKINS) / sizeof(SKINS[0]);
const char* const DIFF_NAMES[3] = {"FACIL", "NORMAL", "DIFICIL"};
#define SK SKINS[skinIdx]

// ============================== GLOBALES ==============================
Adafruit_GC9A01A tft(TFT_CS, TFT_DC, TFT_RST);
Preferences prefs;

#ifndef VEX_HALO_MS
#define VEX_HALO_MS 4000      // tiempo extra con el halo RGB girando antes del menu (OK lo salta)
#endif

// ===== inicio de vex_intro.h =====
// =====================================================================
//  Animación de arranque VEX (tu vex_intro.ino, sin setup/loop/pines)
//  Se incluye desde pacman_esp32s3.ino DESPUÉS de crear el objeto `tft`.
// =====================================================================

#include <pgmspace.h>
#include <math.h>

#ifndef VEX_PANTALLA_MS
#define VEX_PANTALLA_MS 8000   // cuánto dura la pantalla "VEX + powered by ARDUINO" (antes: delay(8000))
#endif

const uint16_t TEAL = 0x04B3;  // color Arduino

// ---------- Imágenes (RGB565, generadas de tus PNG/JPG) ----------
const int ROBOT_W = 64;
const int ROBOT_H = 72;
const uint16_t ROBOT[] PROGMEM = {
  0x0000, 0x0000, 0x0000, 0x0000, 0x0000, 0x0000, 0x0000, 0x0000, 0x0000, 0x0000, 0x0000, 0x0000,
  0x0000, 0x0000, 0x0000, 0x0000, 0x0000, 0x0041, 0x00C3, 0x00E4, 0x0083, 0x0000, 0x0000, 0x0000,
  0x0000, 0x0000, 0x0000, 0x0000, 0x0000, 0x0000, 0x0000, 0x0000, 0x0000, 0x0000, 0x0000, 0x0000,
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  0x0000, 0x0000, 0x0000, 0x0000, 0x0000, 0x0000, 0x0000, 0x0000, 0x0000, 0x0000, 0x0000, 0x0000
};

const int LOGO_W = 40;
const int LOGO_H = 22;
const uint16_t LOGO[] PROGMEM = {
  0x0000, 0x0000, 0x0000, 0x0000, 0x0000, 0x0000, 0x00C3, 0x230C, 0x6DD7, 0x6596, 0x6596, 0x6DD7,
  0x230C, 0x00C3, 0x0000, 0x0000, 0x0000, 0x0000, 0x0000, 0x0000, 0x0000, 0x0000, 0x0000, 0x0000,
  0x0000, 0x0000, 0x00C3, 0x230C, 0x6DD7, 0x6596, 0x6596, 0x6DD7, 0x230C, 0x00C3, 0x0000, 0x0000,
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  0x0000, 0x0000, 0x0000, 0x0000
};

// ---------- Logo VEX (RGB565, 0x0000 = transparente) ----------
// Logo VEX (RGB565, 168x89). 0x0000 = transparente (el negro real se guarda como 0x0001)
const int VEXIMG_W = 168;
const int VEXIMG_H = 89;
const uint16_t VEXIMG[] PROGMEM = {
  0x0000, 0x0000, 0x0000, 0x0000, 0x0000, 0x0000, 0x0000, 0x0000, 0x0000, 0x0000, 0x0000, 0x0000,
  0x0000, 0x0000, 0x0000, 0x0000, 0x0000, 0x0000, 0x0000, 0x0000, 0x0000, 0x0000, 0x0000, 0x0000,
  0x0000, 0x0000, 0x0000, 0x0000, 0x0000, 0x0000, 0x0000, 0x0000, 0x0000, 0x0000, 0x0000, 0x0000,
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  0x0000, 0x0000, 0x0000, 0x0000, 0x0000, 0x0000, 0x0000, 0x0000, 0x0000, 0x0000, 0x0000, 0x0000
};


// ---------- Utilidades de color ----------
static inline uint16_t rgb565(uint8_t r, uint8_t g, uint8_t b) {
  return ((r & 0xF8) << 8) | ((g & 0xFC) << 3) | (b >> 3);
}

// Escala el brillo de un color RGB565 (b = 0..255)
static inline uint16_t escalar565(uint16_t c, int b) {
  int r = (c >> 11) & 31, g = (c >> 5) & 63, bl = c & 31;
  r = (r * (b + 1)) >> 8;
  g = (g * (b + 1)) >> 8;
  bl = (bl * (b + 1)) >> 8;
  return (r << 11) | (g << 5) | bl;
}

// ---------- Logo VEX (imagen) ----------
// Dibuja el logo (sin fondo) con un brillo 0..255, solo los píxeles opacos.
// Sirve para el fundido de la pantalla de arranque.
void dibujarLogoVEX(int x0, int y0, int brillo) {
  static uint16_t fila[VEXIMG_W];
  tft.startWrite();
  for (int y = 0; y < VEXIMG_H; y++) {
    int py = y0 + y;
    if (py < 0 || py >= 240) continue;
    int x = 0;
    while (x < VEXIMG_W) {
      if (!pgm_read_word(&VEXIMG[y * VEXIMG_W + x])) { x++; continue; }
      int ini = x, n = 0;
      while (x < VEXIMG_W) {
        uint16_t c = pgm_read_word(&VEXIMG[y * VEXIMG_W + x]);
        if (!c) break;
        fila[n++] = escalar565(c, brillo);
        x++;
      }
      tft.setAddrWindow(x0 + ini, py, n, 1);
      tft.writePixels(fila, n);
    }
  }
  tft.endWrite();
}

void aparecerVEX(int x0, int y0) {
  for (int b = 0; b < 255; b += 15) {
    dibujarLogoVEX(x0, y0, b);
    delay(10);
  }
  dibujarLogoVEX(x0, y0, 255);
}

// ---------- Robot sin fondo (máscara) ----------
static uint8_t FONDO[ROBOT_W * ROBOT_H];   // 1 = transparente

bool esOscuro(uint16_t c) {
  int r = (c >> 11) & 31, g = (c >> 5) & 63, b = c & 31;
  return (r + g / 2 + b) <= 3;             // negro o casi negro
}

// Marca como transparente solo el negro conectado con el borde de la imagen,
// así los negros internos del robot se conservan.
void prepararMascaraRobot() {
  memset(FONDO, 0, sizeof(FONDO));
  bool cambio = true;
  while (cambio) {
    cambio = false;
    for (int y = 0; y < ROBOT_H; y++) {
      for (int x = 0; x < ROBOT_W; x++) {
        int i = y * ROBOT_W + x;
        if (FONDO[i]) continue;
        if (!esOscuro(pgm_read_word(&ROBOT[i]))) continue;
        bool borde = (x == 0 || y == 0 || x == ROBOT_W - 1 || y == ROBOT_H - 1);
        if (borde ||
            (x > 0 && FONDO[i - 1]) || (x < ROBOT_W - 1 && FONDO[i + 1]) ||
            (y > 0 && FONDO[i - ROBOT_W]) || (y < ROBOT_H - 1 && FONDO[i + ROBOT_W])) {
          FONDO[i] = 1;
          cambio = true;
        }
      }
    }
  }
}

// Dibuja solo las primeras 'filas' del robot (de arriba hacia abajo).
// 'yAbajo' es la coordenada donde termina la última fila dibujada.
void dibujarRobot(int cx, int yAbajo, int filas) {
  int x0 = cx - ROBOT_W / 2;
  int y0 = yAbajo - filas;
  tft.startWrite();
  for (int y = 0; y < filas; y++) {
    int py = y0 + y;
    if (py < 0 || py >= 240) continue;
    for (int x = 0; x < ROBOT_W; x++) {
      int i = y * ROBOT_W + x;
      if (FONDO[i]) continue;
      tft.writePixel(x0 + x, py, pgm_read_word(&ROBOT[i]));
    }
  }
  tft.endWrite();
}

// =====================================================================
//  HALO RGB pegado al borde de la pantalla, difuminado hacia adentro
// =====================================================================
#define HALO_PROF        40     // profundidad del difuminado en px (mas = mas ancho y suave)
#define HALO_PICO        175    // brillo maximo en el borde (0..255; menos = menos solido)
#define HALO_CAIDA       5.0f   // rapidez con que se desvanece hacia adentro (menos = mas largo)
#define MS_POR_PASO_RGB  12     // más pequeño = el arcoíris gira más rápido (12 ms/paso -> ~3 s por vuelta)
#define MS_ENCENDIDO     900    // tiempo en que el halo se enciende de los bordes hacia adentro
#define MS_ENTRADA_LOGO  450    // tiempo que tarda el logo en cruzar de derecha a izquierda

const float R_OUT = 120.5f;
const float R_IN  = R_OUT - HALO_PROF;

#define MAX_ANILLO 26500
// Se reservan en el heap solo durante el arranque y se liberan despues (ver liberarAnillo)
static uint8_t *aBase = nullptr;     // brillo base (difuminado: maximo en el borde, 0 adentro)
static uint8_t *aProf = nullptr;     // profundidad: 0 = borde, 255 = parte más interna
static uint8_t *aTono = nullptr;     // tono (0..255) según el ángulo
static uint16_t filaIni[240];        // índice del primer píxel del anillo en cada fila
static int16_t  xi0[240], xi1[240];  // tramo izquierdo  [xi0, xi1)
static int16_t  xd0[240], xd1[240];  // tramo derecho    [xd0, xd1)
static uint8_t  PAL[256][3];         // rueda de colores RGB

void tonoRGB(uint8_t h, uint8_t &r, uint8_t &g, uint8_t &b) {
  uint8_t region = h / 43;
  uint8_t rem = (h - region * 43) * 6;
  uint8_t q = 255 - rem, t = rem;
  switch (region) {
    case 0:  r = 255; g = t;   b = 0;   break;
    case 1:  r = q;   g = 255; b = 0;   break;
    case 2:  r = 0;   g = 255; b = t;   break;
    case 3:  r = 0;   g = q;   b = 255; break;
    case 4:  r = t;   g = 0;   b = 255; break;
    default: r = 255; g = 0;   b = q;   break;
  }
}

void liberarAnillo() {
  free(aBase); free(aProf); free(aTono);
  aBase = aProf = aTono = nullptr;
}

// Calcula una sola vez qué píxeles forman el halo y su brillo/tono
void prepararAnillo() {
  aBase = (uint8_t*)malloc(MAX_ANILLO);
  aProf = (uint8_t*)malloc(MAX_ANILLO);
  aTono = (uint8_t*)malloc(MAX_ANILLO);
  if (!aBase || !aProf || !aTono) { liberarAnillo(); return; }   // sin memoria: arranca sin halo
  for (int i = 0; i < 256; i++) tonoRGB(i, PAL[i][0], PAL[i][1], PAL[i][2]);
  int n = 0;
  for (int y = 0; y < 240; y++) {
    filaIni[y] = n;
    xi0[y] = xi1[y] = xd0[y] = xd1[y] = 0;
    int fase = 0;   // 0 antes, 1 en tramo izq, 2 entre tramos, 3 en tramo der, 4 fin
    for (int x = 0; x < 240; x++) {
      float dx = x - 119.5f, dy = y - 119.5f;
      float r = sqrtf(dx * dx + dy * dy);
      bool en = (r >= R_IN && r <= R_OUT) && (n < MAX_ANILLO);
      if (en) {
        if (fase == 0)      { fase = 1; xi0[y] = x; }
        else if (fase == 2) { fase = 3; xd0[y] = x; }
        float d = (R_OUT - r) / HALO_PROF;          // 0 borde ... 1 interior
        if (d < 0) d = 0;
        if (d > 1) d = 1;
        aProf[n] = (uint8_t)(d * 255);
        aBase[n] = (uint8_t)(HALO_PICO * expf(-d * d * HALO_CAIDA));   // curva gaussiana: desvanecido suave
        float ang = atan2f(dy, dx);                  // -PI..PI
        aTono[n] = (uint8_t)((ang + PI) * (256.0f / (2.0f * PI)));
        n++;
      } else {
        if (fase == 1)      { fase = 2; xi1[y] = x; }
        else if (fase == 3) { fase = 4; xd1[y] = x; }
      }
    }
    if (fase == 1) xi1[y] = 240;
    else if (fase == 3) xd1[y] = 240;
  }
}

// Mezcla el halo encima de un color de base (el robot, o negro).
// intro: 0..510 (0 = apagado, 255 = solo el borde encendido, 510 = todo encendido)
static inline uint16_t mezclarAnillo(uint16_t base, int i, int intro, uint8_t fase) {
  int t = intro - aProf[i];
  if (t <= 0) return base;
  if (t > 255) t = 255;
  int a = (aBase[i] * (t + 1)) >> 8;
  if (a <= 0) return base;
  const uint8_t* c = PAL[(uint8_t)(aTono[i] + fase)];
  int r = (((base >> 11) & 31) * (256 - a)) >> 8;
  int g = (((base >> 5) & 63) * (256 - a)) >> 8;
  int b = ((base & 31) * (256 - a)) >> 8;
  r += (c[0] * a) >> 11;
  g += (c[1] * a) >> 10;
  b += (c[2] * a) >> 11;
  if (r > 31) r = 31;
  if (g > 63) g = 63;
  if (b > 31) b = 31;
  return (r << 11) | (g << 5) | b;
}

static inline uint16_t colorAnillo(int i, int intro, uint8_t fase) {
  return mezclarAnillo(0, i, intro, fase);
}

static inline uint8_t faseRGB() { return (uint8_t)(millis() / MS_POR_PASO_RGB); }

static uint16_t bufFila[240];

// Dibuja un cuadro completo: robot asomando abajo (opcional) + halo por encima + logo VEX (opcional).
// Cada píxel se escribe una sola vez, así no hay parpadeo ni rastros.
void dibujarFrame(int intro, int logoX, bool conLogo, bool conRobot, uint8_t fase) {
  const int logoY = (240 - VEXIMG_H) / 2;
  const int ROBOT_FILAS = 40;                 // mitad superior del robot
  const int robotY0 = 240 - ROBOT_FILAS;      // asoma desde abajo, centrado (x = 120)
  const int robotX0 = 120 - ROBOT_W / 2;
  tft.startWrite();
  for (int y = 0; y < 240; y++) {
    bool hayLogo  = conLogo  && y >= logoY && y < logoY + VEXIMG_H;
    bool hayRobot = conRobot && y >= robotY0;
    int n = filaIni[y];

    if (!hayLogo && !hayRobot) {
      // solo los tramos del halo
      if (xi1[y] > xi0[y]) {
        int w = xi1[y] - xi0[y];
        for (int k = 0; k < w; k++) bufFila[k] = colorAnillo(n++, intro, fase);
        tft.setAddrWindow(xi0[y], y, w, 1);
        tft.writePixels(bufFila, w);
      }
      if (xd1[y] > xd0[y]) {
        int w = xd1[y] - xd0[y];
        for (int k = 0; k < w; k++) bufFila[k] = colorAnillo(n++, intro, fase);
        tft.setAddrWindow(xd0[y], y, w, 1);
        tft.writePixels(bufFila, w);
      }
      continue;
    }

    // fila con robot y/o logo: se compone entera y se envía de una vez
    memset(bufFila, 0, sizeof(bufFila));
    if (hayRobot) {
      int ry = y - robotY0;
      for (int rx = 0; rx < ROBOT_W; rx++) {
        int i = ry * ROBOT_W + rx;
        if (!FONDO[i]) bufFila[robotX0 + rx] = pgm_read_word(&ROBOT[i]);
      }
    }
    for (int x = xi0[y]; x < xi1[y]; x++) bufFila[x] = mezclarAnillo(bufFila[x], n++, intro, fase);
    for (int x = xd0[y]; x < xd1[y]; x++) bufFila[x] = mezclarAnillo(bufFila[x], n++, intro, fase);
    if (hayLogo) {
      int ly = y - logoY;
      for (int lx = 0; lx < VEXIMG_W; lx++) {
        int x = logoX + lx;
        if (x < 0 || x >= 240) continue;
        uint16_t c = pgm_read_word(&VEXIMG[ly * VEXIMG_W + lx]);
        if (c) bufFila[x] = c;
      }
    }
    tft.setAddrWindow(0, y, 240, 1);
    tft.writePixels(bufFila, 240);
  }
  tft.endWrite();
}

// ---------- Texto normal centrado ----------
void textoCentrado(const char* txt, int y, int tam, uint16_t color) {
  int16_t x1, y1; uint16_t w, h;
  tft.setTextSize(tam);
  tft.getTextBounds(txt, 0, 0, &x1, &y1, &w, &h);
  tft.setCursor((240 - w) / 2 - x1, y);
  tft.setTextColor(color);
  tft.print(txt);
}

// Logo Arduino pequeño + texto "ARDUINO" a su lado, centrado
void marcaArduino(int y) {
  const char* txt = "ARDUINO";
  int16_t x1, y1; uint16_t w, h;
  tft.setTextSize(2);
  tft.getTextBounds(txt, 0, 0, &x1, &y1, &w, &h);
  int gap   = 6;
  int total = LOGO_W + gap + w;
  int x0    = (240 - total) / 2;
  tft.drawRGBBitmap(x0, y, LOGO, LOGO_W, LOGO_H);
  tft.setCursor(x0 + LOGO_W + gap - x1, y + (LOGO_H - h) / 2 - y1);
  tft.setTextColor(TEAL);
  tft.print(txt);
}

// ---------- Animación 1: arranque ----------
void pantallaArranque() {
  const int logoX = (240 - VEXIMG_W) / 2;
  const int logoY = 58;              // el logo ocupa de y=58 a y=147
  const int ROBOT_X = 150;           // usa 120 para centrarlo en la pantalla
  tft.fillScreen(GC9A01A_BLACK);
  // el robot asoma por detrás de la parte de arriba del logo (42 filas visibles)
  dibujarRobot(ROBOT_X, logoY + 12, 42);
  aparecerVEX(logoX, logoY);
  textoCentrado("powered by", 168, 1, 0x8410);
  marcaArduino(184);
  delay(VEX_PANTALLA_MS);
}

// ---------- Animación 2: halo RGB en el borde + robot asomando abajo + logo entrando de derecha a izquierda ----------
const int VEX_X_FINAL = (240 - VEXIMG_W) / 2;

void animacionLogo() {
  tft.fillScreen(GC9A01A_BLACK);

  // 1) El halo se enciende desde el borde hacia adentro (sin dar la vuelta)
  uint32_t t0 = millis();
  for (;;) {
    uint32_t dt = millis() - t0;
    if (dt >= MS_ENCENDIDO) break;
    dibujarFrame((int)(dt * 510UL / MS_ENCENDIDO), 0, false, false, faseRGB());
  }

  // 2) Aparece el robot asomando desde abajo (el halo pasa por encima) y el logo
  //    cruza de derecha a izquierda (rápido al inicio, frena al llegar)
  t0 = millis();
  for (;;) {
    uint32_t dt = millis() - t0;
    if (dt >= MS_ENTRADA_LOGO) break;
    float p = (float)dt / MS_ENTRADA_LOGO;
    float e = 1.0f - (1.0f - p) * (1.0f - p) * (1.0f - p);   // ease-out cúbico
    int x = 240 + (int)((VEX_X_FINAL - 240) * e);
    dibujarFrame(510, x, true, true, faseRGB());
  }
  dibujarFrame(510, VEX_X_FINAL, true, true, faseRGB());
}

// ===== fin de vex_intro.h =====


bool     soundOn = true;
uint8_t  skinIdx = 0;
uint8_t  diffIdx = 1;
uint32_t hiScore = 0;

const uint32_t FRAME_MS = 30;

// ============================== BOTONES ==============================
enum { B_UP, B_DOWN, B_LEFT, B_RIGHT, B_OK };
const uint8_t btnPins[5] = {PIN_UP, PIN_DOWN, PIN_LEFT, PIN_RIGHT, PIN_OK};
bool     btnHeld[5], btnPress[5];
uint32_t btnLast[5];
const int8_t BDX[4] = {0, 0, -1, 1};   // arriba, abajo, izq, der
const int8_t BDY[4] = {-1, 1, 0, 0};

void readButtons(uint32_t now) {
  for (int i = 0; i < 5; i++) {
    bool raw = (digitalRead(btnPins[i]) == LOW);
    if (raw != btnHeld[i] && (now - btnLast[i]) > 15) {
      btnHeld[i] = raw;
      btnLast[i] = now;
      if (raw) btnPress[i] = true;
    }
  }
}
void clearPresses() { for (int i = 0; i < 5; i++) btnPress[i] = false; }

// ============================== SONIDO (no bloqueante) ==============================
const Note SND_INTRO[]  = {{392,100},{523,100},{659,100},{784,160},{0,40},{659,100},{784,260}};
const Note SND_WAKA1[]  = {{880,35}};
const Note SND_WAKA2[]  = {{660,35}};
const Note SND_POWER[]  = {{400,30},{600,30},{800,30},{1000,30},{1200,40}};
const Note SND_GHOST[]  = {{600,40},{900,40},{1200,60},{1500,80}};
const Note SND_DEATH[]  = {{900,90},{800,90},{700,90},{600,90},{500,90},{400,90},{300,90},{200,150}};
const Note SND_LEVEL[]  = {{659,100},{784,100},{988,100},{1319,250}};
const Note SND_CLICK[]  = {{1200,15}};
const Note SND_OVER[]   = {{392,200},{330,200},{262,200},{196,500}};
const Note SND_LIFE[]   = {{1047,80},{1319,80},{1568,160}};
#define NN(a) ((uint8_t)(sizeof(a) / sizeof(a[0])))

const Note* seqPtr = nullptr;
uint8_t  seqLen = 0, seqIdx = 0, seqPrio = 0;
uint32_t seqNext = 0;

void buzz(uint16_t f) {
#if defined(ESP_ARDUINO_VERSION_MAJOR) && ESP_ARDUINO_VERSION_MAJOR >= 3
  ledcWriteTone(PIN_BUZZ, f);
#else
  ledcWriteTone(0, f);
#endif
}
void soundInit() {
#if defined(ESP_ARDUINO_VERSION_MAJOR) && ESP_ARDUINO_VERSION_MAJOR >= 3
  ledcAttach(PIN_BUZZ, 2000, 10);
#else
  ledcSetup(0, 2000, 10);
  ledcAttachPin(PIN_BUZZ, 0);
#endif
  buzz(0);
}
void playSeq(const Note* s, uint8_t n, uint8_t prio) {
  if (!soundOn) return;
  if (seqPtr && prio < seqPrio) return;
  seqPtr = s; seqLen = n; seqIdx = 0; seqPrio = prio; seqNext = millis();
}
void updateSound(uint32_t now) {
  if (!seqPtr) return;
  if ((int32_t)(now - seqNext) < 0) return;
  if (seqIdx >= seqLen) { buzz(0); seqPtr = nullptr; seqPrio = 0; return; }
  buzz(seqPtr[seqIdx].f);
  seqNext = now + seqPtr[seqIdx].ms;
  seqIdx++;
}
void waitMs(uint32_t ms) {
  uint32_t t = millis();
  while (millis() - t < ms) { updateSound(millis()); delay(2); }
}
void click() { playSeq(SND_CLICK, NN(SND_CLICK), 1); }

// ============================== LABERINTO ==============================
// _ vacio fuera del circulo   # pared   . punto   o super punto   = puerta   ' ' pasillo
const int TS = 11, COLS = 17, ROWS = 17, OX = 26, OY = 26;
const char* const MAZE_SRC[ROWS] = {
  "__#############__",
  "_#.............#_",
  "#.o.##.###.##.o.#",
  "#...............#",
  "#.##.#.###.#.##.#",
  "#....#.....#....#",
  "#.##.###=###.##.#",
  "#.....#   #.....#",
  "#.###.#   #.###.#",
  "#.....#####.....#",
  "#.#####...#####.#",
  "#.o...#.#.#...o.#",
  "#...............#",
  "#.##.#.###.#.##.#",
  "#...............#",
  "_#......#......#_",
  "__#############__"
};
char    maze[ROWS][COLS + 1];
uint8_t homeDist[ROWS][COLS];
bool    blinkOn = true, flashWhite = false;

inline bool isPathCh(char t) { return t == ' ' || t == '.' || t == 'o'; }
char tileAt(int c, int r) { return (c < 0 || r < 0 || c >= COLS || r >= ROWS) ? '_' : maze[r][c]; }
bool canEnter(int c, int r) { return isPathCh(tileAt(c, r)); }

void drawTile(int c, int r) {
  if (c < 0 || r < 0 || c >= COLS || r >= ROWS) return;
  char t = maze[r][c];
  int x = OX + c * TS, y = OY + r * TS;
  if (t == '_') { tft.fillRect(x, y, TS, TS, C_BLACK); return; }
  if (t == '#') {
    uint16_t lc = flashWhite ? C_WHITE : SK.wallLine;
    tft.fillRect(x, y, TS, TS, SK.wallFill);
    if (isPathCh(tileAt(c, r - 1)) || tileAt(c, r - 1) == '=') tft.fillRect(x, y, TS, 2, lc);
    if (isPathCh(tileAt(c, r + 1)) || tileAt(c, r + 1) == '=') tft.fillRect(x, y + TS - 2, TS, 2, lc);
    if (isPathCh(tileAt(c - 1, r)) || tileAt(c - 1, r) == '=') tft.fillRect(x, y, 2, TS, lc);
    if (isPathCh(tileAt(c + 1, r)) || tileAt(c + 1, r) == '=') tft.fillRect(x + TS - 2, y, 2, TS, lc);
    return;
  }
  tft.fillRect(x, y, TS, TS, C_BLACK);
  if (t == '.')      tft.fillRect(x + 4, y + 4, 3, 3, SK.dot);
  else if (t == 'o') { if (blinkOn) tft.fillCircle(x + 5, y + 5, 4, SK.dot); }
  else if (t == '=') tft.fillRect(x, y + 4, TS, 3, SK.door);
}
void drawMaze() { for (int r = 0; r < ROWS; r++) for (int c = 0; c < COLS; c++) drawTile(c, r); }
void restoreRect(int x, int y) {   // x,y en pixeles relativos al laberinto
  int c0 = x / TS, c1 = (x + TS - 1) / TS, r0 = y / TS, r1 = (y + TS - 1) / TS;
  for (int r = r0; r <= r1; r++) for (int c = c0; c <= c1; c++) drawTile(c, r);
}

// BFS: distancia de cada pasillo a la casilla sobre la puerta (8,5); la usan los ojos
void buildHomeDist() {
  memset(homeDist, 255, sizeof(homeDist));
  uint8_t qc[ROWS * COLS], qr[ROWS * COLS];
  int head = 0, tail = 0;
  homeDist[5][8] = 0; qc[tail] = 8; qr[tail++] = 5;
  const int dc[4] = {0, -1, 0, 1}, dr[4] = {-1, 0, 1, 0};
  while (head < tail) {
    int c = qc[head], r = qr[head++];
    for (int d = 0; d < 4; d++) {
      int nc = c + dc[d], nr = r + dr[d];
      if (canEnter(nc, nr) && homeDist[nr][nc] == 255) {
        homeDist[nr][nc] = homeDist[r][c] + 1;
        qc[tail] = nc; qr[tail++] = nr;
      }
    }
  }
}

// ============================== SPRITES ==============================
void drawPacSprite(int sx, int sy, int dx, int dy, int mouth, uint16_t col) {
  int cx = sx + 5, cy = sy + 5;
  tft.fillCircle(cx, cy, 5, col);
  if (mouth > 0) {
    if (dx == 0 && dy == 0) dx = 1;
    int pxv = -dy, pyv = dx;
    tft.fillTriangle(cx, cy,
                     cx + dx * 5 + pxv * mouth, cy + dy * 5 + pyv * mouth,
                     cx + dx * 5 - pxv * mouth, cy + dy * 5 - pyv * mouth, C_BLACK);
  }
}
void drawEyes(int sx, int sy, int dx, int dy) {
  tft.fillRect(sx + 2, sy + 3, 3, 3, C_WHITE);
  tft.fillRect(sx + 6, sy + 3, 3, 3, C_WHITE);
  tft.fillRect(sx + 3 + dx, sy + 4 + dy, 1, 1, C_EYE);
  tft.fillRect(sx + 7 + dx, sy + 4 + dy, 1, 1, C_EYE);
}

enum GMode : uint8_t { G_PEN, G_LEAVING, G_NORMAL, G_FRIGHT, G_EATEN, G_ENTERING };
struct Ghost {
  int16_t x, y, px, py;
  int8_t  dx, dy;
  GMode   mode;
  uint8_t acc;
  uint32_t releaseAt;
};
struct Pac {
  int16_t x, y, px, py;
  int8_t  dx, dy, ndx, ndy, lastdx, lastdy;
  uint8_t acc, phase;
};
Ghost ghosts[4];
Pac   pac;

void drawGhostSprite(int sx, int sy, uint16_t col, int dx, int dy, bool fright, bool eyesOnly, bool flash) {
  if (!eyesOnly) {
    uint16_t c = fright ? (flash ? SK.frightFlash : SK.fright) : col;
    tft.fillCircle(sx + 5, sy + 5, 5, c);
    tft.fillRect(sx, sy + 5, 11, 6, c);
    tft.drawFastVLine(sx + 3, sy + 9, 2, C_BLACK);
    tft.drawFastVLine(sx + 7, sy + 9, 2, C_BLACK);
    if (fright) {
      tft.fillRect(sx + 3, sy + 3, 2, 2, flash ? C_RED : C_WHITE);
      tft.fillRect(sx + 7, sy + 3, 2, 2, flash ? C_RED : C_WHITE);
      return;
    }
  }
  drawEyes(sx, sy, dx, dy);
}

// ============================== TEXTO ==============================
void printC(const char* s, int y, uint8_t sz, uint16_t col) {
  tft.setTextSize(sz);
  tft.setTextColor(col);
  int w = strlen(s) * 6 * sz;
  tft.setCursor((240 - w) / 2, y);
  tft.print(s);
}


// Prototipos (adelantados)
void drawMenu();
void drawOptions();

// ============================== ESTADO DE JUEGO ==============================
enum State : uint8_t { S_MENU, S_OPTIONS, S_PLAY, S_PAUSE, S_OVER };
State    state = S_MENU;
uint32_t score = 0, nextLife = 10000, overStart = 0, pauseStart = 0;
int      lives = 3, level = 1, dotsLeft = 0;
int      ghostSpeedQ = 6, frightMsBase = 7000, randChance = 12;
bool     frightActive = false, scatter = true, scoreDirty = true;
uint32_t frightUntil = 0, modeUntil = 0, blinkT = 0;
int      ghostCombo = 200;
bool     newRecord = false;
bool     pacSalir = false;      // true = volver al menu del arcade

const int8_t GDX[4] = {0, -1, 0, 1};   // arriba, izq, abajo, der (orden clasico)
const int8_t GDY[4] = {-1, 0, 1, 0};
const int PAC_SPEED_Q = 8;             // cuartos de pixel por frame (8 = 2 px)

void drawScore() {
  char b[24];
  snprintf(b, sizeof(b), "SCORE %lu", (unsigned long)score);
  tft.fillRect(40, 10, 160, 12, C_BLACK);
  printC(b, 12, 1, SK.text);
}
void drawLives() {
  tft.fillRect(60, 214, 120, 18, C_BLACK);
  for (int i = 0; i < lives && i < 5; i++) {
    int cx = 78 + i * 12, cy = 224;
    tft.fillCircle(cx, cy, 4, SK.pac);
    tft.fillTriangle(cx, cy, cx + 5, cy - 3, cx + 5, cy + 3, C_BLACK);
  }
  char b[12];
  snprintf(b, sizeof(b), "NIV %d", level);
  tft.setTextSize(1); tft.setTextColor(SK.text);
  tft.setCursor(142, 220); tft.print(b);
}

void loadLevel() {
  for (int r = 0; r < ROWS; r++) strcpy(maze[r], MAZE_SRC[r]);
  maze[12][8] = ' ';   // casilla de salida de Pac-Man sin punto
  dotsLeft = 0;
  for (int r = 0; r < ROWS; r++) for (int c = 0; c < COLS; c++) if (maze[r][c] == '.' || maze[r][c] == 'o') dotsLeft++;
  buildHomeDist();
  int base = 5 + diffIdx, add = level - 1; if (add > 2) add = 2;
  ghostSpeedQ = base + add; if (ghostSpeedQ > 8) ghostSpeedQ = 8;
  int ms = 7000 - (level - 1) * 900; if (ms < 2500) ms = 2500;
  if (diffIdx == 0) ms = ms * 14 / 10; else if (diffIdx == 2) ms = ms * 7 / 10;
  frightMsBase = ms;
  randChance = (diffIdx == 0) ? 35 : (diffIdx == 1 ? 12 : 0);
}

void resetEntities() {
  pac.x = 8 * TS; pac.y = 12 * TS; pac.dx = -1; pac.dy = 0; pac.ndx = -1; pac.ndy = 0;
  pac.lastdx = -1; pac.lastdy = 0; pac.acc = 0; pac.phase = 0; pac.px = pac.x; pac.py = pac.y;
  const int8_t gc[4] = {8, 8, 7, 9}, gr[4] = {5, 7, 8, 8};
  for (int i = 0; i < 4; i++) {
    Ghost &g = ghosts[i];
    g.x = gc[i] * TS; g.y = gr[i] * TS; g.px = g.x; g.py = g.y;
    g.dx = (i == 0) ? -1 : 0; g.dy = 0; g.acc = 0;
    g.mode = (i == 0) ? G_NORMAL : G_PEN;
  }
  frightActive = false;
  scatter = true;
}

void drawActors(uint32_t now) {
  int m = 3;
  if (pac.dx || pac.dy) { const uint8_t mm[4] = {1, 3, 4, 3}; m = mm[(pac.phase >> 1) & 3]; }
  drawPacSprite(OX + pac.x, OY + pac.y, pac.lastdx, pac.lastdy, m, SK.pac);
  for (int i = 0; i < 4; i++) {
    Ghost &g = ghosts[i];
    bool fr = (g.mode == G_FRIGHT);
    bool fl = fr && (int32_t)(frightUntil - now) < 2000 && ((now / 200) & 1);
    drawGhostSprite(OX + g.x, OY + g.y, SK.ghost[i], g.dx, g.dy, fr, g.mode == G_EATEN, fl);
  }
}

void startRound(bool intro) {
  resetEntities();
  tft.fillScreen(C_BLACK);
  drawMaze();
  drawScore();
  drawLives();
  drawActors(millis());
  printC("LISTO!", OY + 10 * TS + 2, 1, SK.text);
  if (intro) playSeq(SND_INTRO, NN(SND_INTRO), 3);
  waitMs(intro ? 2300 : 1400);
  for (int c = 5; c <= 11; c++) drawTile(c, 10);
  uint32_t now = millis();
  const uint16_t rel[4] = {0, 2000, 5000, 8000};
  for (int i = 1; i < 4; i++) ghosts[i].releaseAt = now + rel[i];
  modeUntil = now + 5000;
  blinkT = now;
  clearPresses();
}

void startGame() {
  score = 0; lives = 3; level = 1; nextLife = 10000; scoreDirty = true; newRecord = false;
  loadLevel();
  startRound(true);
  state = S_PLAY;
}

// ============================== PAC-MAN ==============================
void startFright(uint32_t now) {
  frightActive = true;
  ghostCombo = 200;
  frightUntil = now + frightMsBase;
  for (int i = 0; i < 4; i++) {
    Ghost &g = ghosts[i];
    if (g.mode == G_NORMAL) { g.mode = G_FRIGHT; g.dx = -g.dx; g.dy = -g.dy; }
  }
  playSeq(SND_POWER, NN(SND_POWER), 2);
}

bool wakaToggle = false;
void eatAt(int c, int r, uint32_t now) {
  char t = maze[r][c];
  if (t == '.') {
    maze[r][c] = ' '; score += 10; dotsLeft--; scoreDirty = true;
    wakaToggle = !wakaToggle;
    if (wakaToggle) playSeq(SND_WAKA1, 1, 0); else playSeq(SND_WAKA2, 1, 0);
  } else if (t == 'o') {
    maze[r][c] = ' '; score += 50; dotsLeft--; scoreDirty = true;
    startFright(now);
  }
}

void movePac(uint32_t now) {
  pac.acc += PAC_SPEED_Q;
  int steps = pac.acc >> 2; pac.acc &= 3;
  for (int s = 0; s < steps; s++) {
    if ((pac.dx || pac.dy) && (pac.ndx || pac.ndy) && pac.ndx == -pac.dx && pac.ndy == -pac.dy) {
      pac.dx = pac.ndx; pac.dy = pac.ndy;     // dar la vuelta en cualquier momento
    }
    if (pac.x % TS == 0 && pac.y % TS == 0) {
      int c = pac.x / TS, r = pac.y / TS;
      eatAt(c, r, now);
      if ((pac.ndx || pac.ndy) && canEnter(c + pac.ndx, r + pac.ndy)) { pac.dx = pac.ndx; pac.dy = pac.ndy; }
      if (!canEnter(c + pac.dx, r + pac.dy)) { pac.dx = 0; pac.dy = 0; }
    }
    pac.x += pac.dx; pac.y += pac.dy;
    if (pac.dx || pac.dy) { pac.lastdx = pac.dx; pac.lastdy = pac.dy; }
  }
  pac.phase++;
}

// ============================== FANTASMAS ==============================
void ghostTarget(int i, int &tc, int &tr) {
  Ghost &g = ghosts[i];
  int pc = (pac.x + TS / 2) / TS, pr = (pac.y + TS / 2) / TS;
  if (g.mode == G_EATEN) { tc = 8; tr = 5; return; }
  if (scatter && g.mode == G_NORMAL) {
    const int sc[4] = {16, 0, 16, 0}, sr[4] = {0, 0, 16, 16};
    tc = sc[i]; tr = sr[i]; return;
  }
  switch (i) {
    case 0: tc = pc; tr = pr; break;
    case 1: tc = pc + 4 * pac.lastdx; tr = pr + 4 * pac.lastdy; break;
    case 2: {
      int ac = pc + 2 * pac.lastdx, ar = pr + 2 * pac.lastdy;
      int bc = (ghosts[0].x + TS / 2) / TS, br = (ghosts[0].y + TS / 2) / TS;
      tc = ac + (ac - bc); tr = ar + (ar - br); break;
    }
    default: {
      int gc = (g.x + TS / 2) / TS, gr = (g.y + TS / 2) / TS;
      long d2 = (long)(gc - pc) * (gc - pc) + (long)(gr - pr) * (gr - pr);
      if (d2 > 64) { tc = pc; tr = pr; } else { tc = 0; tr = 16; }
    }
  }
}

void ghostDecide(int i) {
  Ghost &g = ghosts[i];
  int c = g.x / TS, r = g.y / TS;
  if (g.mode == G_EATEN) {
    int best = 255, bd = -1;
    for (int d = 0; d < 4; d++) {
      int nc = c + GDX[d], nr = r + GDY[d];
      if (canEnter(nc, nr) && homeDist[nr][nc] < best) { best = homeDist[nr][nc]; bd = d; }
    }
    if (bd >= 0) { g.dx = GDX[bd]; g.dy = GDY[bd]; }
    return;
  }
  int tc = 0, tr = 0; ghostTarget(i, tc, tr);
  int cand[4], nc = 0, bestD = -1;
  for (int pass = 0; pass < 2 && nc == 0; pass++) {
    long best = 0x7fffffff;
    for (int d = 0; d < 4; d++) {
      if (pass == 0 && (g.dx || g.dy) && GDX[d] == -g.dx && GDY[d] == -g.dy) continue;
      int xc = c + GDX[d], xr = r + GDY[d];
      if (!canEnter(xc, xr)) continue;
      cand[nc++] = d;
      long dist = (long)(xc - tc) * (xc - tc) + (long)(xr - tr) * (xr - tr);
      if (dist < best) { best = dist; bestD = d; }
    }
  }
  if (nc == 0) { g.dx = 0; g.dy = 0; return; }
  if (g.mode == G_FRIGHT || (g.mode == G_NORMAL && (int)random(100) < randChance)) bestD = cand[random(nc)];
  g.dx = GDX[bestD]; g.dy = GDY[bestD];
}

void moveGhost(int i, uint32_t now) {
  Ghost &g = ghosts[i];
  switch (g.mode) {
    case G_PEN:
      if ((int32_t)(now - g.releaseAt) >= 0) g.mode = G_LEAVING;
      return;
    case G_LEAVING:
      g.dx = 0; g.dy = 0;
      if (g.x < 8 * TS) g.x++;
      else if (g.x > 8 * TS) g.x--;
      else if (g.y > 5 * TS) g.y--;
      else {
        g.mode = frightActive ? G_FRIGHT : G_NORMAL;
        g.dx = random(2) ? 1 : -1; g.dy = 0;
      }
      return;
    case G_ENTERING:
      g.y += 2;
      if (g.y >= 7 * TS) { g.y = 7 * TS; g.mode = G_PEN; g.releaseAt = now + 900; g.dx = 0; g.dy = 0; }
      return;
    default: break;
  }
  int sp = (g.mode == G_EATEN) ? 12 : (g.mode == G_FRIGHT ? 4 : ghostSpeedQ);
  g.acc += sp;
  int steps = g.acc >> 2; g.acc &= 3;
  for (int s = 0; s < steps; s++) {
    if (g.x % TS == 0 && g.y % TS == 0) {
      if (g.mode == G_EATEN && g.x / TS == 8 && g.y / TS == 5) { g.mode = G_ENTERING; g.dx = 0; g.dy = 1; return; }
      ghostDecide(i);
    }
    g.x += g.dx; g.y += g.dy;
  }
}

// ============================== FLUJO DE JUEGO ==============================
void gameOver() {
  state = S_OVER;
  overStart = millis();
  if (score > hiScore) { hiScore = score; newRecord = true; prefs.putUInt("hi", hiScore); }
  tft.fillScreen(C_BLACK);
  printC("GAME OVER", 80, 2, C_RED);
  char b[28]; snprintf(b, sizeof(b), "SCORE %lu", (unsigned long)score);
  printC(b, 112, 2, C_WHITE);
  if (newRecord) printC("NUEVO RECORD!", 142, 1, SK.text);
  else { snprintf(b, sizeof(b), "RECORD %lu", (unsigned long)hiScore); printC(b, 142, 1, SK.dot); }
  playSeq(SND_OVER, NN(SND_OVER), 3);
}

void dieSequence() {
  playSeq(SND_DEATH, NN(SND_DEATH), 3);
  for (int i = 0; i < 4; i++) restoreRect(ghosts[i].x, ghosts[i].y);
  waitMs(350);
  for (int r = 5; r >= 0; r--) {
    restoreRect(pac.x, pac.y);
    if (r > 0) tft.fillCircle(OX + pac.x + 5, OY + pac.y + 5, r, SK.pac);
    waitMs(110);
  }
  waitMs(300);
  lives--;
  if (lives <= 0) gameOver();
  else startRound(false);
}

void levelClear() {
  playSeq(SND_LEVEL, NN(SND_LEVEL), 3);
  waitMs(400);
  for (int i = 0; i < 6; i++) { flashWhite = (i & 1) == 0; drawMaze(); waitMs(180); }
  flashWhite = false;
  level++;
  loadLevel();
  startRound(false);
}

void enterPause() {
  pauseStart = millis();
  state = S_PAUSE;
  buzz(0);
  tft.fillRect(50, 98, 140, 46, C_BLACK);
  tft.drawRect(50, 98, 140, 46, SK.wallLine);
  printC("PAUSA", 104, 2, SK.text);
  printC("OK:SEGUIR  <:SALIR", 128, 1, C_WHITE);
}

void tickPlay(uint32_t now) {
  if (btnPress[B_OK]) { enterPause(); return; }

  int d = -1;
  for (int i = 0; i < 4; i++) if (btnPress[i]) d = i;
  if (d < 0) {
    int cnt = 0, last = -1;
    for (int i = 0; i < 4; i++) if (btnHeld[i]) { cnt++; last = i; }
    if (cnt == 1) d = last;
  }
  if (d >= 0) { pac.ndx = BDX[d]; pac.ndy = BDY[d]; }

  if (now - blinkT >= 250) {
    blinkT = now; blinkOn = !blinkOn;
    for (int r = 0; r < ROWS; r++) for (int c = 0; c < COLS; c++) if (maze[r][c] == 'o') drawTile(c, r);
  }

  pac.px = pac.x; pac.py = pac.y;
  for (int i = 0; i < 4; i++) { ghosts[i].px = ghosts[i].x; ghosts[i].py = ghosts[i].y; }

  movePac(now);

  if (frightActive && (int32_t)(now - frightUntil) >= 0) {
    frightActive = false;
    for (int i = 0; i < 4; i++) if (ghosts[i].mode == G_FRIGHT) ghosts[i].mode = G_NORMAL;
  }
  if (!frightActive && (int32_t)(now - modeUntil) >= 0) {
    scatter = !scatter;
    modeUntil = now + (scatter ? 5000 : 18000);
    for (int i = 0; i < 4; i++) if (ghosts[i].mode == G_NORMAL) { ghosts[i].dx = -ghosts[i].dx; ghosts[i].dy = -ghosts[i].dy; }
  }

  for (int i = 0; i < 4; i++) moveGhost(i, now);

  bool dead = false;
  for (int i = 0; i < 4; i++) {
    Ghost &g = ghosts[i];
    if (g.mode == G_PEN || g.mode == G_ENTERING || g.mode == G_EATEN) continue;
    if (abs(g.x - pac.x) < 8 && abs(g.y - pac.y) < 8) {
      if (g.mode == G_FRIGHT) {
        g.mode = G_EATEN;
        score += ghostCombo; ghostCombo *= 2; scoreDirty = true;
        restoreRect(g.x, g.y);
        playSeq(SND_GHOST, NN(SND_GHOST), 2);
      } else dead = true;
    }
  }

  restoreRect(pac.px, pac.py);
  for (int i = 0; i < 4; i++) if (ghosts[i].px != ghosts[i].x || ghosts[i].py != ghosts[i].y) restoreRect(ghosts[i].px, ghosts[i].py);
  drawActors(now);

  if (scoreDirty) {
    drawScore(); scoreDirty = false;
    if (score >= nextLife) { nextLife += 10000; if (lives < 5) lives++; drawLives(); playSeq(SND_LIFE, NN(SND_LIFE), 2); }
  }
  if (dead) { dieSequence(); return; }
  if (dotsLeft <= 0) { levelClear(); return; }
}

void tickPause() {
  if (btnPress[B_LEFT]) { state = S_MENU; drawMenu(); return; }
  if (btnPress[B_OK]) {
    uint32_t delta = millis() - pauseStart;
    frightUntil += delta; modeUntil += delta;
    for (int i = 1; i < 4; i++) ghosts[i].releaseAt += delta;
    tft.fillScreen(C_BLACK);
    drawMaze(); drawScore(); drawLives(); drawActors(millis());
    state = S_PLAY;
  }
}

void tickOver(uint32_t now) {
  if (now - overStart > 1500 && (btnPress[B_OK] || btnPress[B_RIGHT])) {
    click(); state = S_MENU; drawMenu();
  }
}

// ============================== MENU ==============================
int menuSel = 0, optSel = 0, mx = 50;

void saveSettings() {
  prefs.putBool("snd", soundOn);
  prefs.putUChar("skin", skinIdx);
  prefs.putUChar("diff", diffIdx);
}
void drawMenuItems() {
  const char* items[2] = {"JUGAR", "OPCIONES"};
  for (int i = 0; i < 2; i++) {
    int y = 88 + i * 30;
    tft.fillRect(30, y - 2, 180, 20, C_BLACK);
    char b[20];
    if (i == menuSel) snprintf(b, sizeof(b), "> %s <", items[i]); else snprintf(b, sizeof(b), "%s", items[i]);
    printC(b, y, 2, i == menuSel ? SK.text : C_WHITE);
  }
}
void menuDots() { for (int x = 64; x <= 176; x += 14) tft.fillRect(x, 194, 3, 3, SK.dot); }
void menuAnimReset() { mx = 50; tft.fillRect(36, 186, 168, 22, C_BLACK); menuDots(); }
void drawMenu() {
  tft.fillScreen(C_BLACK);
  printC("PAC-MAN", 38, 3, SK.pac);
  drawMenuItems();
  char b[24]; snprintf(b, sizeof(b), "RECORD %lu", (unsigned long)hiScore);
  printC(b, 160, 1, SK.dot);
  printC("< VOLVER AL ARCADE", 172, 1, C565(150, 150, 150));
  menuAnimReset();
}
void menuAnim() {
  const int y = 189;
  tft.fillRect(mx - 2, y, 16, 13, C_BLACK);
  tft.fillRect(mx - 30, y, 16, 13, C_BLACK);
  mx += 2;
  if (mx > 186) { menuAnimReset(); return; }
  drawGhostSprite(mx - 28, y + 1, SK.ghost[0], 1, 0, false, false, false);
  drawPacSprite(mx, y + 1, 1, 0, ((mx >> 2) & 1) ? 4 : 1, SK.pac);
}
void tickMenu() {
  if (btnPress[B_LEFT]) { click(); pacSalir = true; return; }
  if (btnPress[B_UP] || btnPress[B_DOWN]) { menuSel = 1 - menuSel; click(); drawMenuItems(); }
  if (btnPress[B_OK] || btnPress[B_RIGHT]) {
    click();
    if (menuSel == 0) startGame();
    else { state = S_OPTIONS; optSel = 0; drawOptions(); }
    return;
  }
  menuAnim();
}

// ============================== OPCIONES ==============================
void drawSkinPreview() {
  tft.fillRect(44, 176, 152, 40, C_BLACK);
  int x = 64, y = 180;
  drawPacSprite(x, y, 1, 0, 3, SK.pac);
  for (int i = 0; i < 4; i++) drawGhostSprite(x + 22 + i * 20, y, SK.ghost[i], 1, 0, false, false, false);
  tft.fillRect(60, 202, 120, 8, SK.wallFill);
  tft.drawRect(60, 202, 120, 8, SK.wallLine);
}
void drawOptRows() {
  char b[28];
  for (int i = 0; i < 4; i++) {
    int y = 62 + i * 28;
    tft.fillRect(10, y - 2, 220, 20, C_BLACK);
    switch (i) {
      case 0: snprintf(b, sizeof(b), "SONIDO: %s", soundOn ? "SI" : "NO"); break;
      case 1: snprintf(b, sizeof(b), "SKIN: %s", SK.name); break;
      case 2: snprintf(b, sizeof(b), "DIF: %s", DIFF_NAMES[diffIdx]); break;
      default: snprintf(b, sizeof(b), "VOLVER"); break;
    }
    printC(b, y, 2, i == optSel ? SK.text : C_WHITE);
    if (i == optSel) tft.fillTriangle(20, y + 1, 20, y + 15, 30, y + 8, SK.text);
  }
}
void drawOptions() {
  tft.fillScreen(C_BLACK);
  printC("OPCIONES", 24, 2, SK.pac);
  drawOptRows();
  drawSkinPreview();
}
void tickOptions() {
  if (btnPress[B_UP])   { optSel = (optSel + 3) % 4; click(); drawOptRows(); }
  if (btnPress[B_DOWN]) { optSel = (optSel + 1) % 4; click(); drawOptRows(); }
  if (optSel == 3) {
    if (btnPress[B_OK]) { click(); saveSettings(); state = S_MENU; drawMenu(); }
    return;
  }
  int d = 0;
  if (btnPress[B_LEFT]) d = -1;
  if (btnPress[B_RIGHT] || btnPress[B_OK]) d = 1;
  if (!d) return;
  if (optSel == 0) { soundOn = !soundOn; if (!soundOn) buzz(0); click(); drawOptRows(); }
  else if (optSel == 1) { skinIdx = (skinIdx + NUM_SKINS + d) % NUM_SKINS; click(); drawOptions(); }
  else if (optSel == 2) { diffIdx = (diffIdx + 3 + d) % 3; click(); drawOptRows(); }
  saveSettings();
}

// ============================== PAC-MAN COMO JUEGO DEL ARCADE ==============================
// Corre el bucle de Pac-Man hasta que el jugador sale desde su menu (IZQUIERDA)
void runPacman() {
  pacSalir = false;
  state = S_MENU;
  menuSel = 0;
  drawMenu();
  clearPresses();
  uint32_t last = 0;
  while (!pacSalir) {
    uint32_t now = millis();
    updateSound(now);
    readButtons(now);
    if (now - last < FRAME_MS) { delay(1); continue; }
    last = now;
    switch (state) {
      case S_MENU:    tickMenu();       break;
      case S_OPTIONS: tickOptions();    break;
      case S_PLAY:    tickPlay(now);    break;
      case S_PAUSE:   tickPause();      break;
      case S_OVER:    tickOver(now);    break;
    }
    clearPresses();
  }
  buzz(0);
  seqPtr = nullptr; seqPrio = 0;
}

// ============================== JUEGOS NUEVOS + MENU DEL ARCADE ==============================

// ===== inicio de juegos_comun.h =====
// =====================================================================
//  Utilidades comunes de los juegos nuevos.
//  Se incluye desde pacman_esp32s3.ino DESPUES de definir tft, botones,
//  sonido y printC (usa todo eso).
//
//  Convencion de botones en TODOS los juegos:
//     OK = pausa  (en la pausa: OK sigue, IZQUIERDA sale al menu)
// =====================================================================


Preferences prefsA;                       // records de los juegos nuevos (espacio "arcade")

const uint16_t NEGRO  = 0x0000;
const uint16_t BLANCO = 0xFFFF;

// Mezcla dos colores RGB565. t = 0 -> a, t = 255 -> b
uint16_t mezclar565(uint16_t a, uint16_t b, uint8_t t) {
  int ra = (a >> 11) & 31, ga = (a >> 5) & 63, ba = a & 31;
  int rb = (b >> 11) & 31, gb = (b >> 5) & 63, bb = b & 31;
  int r = ra + ((rb - ra) * (int)t) / 255;
  int g = ga + ((gb - ga) * (int)t) / 255;
  int bl = ba + ((bb - ba) * (int)t) / 255;
  return (uint16_t)((r << 11) | (g << 5) | bl);
}
inline uint16_t aclarar(uint16_t c)  { return mezclar565(c, 0xFFFF, 100); }
inline uint16_t oscurecer(uint16_t c) { return mezclar565(c, 0x0000, 120); }

// Espera un momento sin perder los botones ni el sonido
void esperar(uint32_t ms) {
  uint32_t t = millis();
  while (millis() - t < ms) { updateSound(millis()); delay(2); }
}

// Menu de pausa. Devuelve true si el jugador elige SALIR al menu.
// Despues de seguir, el juego tiene que redibujar toda la pantalla.
bool menuPausa(uint16_t acento) {
  buzz(0);
  tft.fillRoundRect(46, 88, 148, 66, 6, NEGRO);
  tft.drawRoundRect(46, 88, 148, 66, 6, acento);
  printC("PAUSA", 94, 2, acento);
  printC("OK: SEGUIR", 120, 1, BLANCO);
  printC("<: SALIR", 134, 1, BLANCO);
  clearPresses();
  for (;;) {
    uint32_t now = millis();
    readButtons(now);
    updateSound(now);
    if (btnPress[B_OK])   { clearPresses(); return false; }
    if (btnPress[B_LEFT]) { clearPresses(); return true; }
    clearPresses();
    delay(5);
  }
}

// Pantalla de fin de partida. Devuelve true = jugar otra vez, false = volver al menu.
bool pantallaFin(uint32_t pts, uint32_t rec, bool nuevoRec, uint16_t acento) {
  tft.fillScreen(NEGRO);
  printC("GAME OVER", 56, 2, C_RED);
  char b[32];
  snprintf(b, sizeof(b), "PUNTOS %lu", (unsigned long)pts);
  printC(b, 92, 2, BLANCO);
  if (nuevoRec) {
    printC("NUEVO RECORD!", 124, 1, acento);
  } else {
    snprintf(b, sizeof(b), "RECORD %lu", (unsigned long)rec);
    printC(b, 124, 1, acento);
  }
  printC("OK: OTRA VEZ", 158, 1, BLANCO);
  printC("<: MENU", 172, 1, BLANCO);
  playSeq(SND_OVER, NN(SND_OVER), 3);
  uint32_t t0 = millis();
  clearPresses();
  for (;;) {
    uint32_t now = millis();
    readButtons(now);
    updateSound(now);
    if (now - t0 > 900) {
      if (btnPress[B_OK])   { clearPresses(); return true; }
      if (btnPress[B_LEFT]) { clearPresses(); return false; }
    }
    clearPresses();
    delay(5);
  }
}

// Manda un lienzo (GFXcanvas16) completo a la pantalla en (x, y)
void empujarLienzo(GFXcanvas16* c, int x, int y) {
  int w = c->width(), h = c->height();
  uint16_t* buf = c->getBuffer();
  tft.startWrite();
  tft.setAddrWindow(x, y, w, h);
  for (int r = 0; r < h; r++) tft.writePixels(buf + (size_t)r * w, w);
  tft.endWrite();
}

// Dibuja un sprite de caracteres ('#' = pixel) directo en la pantalla, con fondo negro
void spriteTxt(int x, int y, const char* const* filas, int w, int h, uint16_t col) {
  static uint16_t buf[24 * 16];
  for (int j = 0; j < h; j++)
    for (int i = 0; i < w; i++) buf[j * w + i] = (filas[j][i] == '#') ? col : 0;
  tft.startWrite();
  tft.setAddrWindow(x, y, w, h);
  tft.writePixels(buf, w * h);
  tft.endWrite();
}

// Pregunta si se puede reservar memoria para un lienzo; muestra aviso si no
GFXcanvas16* crearLienzo(int w, int h) {
  GFXcanvas16* c = new GFXcanvas16(w, h);
  if (c && c->getBuffer()) return c;
  if (c) delete c;
  tft.fillScreen(NEGRO);
  printC("SIN MEMORIA", 110, 2, C_RED);
  waitMs(1500);
  return nullptr;
}


// ---------------------------------------------------------------------
//  SKIN y DIFICULTAD globales para los juegos nuevos
//  (los ajustes se cambian en el menu OPCIONES de cualquier juego y se guardan)
// ---------------------------------------------------------------------
// Aplica la skin elegida (skinIdx) a un color: CLASSIC lo deja igual; las demas lo re-tiñen
uint16_t skinTinte(uint16_t c) {
  if (skinIdx == 0) return c;
  int r = ((c >> 11) & 31) << 3, g = ((c >> 5) & 63) << 2, b = (c & 31) << 3;
  int l = (r * 30 + g * 59 + b * 11) / 100;            // luminosidad 0..255
  switch (skinIdx) {
    case 1:                                            // NEON: mas saturado y vivo
      r = l + (r - l) * 5 / 3; g = l + (g - l) * 5 / 3; b = l + (b - l) * 5 / 3; break;
    case 2:                                            // RETRO: fosforo verde
      r = l / 6; g = l; b = l / 6; break;
    case 3: {                                          // FUEGO: rojo -> naranja -> amarillo
      int a = l * l / 255;
      r = l * 5 / 4; g = a * 4 / 5; b = a * a / 900; break; }
    default:                                           // ARDUINO: negro -> teal -> blanco
      if (l < 150) { r = 0; g = 151 * l / 150; b = 157 * l / 150; }
      else { int t = (l - 150) * 255 / 105; r = t; g = 151 + (255 - 151) * t / 255; b = 157 + (255 - 157) * t / 255; }
      break;
  }
  if (r < 0) r = 0; if (r > 255) r = 255;
  if (g < 0) g = 0; if (g > 255) g = 255;
  if (b < 0) b = 0; if (b > 255) b = 255;
  return C565(r, g, b);
}
const uint8_t DIF_PCT[3] = {135, 100, 75};            // tiempo entre pasos (%): FACIL mas lento, DIFICIL mas rapido
const float   DIF_VEL[3] = {0.85f, 1.0f, 1.2f};       // multiplicador de velocidad del dino

// ---------------------------------------------------------------------
//  MENU DE ENTRADA DE CADA JUEGO (igual que el de Pac-Man: JUGAR / OPCIONES)
//  IZQUIERDA vuelve al arcade.  OPCIONES: SONIDO, SKIN, DIF, VOLVER
// ---------------------------------------------------------------------
static void mjItems(int sel, uint16_t ac) {
  const char* items[2] = {"JUGAR", "OPCIONES"};
  for (int i = 0; i < 2; i++) {
    int y = 88 + i * 30;
    tft.fillRect(30, y - 2, 180, 20, NEGRO);
    char b[20];
    if (i == sel) snprintf(b, sizeof(b), "> %s <", items[i]); else snprintf(b, sizeof(b), "%s", items[i]);
    printC(b, y, 2, i == sel ? ac : BLANCO);
  }
}
static void mjPantalla(const char* titulo, uint16_t ac, uint32_t rec, int sel) {
  tft.fillScreen(NEGRO);
  printC(titulo, 38, 3, ac);
  mjItems(sel, ac);
  char b[24]; snprintf(b, sizeof(b), "RECORD %lu", (unsigned long)rec);
  printC(b, 160, 1, mezclar565(ac, 0xFFFF, 90));
  printC("< VOLVER AL ARCADE", 172, 1, C565(150, 150, 150));
}
static void mjDino(int x, int y, uint16_t c) {         // dinosaurio mini de 12x11
  tft.fillRect(x + 3, y + 3, 7, 5, c);
  tft.fillRect(x + 6, y, 6, 4, c);
  tft.fillRect(x, y + 5, 4, 2, c);
  tft.fillRect(x + 4, y + 8, 2, 3, c);
  tft.fillRect(x + 8, y + 8, 2, 3, c);
  tft.drawPixel(x + 10, y + 1, NEGRO);
}
// Animacion de la franja inferior (como el Pac-Man persiguiendo al fantasma)
static void mjAnim(uint8_t anim, int fr, uint16_t ac) {
  const int y = 189;
  if (anim == 0) {                                     // TETRIS: bloques que cambian de color
    if (fr % 4) return;
    static const uint16_t pal[7] = {C565(0,230,240), C565(250,230,0), C565(180,60,240), C565(40,220,60), C565(240,40,40), C565(50,90,255), C565(255,150,0)};
    for (int i = 0; i < 8; i++) {
      uint16_t c = skinTinte(pal[(i + fr / 4) % 7]);
      tft.fillRect(60 + i * 15, y + 2, 11, 11, c);
      tft.drawFastHLine(60 + i * 15, y + 2, 11, aclarar(c));
    }
  } else if (anim == 1) {                              // INVADERS: un invasor cruzando
    static int x = 50;
    static const char* const S[2][8] = {
      {"...##...", "..####..", ".######.", "##.##.##", "########", "..#..#..", ".#.##.#.", "#.#..#.#"},
      {"...##...", "..####..", ".######.", "##.##.##", "########", ".#.##.#.", "#......#", ".#....#."}};
    tft.fillRect(x - 2, y, 14, 12, NEGRO);
    x += 2; if (x > 176) x = 50;
    spriteTxt(x, y + 2, S[(x >> 3) & 1], 8, 8, ac);
  } else {                                             // DINO: salta un cactus
    static int cx = 186;
    const int dx0 = 70, suelo = 203;
    tft.fillRect(48, y - 10, 146, 28, NEGRO);
    cx -= 3; if (cx < 52) cx = 186;
    int d = cx - (dx0 + 12), salto = 0;
    if (d > -4 && d < 30) salto = (int)(sinf((30 - d) / 34.0f * 3.14159f) * 14);
    tft.drawFastHLine(52, suelo, 136, C565(110, 110, 110));
    mjDino(dx0, suelo - 11 - salto, ac);
    tft.fillRect(cx, suelo - 12, 4, 12, ac);
    tft.fillRect(cx - 3, suelo - 9, 3, 2, ac);
    tft.fillRect(cx + 4, suelo - 8, 3, 2, ac);
  }
}
static void mjFilas(int sel, uint16_t ac) {
  char b[28];
  for (int i = 0; i < 4; i++) {
    int y = 62 + i * 28;
    tft.fillRect(10, y - 2, 220, 20, NEGRO);
    switch (i) {
      case 0: snprintf(b, sizeof(b), "SONIDO: %s", soundOn ? "SI" : "NO"); break;
      case 1: snprintf(b, sizeof(b), "SKIN: %s", SK.name); break;
      case 2: snprintf(b, sizeof(b), "DIF: %s", DIFF_NAMES[diffIdx]); break;
      default: snprintf(b, sizeof(b), "VOLVER"); break;
    }
    printC(b, y, 2, i == sel ? ac : BLANCO);
    if (i == sel) tft.fillTriangle(20, y + 1, 20, y + 15, 30, y + 8, ac);
  }
}
static void mjOpcionesPantalla(int sel, uint16_t ac) {
  tft.fillScreen(NEGRO);
  printC("OPCIONES", 24, 2, ac);
  mjFilas(sel, ac);
  drawSkinPreview();
}
static void mjOpciones(uint16_t acento0) {
  int sel = 0;
  mjOpcionesPantalla(sel, skinTinte(acento0));
  clearPresses();
  uint32_t last = 0;
  for (;;) {
    uint32_t now = millis();
    updateSound(now);
    readButtons(now);
    if (now - last < FRAME_MS) { delay(1); continue; }
    last = now;
    uint16_t ac = skinTinte(acento0);
    if (btnPress[B_UP])   { sel = (sel + 3) % 4; click(); mjFilas(sel, ac); }
    if (btnPress[B_DOWN]) { sel = (sel + 1) % 4; click(); mjFilas(sel, ac); }
    if (sel == 3) {
      if (btnPress[B_OK]) { click(); saveSettings(); clearPresses(); return; }
    } else {
      int d = 0;
      if (btnPress[B_LEFT]) d = -1;
      if (btnPress[B_RIGHT] || btnPress[B_OK]) d = 1;
      if (d) {
        if (sel == 0)      { soundOn = !soundOn; if (!soundOn) buzz(0); click(); mjFilas(sel, ac); }
        else if (sel == 1) { skinIdx = (skinIdx + NUM_SKINS + d) % NUM_SKINS; click(); mjOpcionesPantalla(sel, skinTinte(acento0)); }
        else               { diffIdx = (diffIdx + 3 + d) % 3; click(); mjFilas(sel, ac); }
        saveSettings();
      }
    }
    clearPresses();
  }
}
// Devuelve true = JUGAR, false = volver al arcade. acento0 = color original del juego (la skin lo tiñe aqui)
// anim: 0 tetris, 1 invaders, 2 dino
bool menuJuego(const char* titulo, uint16_t acento0, uint32_t rec, uint8_t anim) {
  int sel = 0, fr = 0;
  mjPantalla(titulo, skinTinte(acento0), rec, sel);
  clearPresses();
  uint32_t last = 0;
  for (;;) {
    uint32_t now = millis();
    updateSound(now);
    readButtons(now);
    if (now - last < FRAME_MS) { delay(1); continue; }
    last = now; fr++;
    uint16_t ac = skinTinte(acento0);
    if (btnPress[B_LEFT]) { click(); clearPresses(); return false; }
    if (btnPress[B_UP] || btnPress[B_DOWN]) { sel = 1 - sel; click(); mjItems(sel, ac); }
    if (btnPress[B_OK] || btnPress[B_RIGHT]) {
      click();
      if (sel == 0) { clearPresses(); return true; }
      mjOpciones(acento0);
      mjPantalla(titulo, skinTinte(acento0), rec, sel);
      clearPresses();
      continue;
    }
    mjAnim(anim, fr, ac);
    clearPresses();
  }
}

// ===== fin de juegos_comun.h =====


// ===== inicio de tetris.h =====
// =====================================================================
//  TETRIS  (tablero 10x20, celdas de 10 px, cabe justo en la pantalla redonda)
//  Controles: IZQ/DER mover, ARRIBA girar, ABAJO bajar rapido, OK pausa
// =====================================================================


namespace tet {

const int BX = 70, BY = 20, CELDA = 10, BW = 10, BH = 20;

// Cada pieza son 4 giros, cada giro un mapa de 4x4 bits (bit 15 = esquina superior izquierda)
const uint16_t PIEZAS[7][4] = {
  {0x0F00, 0x2222, 0x00F0, 0x4444},   // I
  {0x6600, 0x6600, 0x6600, 0x6600},   // O
  {0x4E00, 0x4C40, 0x0E40, 0x4640},   // T
  {0x6C00, 0x4620, 0x06C0, 0x8C40},   // S
  {0xC600, 0x2640, 0x0C60, 0x4C80},   // Z
  {0x8E00, 0x6440, 0x0E20, 0x44C0},   // J
  {0x2E00, 0x4460, 0x0E80, 0xC440},   // L
};
// colores por tipo (indice = tipo + 1; 0 = vacio)
const uint16_t COLORES0[8] = {
  0,
  C565(0, 230, 240),     // I cian
  C565(250, 230, 0),     // O amarillo
  C565(180, 60, 240),    // T morado
  C565(40, 220, 60),     // S verde
  C565(240, 40, 40),     // Z rojo
  C565(50, 90, 255),     // J azul
  C565(255, 150, 0),     // L naranja
};
const uint16_t FONDO0   = C565(0, 0, 20);
const uint16_t REJILLA0 = C565(18, 18, 52);
const uint16_t MARCO0   = C565(120, 120, 200);
const uint16_t ACENTO0  = C565(0, 230, 240);
// colores en uso (originales + skin elegida)
uint16_t COLORES[8], FONDO, REJILLA, MARCO, ACENTO;
void aplicarSkin() {
  for (int i = 0; i < 8; i++) COLORES[i] = i ? skinTinte(COLORES0[i]) : 0;
  FONDO = skinTinte(FONDO0); REJILLA = skinTinte(REJILLA0); MARCO = skinTinte(MARCO0); ACENTO = skinTinte(ACENTO0);
}

uint16_t claro[8], oscuro[8];
uint8_t  tablero[BH][BW];
uint8_t  mostrado[BH][BW];          // lo que hay dibujado ahora (255 = obligar a redibujar)
int      pt, prot, px, py, sig;     // pieza actual (tipo, giro, posicion) y la siguiente
uint8_t  bolsa[7];
int      bolsaIdx;
uint32_t puntos, record;
int      lineas, nivel;
uint32_t pPuntos, pLineas, pNivel;  // ultimo valor dibujado en el panel

const Note SND_MOVER[]  = {{900, 12}};
const Note SND_GIRAR[]  = {{1300, 18}};
const Note SND_CAER[]   = {{300, 35}};
const Note SND_LINEA[]  = {{660, 70}, {880, 70}, {1100, 90}};
const Note SND_TETRIS[] = {{523, 70}, {659, 70}, {784, 70}, {1047, 200}};
const Note SND_NIVEL[]  = {{784, 80}, {988, 80}, {1319, 160}};

// ---------------------------------------------------------------- piezas
bool choca(int t, int r, int x, int y) {
  uint16_t m = PIEZAS[t][r & 3];
  for (int i = 0; i < 16; i++) {
    if (!(m & (0x8000 >> i))) continue;
    int cx = x + (i & 3), cy = y + (i >> 2);
    if (cx < 0 || cx >= BW || cy >= BH) return true;
    if (cy >= 0 && tablero[cy][cx]) return true;
  }
  return false;
}

int piezaDeLaBolsa() {
  if (bolsaIdx >= 7) {
    for (int i = 0; i < 7; i++) bolsa[i] = i;
    for (int i = 6; i > 0; i--) { int j = random(i + 1); uint8_t t = bolsa[i]; bolsa[i] = bolsa[j]; bolsa[j] = t; }
    bolsaIdx = 0;
  }
  return bolsa[bolsaIdx++];
}

// ---------------------------------------------------------------- dibujo
void dibujarCelda(int c, int r, uint8_t v) {
  int x = BX + c * CELDA, y = BY + r * CELDA;
  if (v == 0) {
    tft.fillRect(x, y, CELDA, CELDA, FONDO);
    tft.drawRect(x, y, CELDA, CELDA, REJILLA);
  } else if (v >= 16) {                       // sombra de donde va a caer
    uint8_t k = v - 16;
    tft.fillRect(x, y, CELDA, CELDA, FONDO);
    tft.drawRect(x, y, CELDA, CELDA, oscuro[k]);
    tft.drawRect(x + 1, y + 1, CELDA - 2, CELDA - 2, REJILLA);
  } else {
    tft.fillRect(x, y, CELDA, CELDA, COLORES[v]);
    tft.drawFastHLine(x, y, CELDA, claro[v]);
    tft.drawFastVLine(x, y, CELDA, claro[v]);
    tft.drawFastHLine(x, y + CELDA - 1, CELDA, oscuro[v]);
    tft.drawFastVLine(x + CELDA - 1, y, CELDA, oscuro[v]);
    tft.fillRect(x + 3, y + 3, 3, 3, claro[v]);
  }
}

// Compone tablero + sombra + pieza actual y redibuja solo las celdas que cambiaron
void refrescar(bool conPieza = true) {
  uint8_t out[BH][BW];
  memcpy(out, tablero, sizeof(out));
  if (conPieza) {
    int gy = py;
    while (!choca(pt, prot, px, gy + 1)) gy++;
    uint16_t m = PIEZAS[pt][prot & 3];
    for (int i = 0; i < 16; i++) {
      if (!(m & (0x8000 >> i))) continue;
      int cx = px + (i & 3), cy = gy + (i >> 2);
      if (cy >= 0 && cy < BH && cx >= 0 && cx < BW && out[cy][cx] == 0) out[cy][cx] = 16 + pt + 1;
    }
    for (int i = 0; i < 16; i++) {
      if (!(m & (0x8000 >> i))) continue;
      int cx = px + (i & 3), cy = py + (i >> 2);
      if (cy >= 0 && cy < BH && cx >= 0 && cx < BW) out[cy][cx] = pt + 1;
    }
  }
  for (int r = 0; r < BH; r++)
    for (int c = 0; c < BW; c++)
      if (out[r][c] != mostrado[r][c]) { dibujarCelda(c, r, out[r][c]); mostrado[r][c] = out[r][c]; }
}

void dibujarSiguiente() {
  tft.fillRect(176, 72, 40, 40, FONDO);
  tft.drawRect(176, 72, 40, 40, MARCO);
  uint16_t m = PIEZAS[sig][0];
  int minC = 4, maxC = -1, minR = 4, maxR = -1;
  for (int i = 0; i < 16; i++) if (m & (0x8000 >> i)) {
    int c = i & 3, r = i >> 2;
    if (c < minC) minC = c; if (c > maxC) maxC = c;
    if (r < minR) minR = r; if (r > maxR) maxR = r;
  }
  int w = (maxC - minC + 1) * 8, h = (maxR - minR + 1) * 8;
  int ox = 176 + (40 - w) / 2, oy = 72 + (40 - h) / 2;
  for (int i = 0; i < 16; i++) if (m & (0x8000 >> i)) {
    int x = ox + ((i & 3) - minC) * 8, y = oy + ((i >> 2) - minR) * 8;
    tft.fillRect(x, y, 8, 8, COLORES[sig + 1]);
    tft.drawFastHLine(x, y, 8, claro[sig + 1]);
    tft.drawFastVLine(x, y, 8, claro[sig + 1]);
    tft.drawFastHLine(x, y + 7, 8, oscuro[sig + 1]);
    tft.drawFastVLine(x + 7, y, 8, oscuro[sig + 1]);
  }
}

void valorPanel(int x, int y, uint32_t v, uint16_t col) {
  char b[12];
  snprintf(b, sizeof(b), "%lu", (unsigned long)v);
  tft.fillRect(x, y, 42, 8, NEGRO);
  tft.setTextSize(1); tft.setTextColor(col);
  tft.setCursor(x, y); tft.print(b);
}
void etiqueta(int x, int y, const char* s) {
  tft.setTextSize(1); tft.setTextColor(C565(140, 140, 200));
  tft.setCursor(x, y); tft.print(s);
}

void panel(bool todo) {
  if (todo) {
    etiqueta(22, 58, "PUNTOS");  etiqueta(22, 92, "LINEAS");
    etiqueta(22, 126, "NIVEL");  etiqueta(22, 160, "RECORD");
    etiqueta(180, 58, "NEXT");
    valorPanel(22, 170, record, C565(255, 200, 60));
    pPuntos = pLineas = pNivel = 0xFFFFFFFF;
  }
  if (pPuntos != puntos) { valorPanel(22, 68, puntos, BLANCO);  pPuntos = puntos; }
  if (pLineas != (uint32_t)lineas) { valorPanel(22, 102, lineas, BLANCO); pLineas = lineas; }
  if (pNivel != (uint32_t)nivel) { valorPanel(22, 136, nivel, ACENTO); pNivel = nivel; }
}

void dibujarTodo() {
  tft.fillScreen(NEGRO);
  tft.drawRect(BX - 2, BY - 2, BW * CELDA + 4, BH * CELDA + 4, MARCO);
  tft.drawRect(BX - 1, BY - 1, BW * CELDA + 2, BH * CELDA + 2, C565(50, 50, 110));
  memset(mostrado, 255, sizeof(mostrado));
  panel(true);
  dibujarSiguiente();
  refrescar();
}

// ---------------------------------------------------------------- juego
uint32_t intervaloCaida() {
  int ms = (760 - (nivel - 1) * 62) * DIF_PCT[diffIdx] / 100;
  return ms < 55 ? 55 : ms;
}

void nuevaPieza() {
  pt = sig; prot = 0; px = 3; py = 0;
  sig = piezaDeLaBolsa();
  dibujarSiguiente();
}

bool mover(int dx, int dy) {
  if (choca(pt, prot, px + dx, py + dy)) return false;
  px += dx; py += dy;
  return true;
}

void girar() {
  int nr = (prot + 1) & 3;
  const int kicks[5] = {0, -1, 1, -2, 2};
  for (int k = 0; k < 5; k++) {
    if (!choca(pt, nr, px + kicks[k], py)) {
      px += kicks[k]; prot = nr;
      playSeq(SND_GIRAR, NN(SND_GIRAR), 1);
      return;
    }
  }
}

// Fija la pieza, borra lineas completas. Devuelve false si ya no cabe la siguiente (fin).
bool fijarPieza() {
  uint16_t m = PIEZAS[pt][prot & 3];
  for (int i = 0; i < 16; i++) if (m & (0x8000 >> i)) {
    int cx = px + (i & 3), cy = py + (i >> 2);
    if (cy >= 0 && cy < BH && cx >= 0 && cx < BW) tablero[cy][cx] = pt + 1;
  }
  playSeq(SND_CAER, NN(SND_CAER), 1);
  refrescar(false);

  int llenas[4], n = 0;
  for (int r = 0; r < BH && n < 4; r++) {
    bool full = true;
    for (int c = 0; c < BW; c++) if (!tablero[r][c]) { full = false; break; }
    if (full) llenas[n++] = r;
  }
  if (n > 0) {
    playSeq(n == 4 ? SND_TETRIS : SND_LINEA, n == 4 ? NN(SND_TETRIS) : NN(SND_LINEA), 2);
    for (int f = 0; f < 4; f++) {                        // parpadeo blanco
      for (int k = 0; k < n; k++)
        for (int c = 0; c < BW; c++) {
          int x = BX + c * CELDA, y = BY + llenas[k] * CELDA;
          tft.fillRect(x, y, CELDA, CELDA, (f & 1) ? COLORES[tablero[llenas[k]][c]] : BLANCO);
        }
      waitMs(70);
    }
    for (int k = 0; k < n; k++) {                        // bajar lo de arriba
      for (int r = llenas[k]; r > 0; r--) memcpy(tablero[r], tablero[r - 1], BW);
      memset(tablero[0], 0, BW);
    }
    memset(mostrado, 255, sizeof(mostrado));
    const uint16_t pts[5] = {0, 100, 300, 500, 800};
    puntos += pts[n] * nivel;
    lineas += n;
    int nuevoNivel = 1 + lineas / 10;
    if (nuevoNivel > nivel) { nivel = nuevoNivel; playSeq(SND_NIVEL, NN(SND_NIVEL), 3); }
  }
  nuevaPieza();
  panel(false);
  return !choca(pt, prot, px, py);
}

// Una partida. Devuelve true si termino perdiendo, false si salio desde la pausa.
bool partida() {
  memset(tablero, 0, sizeof(tablero));
  puntos = 0; lineas = 0; nivel = 1; bolsaIdx = 7;
  randomSeed(micros());
  sig = piezaDeLaBolsa();
  nuevaPieza();
  dibujarTodo();
  clearPresses();

  uint32_t tCaida = millis() + 600, tAbajo = 0, repetir[2] = {0, 0}, ultimo = 0;
  for (;;) {
    uint32_t now = millis();
    updateSound(now);
    readButtons(now);
    if (now - ultimo < FRAME_MS) { delay(1); continue; }
    ultimo = now;

    if (btnPress[B_OK]) {
      clearPresses();
      if (menuPausa(ACENTO)) return false;
      dibujarTodo();
      tCaida = millis() + 400;
      continue;
    }
    // izquierda / derecha con repeticion al mantener
    for (int d = 0; d < 2; d++) {
      int b = d == 0 ? B_LEFT : B_RIGHT, dx = d == 0 ? -1 : 1;
      if (btnPress[b]) { if (mover(dx, 0)) playSeq(SND_MOVER, 1, 0); repetir[d] = now + 170; }
      else if (btnHeld[b] && now >= repetir[d]) { if (mover(dx, 0)) playSeq(SND_MOVER, 1, 0); repetir[d] = now + 55; }
    }
    if (btnPress[B_UP]) girar();

    bool bajo = false;
    if (btnHeld[B_DOWN] && now >= tAbajo) {
      tAbajo = now + 32;
      if (mover(0, 1)) { puntos++; tCaida = now + intervaloCaida(); }
      else bajo = true;
    }
    if (now >= tCaida) {
      tCaida = now + intervaloCaida();
      if (!mover(0, 1)) bajo = true;
    }
    if (bajo) {
      if (!fijarPieza()) return true;
      tCaida = millis() + intervaloCaida();
      tAbajo = millis() + 150;
    }
    refrescar();
    panel(false);
    clearPresses();
  }
}

// Punto de entrada desde el arcade: menu del juego -> partidas -> menu del juego ...
void jugar() {
  for (;;) {
    record = prefsA.getUInt("hiTet", 0);
    if (!menuJuego("TETRIS", ACENTO0, record, 0)) return;
    aplicarSkin();
    for (int i = 1; i < 8; i++) { claro[i] = aclarar(COLORES[i]); oscuro[i] = oscurecer(COLORES[i]); }
    for (;;) {
      bool perdio = partida();
      if (!perdio) break;
      // la pila sube hasta arriba
      for (int r = BH - 1; r >= 0; r--) {
        for (int c = 0; c < BW; c++) {
          int x = BX + c * CELDA, y = BY + r * CELDA;
          tft.fillRect(x, y, CELDA, CELDA, skinTinte(C565(90, 90, 100)));
          tft.drawRect(x, y, CELDA, CELDA, skinTinte(C565(40, 40, 50)));
        }
        delay(18);
      }
      bool nuevo = puntos > record;
      if (nuevo) { record = puntos; prefsA.putUInt("hiTet", record); }
      if (!pantallaFin(puntos, record, nuevo, ACENTO)) break;
    }
  }
}

}  // namespace tet

// ===== fin de tetris.h =====


// ===== inicio de invaders.h =====
// =====================================================================
//  SPACE INVADERS
//  Controles: IZQ/DER mover, ARRIBA (o mantener) disparar, OK pausa
// =====================================================================


namespace inv {

// ---------------------------------------------------------------- sprites (# = pixel)
const char* const SQUID_A[8] = {"...##...", "..####..", ".######.", "##.##.##", "########", "..#..#..", ".#.##.#.", "#.#..#.#"};
const char* const SQUID_B[8] = {"...##...", "..####..", ".######.", "##.##.##", "########", ".#.##.#.", "#......#", ".#....#."};
const char* const CRAB_A[8]  = {"..#.....#..", "...#...#...", "..#######..", ".##.###.##.", "###########", "#.#######.#", "#.#.....#.#", "...##.##..."};
const char* const CRAB_B[8]  = {"..#.....#..", "#..#...#..#", "#.#######.#", "###.###.###", "###########", ".#########.", "..#.....#..", ".#.......#."};
const char* const OCTO_A[8]  = {"....####....", ".##########.", "############", "###..##..###", "############", "...##..##...", "..##.##.##..", "##........##"};
const char* const OCTO_B[8]  = {"....####....", ".##########.", "############", "###..##..###", "############", "..###..###..", ".##..##..##.", "..##....##.."};
const char* const NAVE[8]    = {"......#......", ".....###.....", ".....###.....", ".###########.", "#############", "#############", "#############", "#############"};
const char* const UFO[7]     = {".....######.....", "...##########...", "..############..", ".##.##.##.##.##.", "################", "..###..##..###..", "...#........#..."};
const char* const BOOM[8]    = {"#...#..#...#", ".#..#..#..#.", "..#.....#...", "#..#####..#.", "...#####....", "..#.....#...", ".#..#..#..#.", "#...#..#...#"};
const char* const BOOMN[8]   = {"..#..#..#.#.", ".#.#.##.#.#.", "#.#.####.#.#", ".#.######.#.", "#.#.####.#.#", ".#.#.##.#.#.", "#..#.##.#..#", ".#.#.#..#.#."};

const int ANCHO_CEL = 20, ALTO_CEL = 16, FILAS = 4, COLUMNAS = 6;
const int XMIN = 28, XMAX = 212;           // limites de la formacion
const int Y_NAVE = 198, Y_ESC = 160, Y_UFO = 40, Y_SUELO = 210;
const int ESC_N = 3, ESC_W = 11, ESC_H = 6;  // 3 escudos, 11x6 celdas de 2x2 px

const uint16_t C_FILA0[FILAS] = {C565(255, 80, 255), C565(0, 240, 255), C565(0, 240, 255), C565(120, 255, 60)};
const uint16_t C_NAVE0  = C565(60, 255, 90);
const uint16_t C_ESC0   = C565(60, 220, 60);
const uint16_t C_UFO0   = C565(255, 50, 80);
const uint16_t C_DISP   = C565(255, 255, 255);
const uint16_t C_BALA0  = C565(255, 220, 60);
const uint16_t ACENTO0  = C565(60, 255, 90);
// colores en uso (originales + skin elegida)
uint16_t C_FILA[FILAS], C_NAVE, C_ESC, C_UFO, C_BALA, ACENTO;
void aplicarSkin() {
  for (int i = 0; i < FILAS; i++) C_FILA[i] = skinTinte(C_FILA0[i]);
  C_NAVE = skinTinte(C_NAVE0); C_ESC = skinTinte(C_ESC0); C_UFO = skinTinte(C_UFO0);
  C_BALA = skinTinte(C_BALA0); ACENTO = skinTinte(ACENTO0);
}

const char* const FORMA_ESC[ESC_H] = {".#########.", "###########", "###########", "###########", "####...####", "###.....###"};

struct Bala { int16_t x, y; bool on; uint8_t tipo; };

bool     vivo[FILAS][COLUMNAS];
uint8_t  escudo[ESC_N][ESC_H][ESC_W];
int      ox, oy, dir, frameAnim, vivos;
uint32_t tPaso, tUfo, tExplosion, ufoMsgHasta;
int      expX, expY; bool expOn;
int      nx;                                   // posicion de la nave (centro)
Bala     bn;                                   // bala de la nave
Bala     bi[4];                                // balas de los invasores
int      maxBalasI;
float    ufoX; int ufoDir; bool ufoOn;
uint32_t puntos, record, proxVida; int vidas, nivel, pasoSnd;
uint32_t pPuntos; int pVidas;

const Note SND_DISPARO[] = {{1800, 15}, {1200, 15}};
const Note SND_MATAR[]   = {{500, 25}, {300, 25}, {150, 40}};
const Note SND_GOLPE[]   = {{300, 60}, {200, 60}, {120, 80}, {80, 120}, {60, 120}};
const Note SND_UFO[]     = {{900, 30}, {1300, 30}, {900, 30}, {1300, 30}};
const Note SND_PASO[4][1] = {{{180, 28}}, {{160, 28}}, {{140, 28}}, {{120, 28}}};
const Note SND_SUBE[]    = {{523, 80}, {659, 80}, {784, 80}, {1047, 160}};

// ---------------------------------------------------------------- utilidades
int anchoTipo(int fila) { return fila == 0 ? 8 : (fila < 3 ? 11 : 12); }

const char* const* spriteInvasor(int fila, int frame) {
  if (fila == 0) return frame ? SQUID_B : SQUID_A;
  if (fila < 3)  return frame ? CRAB_B : CRAB_A;
  return frame ? OCTO_B : OCTO_A;
}
int posX(int c, int fila) { return ox + c * ANCHO_CEL + (14 - anchoTipo(fila)) / 2; }
int posY(int f) { return oy + f * ALTO_CEL; }
int escX(int s) { return 120 - (ESC_N * 22 + (ESC_N - 1) * 36) / 2 + s * 58; }

void dibujarInvasor(int c, int f) {
  spriteTxt(posX(c, f), posY(f), spriteInvasor(f, frameAnim), anchoTipo(f), 8, C_FILA[f]);
}
void borrarInvasor(int c, int f) { tft.fillRect(posX(c, f), posY(f), anchoTipo(f), 8, NEGRO); }

void dibujarCeldaEsc(int s, int cx, int cy) {
  int x = escX(s) + cx * 2, y = Y_ESC + cy * 2;
  tft.fillRect(x, y, 2, 2, escudo[s][cy][cx] ? C_ESC : NEGRO);
}
void dibujarEscudos() {
  for (int s = 0; s < ESC_N; s++)
    for (int r = 0; r < ESC_H; r++)
      for (int c = 0; c < ESC_W; c++) if (escudo[s][r][c]) dibujarCeldaEsc(s, c, r);
}
void reiniciarEscudos() {
  for (int s = 0; s < ESC_N; s++)
    for (int r = 0; r < ESC_H; r++)
      for (int c = 0; c < ESC_W; c++) escudo[s][r][c] = (FORMA_ESC[r][c] == '#');
}

// Si el punto (x,y) toca un escudo, lo daña y devuelve true
bool golpeEscudo(int x, int y) {
  for (int s = 0; s < ESC_N; s++) {
    int ex = escX(s);
    if (x < ex || x >= ex + ESC_W * 2 || y < Y_ESC || y >= Y_ESC + ESC_H * 2) continue;
    int cx = (x - ex) / 2, cy = (y - Y_ESC) / 2;
    if (!escudo[s][cy][cx]) continue;
    escudo[s][cy][cx] = 0; dibujarCeldaEsc(s, cx, cy);
    for (int k = 0; k < 2; k++) {                     // desmorona un poco alrededor
      int nxc = cx + (int)random(3) - 1, nyc = cy + (int)random(3) - 1;
      if (nxc >= 0 && nxc < ESC_W && nyc >= 0 && nyc < ESC_H && escudo[s][nyc][nxc]) {
        escudo[s][nyc][nxc] = 0; dibujarCeldaEsc(s, nxc, nyc);
      }
    }
    return true;
  }
  return false;
}

// Borra un rectangulo (bala) y repinta las celdas de escudo que tocaba
void borrarRect(int x, int y, int w, int h) {
  tft.fillRect(x, y, w, h, NEGRO);
  if (y + h <= Y_ESC || y >= Y_ESC + ESC_H * 2) return;
  for (int s = 0; s < ESC_N; s++) {
    int ex = escX(s);
    if (x + w <= ex || x >= ex + ESC_W * 2) continue;
    for (int cy = 0; cy < ESC_H; cy++) for (int cx = 0; cx < ESC_W; cx++) {
      int px = ex + cx * 2, py = Y_ESC + cy * 2;
      if (escudo[s][cy][cx] && px + 2 > x && px < x + w && py + 2 > y && py < y + h) dibujarCeldaEsc(s, cx, cy);
    }
  }
}

// Los invasores que bajan comen los escudos
void comerEscudos() {
  for (int f = 0; f < FILAS; f++) for (int c = 0; c < COLUMNAS; c++) {
    if (!vivo[f][c]) continue;
    int y0 = posY(f), y1 = y0 + 8;
    if (y1 < Y_ESC || y0 >= Y_ESC + ESC_H * 2) continue;
    int x0 = posX(c, f), x1 = x0 + anchoTipo(f);
    for (int s = 0; s < ESC_N; s++) {
      int ex = escX(s);
      if (x1 < ex || x0 >= ex + ESC_W * 2) continue;
      for (int cy = 0; cy < ESC_H; cy++) for (int cx = 0; cx < ESC_W; cx++) {
        int px = ex + cx * 2, py = Y_ESC + cy * 2;
        if (escudo[s][cy][cx] && px + 2 > x0 && px < x1 && py + 2 > y0 && py < y1) {
          escudo[s][cy][cx] = 0; dibujarCeldaEsc(s, cx, cy);
        }
      }
    }
  }
}

void dibujarHUD(bool todo) {
  if (todo || pPuntos != puntos) {
    char b[40]; snprintf(b, sizeof(b), "PUNTOS %05lu  NIV %d", (unsigned long)puntos, nivel);
    tft.fillRect(40, 24, 160, 10, NEGRO);
    printC(b, 26, 1, BLANCO);
    pPuntos = puntos;
  }
  if (todo || pVidas != vidas) {
    tft.fillRect(80, 218, 80, 12, NEGRO);
    for (int i = 0; i < vidas && i < 5; i++) {
      int x = 86 + i * 15;
      tft.fillRect(x + 4, 219, 3, 2, C_NAVE);
      tft.fillRect(x + 1, 221, 9, 3, C_NAVE);
      tft.fillRect(x, 224, 11, 3, C_NAVE);
    }
    pVidas = vidas;
  }
}

void contarVivos() {
  vivos = 0;
  for (int f = 0; f < FILAS; f++) for (int c = 0; c < COLUMNAS; c++) if (vivo[f][c]) vivos++;
}

void nuevaOleada() {
  for (int f = 0; f < FILAS; f++) for (int c = 0; c < COLUMNAS; c++) vivo[f][c] = true;
  contarVivos();
  int bajada = (nivel - 1) * 8; if (bajada > 32) bajada = 32;
  ox = 63; oy = 56 + bajada; dir = 1; frameAnim = 0;
  maxBalasI = 2 + nivel / 3; if (maxBalasI > 4) maxBalasI = 4;
  for (int i = 0; i < 4; i++) bi[i].on = false;
  bn.on = false;
  reiniciarEscudos();
  tPaso = millis() + 500;
  tUfo = millis() + 9000 + random(8000);
  ufoOn = false;
}

void dibujarEscenario() {
  tft.fillScreen(NEGRO);
  tft.drawFastHLine(30, Y_SUELO, 180, C565(40, 160, 60));
  dibujarEscudos();
  for (int f = 0; f < FILAS; f++) for (int c = 0; c < COLUMNAS; c++) if (vivo[f][c]) dibujarInvasor(c, f);
  spriteTxt(nx - 6, Y_NAVE, NAVE, 13, 8, C_NAVE);
  dibujarHUD(true);
}

// ---------------------------------------------------------------- bucle de juego
void pasoInvasores(uint32_t now) {
  int minC = COLUMNAS, maxC = -1;
  for (int f = 0; f < FILAS; f++) for (int c = 0; c < COLUMNAS; c++) if (vivo[f][c]) {
    if (c < minC) minC = c;
    if (c > maxC) maxC = c;
  }
  if (maxC < 0) return;
  int izq = ox + minC * ANCHO_CEL, der = ox + maxC * ANCHO_CEL + 14;
  bool baja = (dir > 0 && der + 4 > XMAX) || (dir < 0 && izq - 4 < XMIN);

  for (int f = 0; f < FILAS; f++) for (int c = 0; c < COLUMNAS; c++) if (vivo[f][c]) borrarInvasor(c, f);
  if (baja) { oy += 8; dir = -dir; } else ox += dir * 4;
  frameAnim ^= 1;
  for (int f = 0; f < FILAS; f++) for (int c = 0; c < COLUMNAS; c++) if (vivo[f][c]) dibujarInvasor(c, f);
  comerEscudos();
  playSeq(SND_PASO[pasoSnd & 3], 1, 0); pasoSnd++;

  int ms = 36 + vivos * 15 - (nivel - 1) * 14;
  if (ms < 14) ms = 14;
  ms = ms * DIF_PCT[diffIdx] / 100;
  tPaso = now + ms;
}

void disparoInvasor() {
  int libre = -1, activas = 0;
  for (int i = 0; i < 4; i++) { if (bi[i].on) activas++; else libre = i; }
  if (libre < 0 || activas >= maxBalasI) return;
  if ((int)random(100) >= 2 + nivel) return;
  int c = random(COLUMNAS);
  for (int f = FILAS - 1; f >= 0; f--) if (vivo[f][c]) {
    bi[libre].x = posX(c, f) + anchoTipo(f) / 2;
    bi[libre].y = posY(f) + 8;
    bi[libre].on = true;
    bi[libre].tipo = random(2);
    return;
  }
}

void explosionNave() {
  playSeq(SND_GOLPE, NN(SND_GOLPE), 3);
  for (int k = 0; k < 8; k++) {
    spriteTxt(nx - 6, Y_NAVE, (k & 1) ? BOOM : BOOMN, 12, 8, (k & 1) ? C565(255, 200, 0) : C565(255, 60, 30));
    waitMs(110);
  }
  tft.fillRect(nx - 8, Y_NAVE - 1, 16, 10, NEGRO);
}

// Juega una partida. Devuelve true si perdio, false si salio por la pausa
bool partida() {
  randomSeed(micros());
  puntos = 0; vidas = 3; nivel = 1; proxVida = 1500; nx = 120; pasoSnd = 0; expOn = false; ufoMsgHasta = 0;
  nuevaOleada();
  dibujarEscenario();
  clearPresses();
  uint32_t ultimo = 0;

  for (;;) {
    uint32_t now = millis();
    updateSound(now);
    readButtons(now);
    if (now - ultimo < FRAME_MS) { delay(1); continue; }
    ultimo = now;

    if (btnPress[B_OK]) {
      clearPresses();
      if (menuPausa(ACENTO)) return false;
      dibujarEscenario();
      continue;
    }

    // ---- nave
    int mv = (btnHeld[B_LEFT] ? -1 : 0) + (btnHeld[B_RIGHT] ? 1 : 0);
    if (mv) {
      int nuevo = constrain(nx + mv * 3, 44, 196);
      if (nuevo != nx) {
        tft.fillRect(nx - 6, Y_NAVE, 13, 8, NEGRO);
        nx = nuevo;
        spriteTxt(nx - 6, Y_NAVE, NAVE, 13, 8, C_NAVE);
      }
    }
    if ((btnPress[B_UP] || btnHeld[B_UP]) && !bn.on) {
      bn.x = nx; bn.y = Y_NAVE - 6; bn.on = true;
      playSeq(SND_DISPARO, NN(SND_DISPARO), 1);
    }

    // ---- bala de la nave
    if (bn.on) {
      borrarRect(bn.x, bn.y, 2, 6);
      bn.y -= 7;
      bool fin = false;
      if (bn.y < 30) fin = true;
      // contra invasores
      for (int f = 0; f < FILAS && !fin; f++) for (int c = 0; c < COLUMNAS && !fin; c++) {
        if (!vivo[f][c]) continue;
        int x0 = posX(c, f), y0 = posY(f);
        if (bn.x + 1 >= x0 && bn.x < x0 + anchoTipo(f) && bn.y <= y0 + 8 && bn.y + 6 >= y0) {
          vivo[f][c] = false; vivos--;
          borrarInvasor(c, f);
          static const uint8_t pts[FILAS] = {30, 20, 20, 10};
          puntos += pts[f];
          playSeq(SND_MATAR, NN(SND_MATAR), 2);
          expX = x0 - 1; expY = y0; expOn = true; tExplosion = now + 130;
          spriteTxt(expX, expY, BOOM, 12, 8, C565(255, 255, 255));
          fin = true;
        }
      }
      // contra el ovni
      if (!fin && ufoOn && bn.y <= Y_UFO + 7 && bn.y + 6 >= Y_UFO && bn.x >= (int)ufoX && bn.x < (int)ufoX + 16) {
        static const uint16_t ptsU[4] = {50, 100, 150, 300};
        uint16_t p = ptsU[random(4)];
        puntos += p; ufoOn = false;
        tft.fillRect((int)ufoX, Y_UFO, 16, 7, NEGRO);
        char b[8]; snprintf(b, sizeof(b), "%u", p);
        tft.setTextSize(1); tft.setTextColor(C_UFO); tft.setCursor((int)ufoX, Y_UFO); tft.print(b);
        playSeq(SND_MATAR, NN(SND_MATAR), 2);
        ufoMsgHasta = now + 800;
        tUfo = now + 12000 + random(10000);
        fin = true;
      }
      if (!fin && golpeEscudo(bn.x, bn.y)) fin = true;
      if (fin) bn.on = false;
      else tft.fillRect(bn.x, bn.y, 2, 6, C_DISP);
    }
    if (expOn && (int32_t)(now - tExplosion) >= 0) {
      tft.fillRect(expX, expY, 12, 8, NEGRO); expOn = false;
    }

    // ---- ovni
    if (ufoMsgHasta && (int32_t)(now - ufoMsgHasta) >= 0) { tft.fillRect(30, Y_UFO, 180, 8, NEGRO); ufoMsgHasta = 0; }
    if (!ufoOn && (int32_t)(now - tUfo) >= 0) {
      if (vivos > 6 && oy < 110) {
        ufoOn = true; ufoDir = random(2) ? 1 : -1;
        ufoX = ufoDir > 0 ? 32 : 192;
        playSeq(SND_UFO, NN(SND_UFO), 1);
      }
      tUfo = now + 12000 + random(10000);
    }
    if (ufoOn) {
      tft.fillRect((int)ufoX, Y_UFO, 16, 7, NEGRO);
      ufoX += ufoDir * 2;
      if (ufoX < 30 || ufoX > 194) { ufoOn = false; tft.fillRect(28, Y_UFO, 184, 8, NEGRO); }
      else spriteTxt((int)ufoX, Y_UFO, UFO, 16, 7, C_UFO);
    }

    // ---- invasores
    if ((int32_t)(now - tPaso) >= 0) pasoInvasores(now);
    disparoInvasor();

    // ---- balas enemigas
    bool golpeado = false;
    for (int i = 0; i < 4; i++) {
      if (!bi[i].on) continue;
      borrarRect(bi[i].x - 1, bi[i].y, 3, 7);
      bi[i].y += 3 + (nivel > 3 ? 1 : 0) + (nivel > 6 ? 1 : 0);
      bool fin = false;
      if (bi[i].y >= Y_SUELO - 6) fin = true;
      else if (bi[i].y + 7 >= Y_NAVE && bi[i].y <= Y_NAVE + 8 && bi[i].x >= nx - 6 && bi[i].x <= nx + 6) { golpeado = true; fin = true; }
      else if (golpeEscudo(bi[i].x, bi[i].y + 6)) fin = true;
      else if (bn.on && bn.x + 1 >= bi[i].x - 1 && bn.x <= bi[i].x + 1 && bn.y <= bi[i].y + 7 && bn.y + 6 >= bi[i].y) {   // se cruzan las balas
        borrarRect(bn.x, bn.y, 2, 6); bn.on = false; fin = true;
      }
      if (fin) bi[i].on = false;
      else {
        int x = bi[i].x - 1, y = bi[i].y;
        tft.fillRect(x + 1, y, 1, 7, C_BALA);
        tft.fillRect(x + (bi[i].tipo ^ ((y >> 2) & 1)) * 2, y + 2, 1, 2, C_BALA);
      }
    }

    // ---- consecuencias
    if (golpeado) {
      explosionNave();
      vidas--;
      for (int i = 0; i < 4; i++) { if (bi[i].on) borrarRect(bi[i].x - 1, bi[i].y, 3, 7); bi[i].on = false; }
      if (bn.on) { borrarRect(bn.x, bn.y, 2, 6); bn.on = false; }
      if (vidas <= 0) return true;
      nx = 120; spriteTxt(nx - 6, Y_NAVE, NAVE, 13, 8, C_NAVE);
      dibujarHUD(true);
      waitMs(500);
      clearPresses();
      tPaso = millis() + 400;
      continue;
    }
    // invasores llegaron abajo
    bool llegaron = false;
    for (int f = FILAS - 1; f >= 0 && !llegaron; f--) for (int c = 0; c < COLUMNAS; c++)
      if (vivo[f][c] && posY(f) + 8 >= Y_NAVE - 2) { llegaron = true; break; }
    if (llegaron) { explosionNave(); return true; }

    if (puntos >= proxVida) { proxVida += 1500; if (vidas < 5) vidas++; playSeq(SND_SUBE, NN(SND_SUBE), 2); }
    dibujarHUD(false);

    if (vivos <= 0) {
      playSeq(SND_SUBE, NN(SND_SUBE), 3);
      waitMs(900);
      nivel++;
      nuevaOleada();
      dibujarEscenario();
      clearPresses();
    }
    clearPresses();
  }
}

void jugar() {
  for (;;) {
    record = prefsA.getUInt("hiInv", 0);
    if (!menuJuego("INVADERS", ACENTO0, record, 1)) return;
    aplicarSkin();
    for (;;) {
      pPuntos = 0xFFFFFFFF; pVidas = -1;
      bool perdio = partida();
      if (!perdio) break;
      bool nuevo = puntos > record;
      if (nuevo) { record = puntos; prefsA.putUInt("hiInv", record); }
      if (!pantallaFin(puntos, record, nuevo, ACENTO)) break;
    }
  }
}

}  // namespace inv

// ===== fin de invaders.h =====


// ===== inicio de dino.h =====
// =====================================================================
//  DINO RUN  (el del dinosaurio de Chrome, pero a colores y con dia/noche)
//  Controles: ARRIBA saltar (mantener = salto mas alto), ABAJO agacharse /
//             caer rapido, OK pausa
//  Dibuja una franja de 240x120 en memoria y la manda de una vez (sin parpadeo)
// =====================================================================


namespace dino {

const int BANDA_Y = 60, BANDA_H = 120;     // franja de pantalla donde ocurre la accion
const int SUELO   = 92;                    // y del suelo dentro de la franja
const int DINO_X  = 34;
const int ANCHO_D = 24, ALTO_D = 26, ANCHO_AG = 28, ALTO_AG = 14;

const uint16_t CIELO_D0 = C565(120, 200, 255), CIELO_N0 = C565(12, 14, 48);
const uint16_t LEJ_D0   = C565(170, 222, 175), LEJ_N0   = C565(30, 38, 82);
const uint16_t CERC_D0  = C565(105, 200, 120), CERC_N0  = C565(20, 58, 72);
const uint16_t SUE_D0   = C565(228, 192, 124), SUE_N0   = C565(72, 60, 50);
const uint16_t LIN_D0   = C565(140, 98, 48),  LIN_N0   = C565(30, 24, 20);
const uint16_t NUBE_D0  = C565(255, 255, 255), NUBE_N0  = C565(74, 84, 126);
const uint16_t C_DINO0  = C565(80, 205, 90),  C_DINO_S0 = C565(40, 140, 60), C_PANZA0 = C565(165, 240, 130);
const uint16_t C_CACTO0 = C565(30, 160, 70),  C_CACTO_S0 = C565(15, 105, 45);
const uint16_t C_AVE0   = C565(170, 80, 220), C_AVE_S0 = C565(105, 40, 160), C_PICO0 = C565(255, 170, 30);
const uint16_t ACENTO0  = C565(80, 205, 90);
// colores en uso (originales + skin elegida)
uint16_t CIELO_D, CIELO_N, LEJ_D, LEJ_N, CERC_D, CERC_N, SUE_D, SUE_N, LIN_D, LIN_N, NUBE_D, NUBE_N;
uint16_t C_DINO, C_DINO_S, C_PANZA, C_CACTO, C_CACTO_S, C_AVE, C_AVE_S, C_PICO, ACENTO;
void aplicarSkin() {
  CIELO_D = skinTinte(CIELO_D0); CIELO_N = skinTinte(CIELO_N0);
  LEJ_D = skinTinte(LEJ_D0);     LEJ_N = skinTinte(LEJ_N0);
  CERC_D = skinTinte(CERC_D0);   CERC_N = skinTinte(CERC_N0);
  SUE_D = skinTinte(SUE_D0);     SUE_N = skinTinte(SUE_N0);
  LIN_D = skinTinte(LIN_D0);     LIN_N = skinTinte(LIN_N0);
  NUBE_D = skinTinte(NUBE_D0);   NUBE_N = skinTinte(NUBE_N0);
  C_DINO = skinTinte(C_DINO0);   C_DINO_S = skinTinte(C_DINO_S0); C_PANZA = skinTinte(C_PANZA0);
  C_CACTO = skinTinte(C_CACTO0); C_CACTO_S = skinTinte(C_CACTO_S0);
  C_AVE = skinTinte(C_AVE0);     C_AVE_S = skinTinte(C_AVE_S0);   C_PICO = skinTinte(C_PICO0);
  ACENTO = skinTinte(ACENTO0);
}

struct Obs { float x; uint8_t tipo; int16_t w, h, alt; bool on; };
struct Nube { float x; int16_t y; };
struct Mota { float x; uint8_t y, w; };

GFXcanvas16* cv = nullptr;
Obs   obs[4];
Nube  nubes[3];
Mota  motas[18];
float altura, vh, vel, dist, off1, off2, proxGap, desdeUlt;
uint8_t dn;                 // 0 = dia, 255 = noche
uint32_t puntos, record, pPuntos, pRecord;
int   fAnim;
bool  agachado, enSuelo, muerto, esperando;

const Note SND_SALTO[]  = {{500, 25}, {800, 35}};
const Note SND_HITO[]   = {{988, 60}, {0, 40}, {988, 60}, {1319, 120}};
const Note SND_MUERTE[] = {{400, 80}, {300, 80}, {200, 80}, {120, 200}};

uint16_t col(uint16_t d, uint16_t n) { return mezclar565(d, n, dn); }

// ---------------------------------------------------------------- dibujo en el lienzo
void dibujarNube(int x, int y, uint16_t c) {
  cv->fillRoundRect(x, y + 5, 28, 7, 3, c);
  cv->fillCircle(x + 9, y + 5, 5, c);
  cv->fillCircle(x + 17, y + 4, 6, c);
}

void dibujarCacto(int x, int yb, int h, uint16_t c, uint16_t s) {
  int tw = h > 24 ? 8 : 6;
  int tx = x + 4;
  cv->fillRect(tx, yb - h, tw, h, c);
  cv->fillRect(tx + 1, yb - h - 1, tw - 2, 1, c);
  cv->fillRect(tx + tw - 2, yb - h + 2, 2, h - 3, s);          // sombra del tronco
  int a1 = yb - (h * 55) / 100;                                 // brazo izquierdo
  cv->fillRect(x, a1, 5, 3, c);
  cv->fillRect(x, a1 - (h > 24 ? 9 : 6), 3, (h > 24 ? 9 : 6) + 3, c);
  cv->fillRect(x + 1, a1 - (h > 24 ? 9 : 6) - 1, 1, 1, c);
  int a2 = yb - (h * 40) / 100;                                 // brazo derecho
  cv->fillRect(tx + tw - 1, a2, 5, 3, c);
  cv->fillRect(tx + tw + 2, a2 - (h > 24 ? 8 : 5), 3, (h > 24 ? 8 : 5) + 3, c);
  cv->fillRect(tx + tw + 3, a2 - (h > 24 ? 8 : 5) - 1, 1, 1, c);
  cv->drawPixel(tx + 2, yb - h + 4, BLANCO);                    // espinas
  cv->drawPixel(tx + 3, yb - h / 2, BLANCO);
  cv->drawPixel(tx + 1, yb - 5, BLANCO);
}

void dibujarAve(int x, int y, int frame) {          // x,y = esquina superior izquierda (22x14)
  cv->fillRect(x + 4, y + 5, 13, 5, C_AVE);        // cuerpo
  cv->fillRect(x + 14, y + 3, 6, 5, C_AVE);        // cabeza
  cv->fillRect(x + 19, y + 5, 3, 2, C_PICO);       // pico
  cv->drawPixel(x + 17, y + 4, BLANCO);
  cv->fillRect(x, y + 6, 5, 2, C_AVE_S);           // cola
  cv->fillRect(x + 4, y + 9, 12, 1, C_AVE_S);
  if (frame) {                                      // alas arriba
    cv->fillTriangle(x + 6, y + 5, x + 14, y + 5, x + 9, y - 1, C_AVE_S);
    cv->fillTriangle(x + 8, y + 5, x + 13, y + 5, x + 12, y - 1, C_AVE);
  } else {                                          // alas abajo
    cv->fillTriangle(x + 6, y + 10, x + 14, y + 10, x + 9, y + 15, C_AVE_S);
    cv->fillTriangle(x + 8, y + 10, x + 13, y + 10, x + 12, y + 15, C_AVE);
  }
}

// yPies = coordenada del suelo bajo los pies
void dibujarDino(int x, int yPies, bool ag, int frame, bool muertoD) {
  uint16_t c = C_DINO, s = C_DINO_S;
  if (!ag) {
    int y = yPies - ALTO_D;
    cv->fillRect(x + 11, y, 13, 11, c);             // cabeza
    cv->fillRect(x + 22, y + 1, 2, 2, c);
    cv->fillRect(x + 10, y + 1, 1, 8, c);
    cv->fillRect(x + 17, y + 8, 7, 3, s);           // boca
    cv->fillRect(x + 17, y + 9, 5, 1, NEGRO);
    if (muertoD) { cv->drawLine(x + 15, y + 2, x + 18, y + 5, NEGRO); cv->drawLine(x + 18, y + 2, x + 15, y + 5, NEGRO); }
    else { cv->fillRect(x + 15, y + 2, 4, 4, BLANCO); cv->fillRect(x + 17, y + 3, 2, 2, NEGRO); }
    cv->fillRect(x + 9, y + 11, 10, 5, c);          // cuello
    cv->fillRect(x + 4, y + 15, 15, 7, c);          // cuerpo
    cv->fillRect(x + 2, y + 13, 7, 6, c);           // lomo
    cv->fillRect(x + 8, y + 18, 9, 4, C_PANZA);     // panza
    cv->fillRect(x + 0, y + 14, 4, 4, c);           // cola
    cv->fillRect(x + 0, y + 17, 2, 2, s);
    cv->fillRect(x + 2, y + 18, 3, 3, c);
    cv->fillRect(x + 17, y + 16, 5, 2, c);          // bracito
    cv->fillRect(x + 20, y + 17, 2, 1, s);
    cv->fillRect(x + 4, y + 20, 15, 2, s);          // sombra bajo el cuerpo
    int l1 = 4, l2 = 4;                             // piernas (una sube y otra baja al correr)
    if (!muertoD && yPies >= SUELO) { if (frame) l1 = 1; else l2 = 1; }
    cv->fillRect(x + 6, yPies - l1, 4, l1, c);
    cv->fillRect(x + 6, yPies - 1, 6, 1, s);
    cv->fillRect(x + 14, yPies - l2, 4, l2, c);
    cv->fillRect(x + 14, yPies - 1, 6, 1, s);
  } else {
    int y = yPies - ALTO_AG;
    cv->fillRect(x + 4, y + 4, 18, 7, c);           // cuerpo largo
    cv->fillRect(x + 6, y + 9, 12, 2, C_PANZA);
    cv->fillRect(x + 0, y + 5, 5, 4, c);            // cola
    cv->fillRect(x + 17, y + 0, 11, 8, c);          // cabeza
    cv->fillRect(x + 24, y + 5, 4, 3, s);           // boca
    cv->fillRect(x + 21, y + 1, 3, 3, BLANCO);
    cv->fillRect(x + 22, y + 2, 2, 2, NEGRO);
    int l1 = 3, l2 = 3;
    if (frame) l1 = 1; else l2 = 1;
    cv->fillRect(x + 7, yPies - l1, 4, l1, c);
    cv->fillRect(x + 15, yPies - l2, 4, l2, c);
  }
}

void dibujarObs(const Obs& o) {
  int x = (int)o.x;
  if (o.tipo == 5) {
    dibujarAve(x, SUELO - o.alt - o.h, (fAnim >> 2) & 1);
    return;
  }
  int n = (o.w + 2) / 14;                             // cuantos troncos
  int h = o.h;
  for (int i = 0; i < n; i++) dibujarCacto(x + i * 14, SUELO + 1, h - (i == 1 && n == 3 ? 4 : 0), C_CACTO, C_CACTO_S);
}

void componer() {
  uint16_t cielo = col(CIELO_D, CIELO_N);
  cv->fillScreen(cielo);
  // estrellas de noche
  if (dn > 70) {
    uint16_t es = mezclar565(cielo, BLANCO, dn - 40);
    static const uint8_t ex[10] = {14, 40, 66, 92, 118, 150, 176, 204, 226, 80};
    static const uint8_t ey[10] = {10, 30, 6, 22, 40, 12, 34, 8, 26, 50};
    for (int i = 0; i < 10; i++) { cv->drawPixel(ex[i], ey[i], es); if (i & 1) cv->drawPixel(ex[i] + 1, ey[i], es); }
  }
  // sol / luna
  if (dn < 128) {
    cv->fillCircle(190, 24, 12, mezclar565(cielo, C565(255, 240, 150), 120));
    cv->fillCircle(190, 24, 9, C565(255, 215, 40));
  } else {
    cv->fillCircle(190, 24, 9, C565(236, 236, 205));
    cv->fillCircle(194, 21, 8, cielo);
  }
  // nubes
  uint16_t cn = col(NUBE_D, NUBE_N);
  for (int i = 0; i < 3; i++) dibujarNube((int)nubes[i].x, nubes[i].y, cn);
  // colinas lejanas y cercanas (parallax)
  uint16_t cl = col(LEJ_D, LEJ_N), cc = col(CERC_D, CERC_N);
  for (int x = 0; x < 240; x++) {
    int h1 = 18 + (int)(11.0f * sinf((x + off1) * 0.045f) + 5.0f * sinf((x + off1) * 0.11f));
    cv->drawFastVLine(x, SUELO - h1, h1, cl);
  }
  for (int x = 0; x < 240; x++) {
    int h2 = 8 + (int)(6.0f * sinf((x + off2) * 0.08f + 1.3f));
    cv->drawFastVLine(x, SUELO - h2, h2, cc);
  }
  // suelo
  uint16_t su = col(SUE_D, SUE_N), li = col(LIN_D, LIN_N);
  cv->fillRect(0, SUELO, 240, BANDA_H - SUELO, su);
  cv->fillRect(0, SUELO, 240, 2, li);
  for (int i = 0; i < 18; i++) cv->fillRect((int)motas[i].x, SUELO + motas[i].y, motas[i].w, 1, li);
  // obstaculos y dino
  for (int i = 0; i < 4; i++) if (obs[i].on) dibujarObs(obs[i]);
  int yPies = SUELO + 1 - (int)altura;
  dibujarDino(DINO_X, yPies, agachado && enSuelo, (fAnim >> 2) & 1, muerto);
}

// colores de las zonas fuera de la franja
void fondoExterior() {
  tft.fillRect(0, 0, 240, BANDA_Y, col(CIELO_D, CIELO_N));
  tft.fillRect(0, BANDA_Y + BANDA_H, 240, 240 - BANDA_Y - BANDA_H, col(SUE_D, SUE_N));
}

void hud(bool todo) {
  uint16_t fondo = col(CIELO_D, CIELO_N);
  uint16_t tx = mezclar565(C565(50, 60, 70), BLANCO, dn);
  if (todo || pPuntos != puntos || pRecord != record) {
    char b[16];
    tft.fillRect(60, 30, 120, 28, fondo);
    snprintf(b, sizeof(b), "%05lu", (unsigned long)puntos);
    printC(b, 32, 2, tx);
    snprintf(b, sizeof(b), "HI %05lu", (unsigned long)record);
    printC(b, 50, 1, tx);
    pPuntos = puntos; pRecord = record;
  }
}

// ---------------------------------------------------------------- logica
void nuevaObs() {
  int i = 0;
  while (i < 4 && obs[i].on) i++;
  if (i >= 4) return;
  Obs& o = obs[i];
  o.on = true; o.x = 246; o.alt = 0;
  int r = random(100);
  if (puntos > 200 && r < 24) {                   // pajaro
    o.tipo = 5; o.w = 22; o.h = 14;
    static const int16_t alts[3] = {2, 16, 34};
    o.alt = alts[random(3)];
  } else {
    int t = (puntos < 120) ? random(3) : random(5);
    o.tipo = t;
    static const int16_t ws[5] = {10, 12, 26, 40, 28};
    static const int16_t hs[5] = {20, 30, 20, 20, 30};
    o.w = ws[t]; o.h = hs[t];
    if (t == 1) o.w = 14;
  }
}

bool choque() {
  int dx0, dy0, dx1, dy1;
  int yPies = SUELO + 1 - (int)altura;
  if (agachado && enSuelo) { dx0 = DINO_X + 3; dx1 = DINO_X + 26; dy0 = yPies - ALTO_AG + 4; dy1 = yPies - 1; }
  else { dx0 = DINO_X + 5; dx1 = DINO_X + 22; dy0 = yPies - ALTO_D + 2; dy1 = yPies - 2; }
  for (int i = 0; i < 4; i++) {
    if (!obs[i].on) continue;
    int ox0, ox1, oy0, oy1;
    if (obs[i].tipo == 5) {
      ox0 = (int)obs[i].x + 3; ox1 = (int)obs[i].x + obs[i].w - 3;
      oy1 = SUELO - obs[i].alt - 2; oy0 = SUELO - obs[i].alt - obs[i].h + 3;
    } else {
      ox0 = (int)obs[i].x + 3; ox1 = (int)obs[i].x + obs[i].w - 3;
      oy1 = SUELO; oy0 = SUELO - obs[i].h + 3;
    }
    if (dx1 > ox0 && dx0 < ox1 && dy1 > oy0 && dy0 < oy1) return true;
  }
  return false;
}

void reiniciar() {
  altura = 0; vh = 0; vel = 4.6f * DIF_VEL[diffIdx]; dist = 0; off1 = 0; off2 = 0; desdeUlt = 0; proxGap = 150;
  dn = 0; puntos = 0; fAnim = 0; agachado = false; enSuelo = true; muerto = false; esperando = true;
  for (int i = 0; i < 4; i++) obs[i].on = false;
  for (int i = 0; i < 3; i++) { nubes[i].x = 30 + i * 85; nubes[i].y = 6 + random(30); }
  for (int i = 0; i < 18; i++) { motas[i].x = random(240); motas[i].y = 4 + random(22); motas[i].w = 1 + random(3); }
  pPuntos = 0xFFFFFFFF; pRecord = 0xFFFFFFFF;
}

// Una partida. Devuelve true si perdio, false si salio por la pausa.
bool partida() {
  randomSeed(micros());
  reiniciar();
  fondoExterior();
  componer(); empujarLienzo(cv, 0, BANDA_Y);
  hud(true);
  printC("ARRIBA: SALTAR", 192, 1, BLANCO);
  printC("ABAJO: AGACHAR", 206, 1, BLANCO);
  clearPresses();
  uint32_t ultimo = 0;
  bool noche = false;
  uint8_t cuentaFondo = 0;

  for (;;) {
    uint32_t now = millis();
    updateSound(now);
    readButtons(now);
    if (now - ultimo < FRAME_MS) { delay(1); continue; }
    ultimo = now;

    if (btnPress[B_OK]) {
      clearPresses();
      if (menuPausa(ACENTO)) return false;
      fondoExterior(); hud(true);
      if (esperando) { printC("ARRIBA: SALTAR", 192, 1, BLANCO); printC("ABAJO: AGACHAR", 206, 1, BLANCO); }
      componer(); empujarLienzo(cv, 0, BANDA_Y);
      continue;
    }

    if (esperando) {
      if (btnPress[B_UP]) {
        esperando = false;
        tft.fillRect(60, 186, 120, 30, col(SUE_D, SUE_N));
      } else { clearPresses(); continue; }
    }

    // ---- entrada
    agachado = btnHeld[B_DOWN];
    if (enSuelo && btnPress[B_UP] ) {
      vh = 9.8f; enSuelo = false;
      playSeq(SND_SALTO, NN(SND_SALTO), 1);
    }
    if (!enSuelo) {
      if (!btnHeld[B_UP] && vh > 3.6f) vh = 3.6f;      // soltar = salto corto
      vh -= agachado ? 2.6f : 0.92f;
      altura += vh;
      if (altura <= 0) { altura = 0; vh = 0; enSuelo = true; }
    }

    // ---- mundo
    vel = (4.6f + (float)puntos * 0.0045f) * DIF_VEL[diffIdx]; if (vel > 10.5f * DIF_VEL[diffIdx]) vel = 10.5f * DIF_VEL[diffIdx];
    dist += vel;
    puntos = (uint32_t)(dist / 11.0f);
    off1 += vel * 0.22f; off2 += vel * 0.55f;
    fAnim++;
    for (int i = 0; i < 3; i++) { nubes[i].x -= vel * 0.12f; if (nubes[i].x < -34) { nubes[i].x = 244; nubes[i].y = 6 + random(30); } }
    for (int i = 0; i < 18; i++) { motas[i].x -= vel; if (motas[i].x < -4) { motas[i].x = 242 + random(20); motas[i].y = 4 + random(22); motas[i].w = 1 + random(3); } }
    for (int i = 0; i < 4; i++) if (obs[i].on) { obs[i].x -= vel; if (obs[i].x < -50) obs[i].on = false; }
    desdeUlt += vel;
    if (desdeUlt >= proxGap) { nuevaObs(); desdeUlt = 0; proxGap = vel * (24 + random(18)) + 44; }

    // ---- dia / noche
    noche = ((puntos / 350) & 1) == 1;
    if (noche && dn < 255) dn = (dn > 253) ? 255 : dn + 2;
    else if (!noche && dn > 0) dn = (dn < 2) ? 0 : dn - 2;
    if ((dn != 0 && dn != 255) && ((++cuentaFondo) & 3) == 0) { fondoExterior(); hud(true); }

    static uint32_t ultimoHito = 0;
    if (puntos < 5) ultimoHito = 0;
    if (puntos / 100 > ultimoHito) { ultimoHito = puntos / 100; if (puntos >= 100) playSeq(SND_HITO, NN(SND_HITO), 2); }

    // ---- dibujar
    muerto = choque();
    componer();
    empujarLienzo(cv, 0, BANDA_Y);
    hud(false);
    if (muerto) {
      playSeq(SND_MUERTE, NN(SND_MUERTE), 3);
      waitMs(900);
      return true;
    }
    clearPresses();
  }
}

void jugar() {
  for (;;) {
    record = prefsA.getUInt("hiDino", 0);
    if (!menuJuego("DINO RUN", ACENTO0, record, 2)) return;
    aplicarSkin();
    cv = crearLienzo(240, BANDA_H);
    if (!cv) return;
    for (;;) {
      bool perdio = partida();
      if (!perdio) break;
      bool nuevo = puntos > record;
      if (nuevo) { record = puntos; prefsA.putUInt("hiDino", record); }
      if (!pantallaFin(puntos, record, nuevo, ACENTO)) break;
    }
    delete cv; cv = nullptr;
  }
}

}  // namespace dino

// ===== fin de dino.h =====





// >>>>>>>>>>>>>>>>>>>>>>>>>>>>>>>>>>>>>>>>>>>>>>>>>>>>>>>>>>>>>>>>>>>>>>>>>>>>>>
// >>> NUEVO (RFID/NFC + WiFi): todo lo que hay entre aqui y "fin de agregar_juego.h"
// >>>>>>>>>>>>>>>>>>>>>>>>>>>>>>>>>>>>>>>>>>>>>>>>>>>>>>>>>>>>>>>>>>>>>>>>>>>>>>

// ===== inicio de rfid_rc522.h =====
// =====================================================================
//  Driver minimo del lector RC522 (MFRC522) por SPI, sin librerias.
//  Solo lo necesario: detectar etiquetas tipo 2 (NTAG / Ultralight) y
//  leer sus paginas. Comparte SCK y MOSI con la pantalla; usa su propio
//  SS (pin 7), MISO (pin 13) y RST (pin 43). Va a 4 MHz con transacciones.
// =====================================================================
namespace rc {

const uint8_t CmdReg = 0x01, ComIrqReg = 0x04, DivIrqReg = 0x05, ErrorReg = 0x06,
              FifoDataReg = 0x09, FifoLevelReg = 0x0A, BitFramingReg = 0x0D, CollReg = 0x0E,
              ModeReg = 0x11, TxControlReg = 0x14, TxASKReg = 0x15, CrcResH = 0x21, CrcResL = 0x22,
              TModeReg = 0x2A, TPrescalerReg = 0x2B, TReloadH = 0x2C, TReloadL = 0x2D, VersionReg = 0x37;

bool    listo = false;
uint8_t sak = 0;
uint8_t uid[10];
uint8_t uidLen = 0;
uint8_t datos[528];          // area de datos de la etiqueta (desde la pagina 4)
int     datosLen = 0;
int     ndefOff = 0, ndefLen = 0;

void wr(uint8_t r, uint8_t v) {
  SPI.beginTransaction(SPISettings(4000000, MSBFIRST, SPI_MODE0));
  digitalWrite(RC_SS, LOW);
  SPI.transfer((r << 1) & 0x7E);
  SPI.transfer(v);
  digitalWrite(RC_SS, HIGH);
  SPI.endTransaction();
}
uint8_t rd(uint8_t r) {
  SPI.beginTransaction(SPISettings(4000000, MSBFIRST, SPI_MODE0));
  digitalWrite(RC_SS, LOW);
  SPI.transfer(((r << 1) & 0x7E) | 0x80);
  uint8_t v = SPI.transfer(0);
  digitalWrite(RC_SS, HIGH);
  SPI.endTransaction();
  return v;
}

// Reinicia el chip y comprueba que responde. false = no hay lector.
bool iniciar() {
  pinMode(RC_SS, OUTPUT);  digitalWrite(RC_SS, HIGH);
  pinMode(RC_RST, OUTPUT);
  digitalWrite(RC_RST, LOW);  delay(10);
  digitalWrite(RC_RST, HIGH); delay(50);
  wr(CmdReg, 0x0F);                                   // reset por software
  uint32_t t = millis();
  while ((rd(CmdReg) & 0x10) && millis() - t < 100) delay(2);
  uint8_t v = rd(VersionReg);
  listo = !(v == 0x00 || v == 0xFF);
  if (!listo) return false;
  wr(TModeReg, 0x80); wr(TPrescalerReg, 0xA9);        // temporizador ~25 ms
  wr(TReloadH, 0x03); wr(TReloadL, 0xE8);
  wr(TxASKReg, 0x40); wr(ModeReg, 0x3D);
  if ((rd(TxControlReg) & 3) != 3) wr(TxControlReg, rd(TxControlReg) | 3);   // antena ON
  return true;
}
// Apaga la antena y deja el chip dormido (RST bajo)
void apagar() {
  if (listo) wr(TxControlReg, rd(TxControlReg) & ~3);
  digitalWrite(RC_RST, LOW);
  listo = false;
}

// Envia n bytes y recibe hasta rmax. Devuelve los bytes recibidos o -1.
int trx(const uint8_t* s, uint8_t n, uint8_t* r, uint8_t rmax, uint8_t bitsUlt) {
  wr(CmdReg, 0x00);
  wr(ComIrqReg, 0x7F);
  wr(FifoLevelReg, 0x80);
  for (uint8_t i = 0; i < n; i++) wr(FifoDataReg, s[i]);
  wr(BitFramingReg, bitsUlt);
  wr(CmdReg, 0x0C);                                   // Transceive
  wr(BitFramingReg, bitsUlt | 0x80);                  // StartSend
  uint32_t t = millis();
  uint8_t irq;
  for (;;) {
    irq = rd(ComIrqReg);
    if (irq & 0x31) break;
    if (millis() - t > 30) { wr(CmdReg, 0x00); return -1; }
  }
  wr(BitFramingReg, bitsUlt);
  if ((irq & 0x01) && !(irq & 0x20)) return -1;       // sin respuesta
  if (rd(ErrorReg) & 0x13) return -1;                 // desbordamiento, paridad o protocolo
  uint8_t k = rd(FifoLevelReg);
  if (k > rmax) k = rmax;
  for (uint8_t i = 0; i < k; i++) r[i] = rd(FifoDataReg);
  return k;
}

bool crc(const uint8_t* d, uint8_t n, uint8_t* out) {
  wr(CmdReg, 0x00); wr(DivIrqReg, 0x04); wr(FifoLevelReg, 0x80);
  for (uint8_t i = 0; i < n; i++) wr(FifoDataReg, d[i]);
  wr(CmdReg, 0x03);
  uint32_t t = millis();
  while (!(rd(DivIrqReg) & 0x04)) if (millis() - t > 20) return false;
  wr(CmdReg, 0x00);
  out[0] = rd(CrcResL); out[1] = rd(CrcResH);
  return true;
}

// Despierta y selecciona una etiqueta (WUPA + anticolision). true = hay una y queda en uid/sak.
bool detectar() {
  if (!listo) return false;
  wr(CollReg, rd(CollReg) & 0x7F);
  uint8_t b[18], q = 0x52;                            // WUPA
  if (trx(&q, 1, b, 18, 7) != 2) return false;
  uidLen = 0;
  for (uint8_t nivel = 0; nivel < 3; nivel++) {
    uint8_t sel = (nivel == 0) ? 0x93 : (nivel == 1) ? 0x95 : 0x97;
    uint8_t a[2] = {sel, 0x20};
    if (trx(a, 2, b, 18, 0) != 5) return false;
    if ((uint8_t)(b[0] ^ b[1] ^ b[2] ^ b[3]) != b[4]) return false;
    uint8_t u[5]; memcpy(u, b, 5);
    uint8_t s[9] = {sel, 0x70, u[0], u[1], u[2], u[3], u[4], 0, 0};
    if (!crc(s, 7, s + 7)) return false;
    if (trx(s, 9, b, 18, 0) != 3) return false;
    sak = b[0];
    if (u[0] == 0x88) { memcpy(uid + uidLen, u + 1, 3); uidLen += 3; }
    else              { memcpy(uid + uidLen, u, 4);     uidLen += 4; break; }
    if (!(sak & 0x04)) break;
  }
  return uidLen > 0;
}

// Pone la etiqueta en HALT (para poder volver a detectarla con WUPA)
void detener() {
  uint8_t h[4] = {0x50, 0x00, 0, 0}, b[4];
  crc(h, 2, h + 2);
  trx(h, 4, b, 4, 0);
}

bool leerPag(uint8_t pag, uint8_t* out16) {
  uint8_t c[4] = {0x30, pag, 0, 0}, b[18], cc[2];
  crc(c, 2, c + 2);
  if (trx(c, 4, b, 18, 0) != 18) return false;
  if (!crc(b, 16, cc) || cc[0] != b[16] || cc[1] != b[17]) return false;
  memcpy(out16, b, 16);
  return true;
}

// Lee el area NDEF de una etiqueta tipo 2. Deja el mensaje en datos[ndefOff .. ndefOff+ndefLen).
//  1 = ok, 0 = vacia o sin NDEF, -1 = error de lectura, -2 = tipo no soportado (no es NTAG/Ultralight)
int leerNdef() {
  if (sak != 0x00) return -2;
  uint8_t p[16];
  if (!leerPag(0, p)) return -1;                      // pag 0-3: el byte 12 es el CC
  if (p[12] != 0xE1) return 0;                        // sin formato NDEF
  int tam = p[14] * 8;
  if (tam < 16) return 0;
  if (tam > 512) tam = 512;
  for (int off = 0; off < tam; off += 16)
    if (!leerPag(4 + off / 4, datos + off)) return -1;
  datosLen = tam;
  int i = 0;
  ndefOff = ndefLen = 0;
  while (i < datosLen) {                              // recorre los TLV
    uint8_t t = datos[i++];
    if (t == 0x00) continue;
    if (t == 0xFE || i >= datosLen) break;
    int len = datos[i++];
    if (len == 0xFF) { if (i + 1 >= datosLen) break; len = (datos[i] << 8) | datos[i + 1]; i += 2; }
    if (t == 0x03) {
      if (len == 0 || i + len > datosLen) return 0;
      ndefOff = i; ndefLen = len;
      return 1;
    }
    i += len;
  }
  return 0;
}

}  // namespace rc

// ===== fin de rfid_rc522.h =====


// ===== inicio de ndef.h =====
// =====================================================================
//  Lector de mensajes NDEF: se queda con el primer registro URI y el
//  primer registro de texto (lo que escriben las apps de celular).
// =====================================================================
namespace ndef {

char uri[161];
char txt[161];

bool parsear(const uint8_t* m, int n) {
  uri[0] = txt[0] = 0;
  int i = 0;
  while (i < n) {
    uint8_t h = m[i++];
    bool sr = h & 0x10, il = h & 0x08;
    uint8_t tnf = h & 7;
    if (h & 0x20) break;                              // registros en trozos: no soportado
    if (i >= n) break;
    uint8_t tl = m[i++];
    uint32_t pl;
    if (sr) { if (i >= n) break; pl = m[i++]; }
    else {
      if (i + 4 > n) break;
      pl = ((uint32_t)m[i] << 24) | ((uint32_t)m[i + 1] << 16) | ((uint32_t)m[i + 2] << 8) | m[i + 3];
      i += 4;
    }
    uint8_t idl = 0;
    if (il) { if (i >= n) break; idl = m[i++]; }
    if (pl > (uint32_t)n || i + tl + idl + (int)pl > n) break;
    const uint8_t* ty = m + i;
    const uint8_t* pa = m + i + tl + idl;
    if (tnf == 1 && tl == 1 && ty[0] == 'U' && pl >= 1 && !uri[0]) {
      static const char* const PRE[5] = {"", "http://www.", "https://www.", "http://", "https://"};
      uint8_t c = pa[0];
      if (c <= 4) {
        size_t k = strlen(PRE[c]);
        strcpy(uri, PRE[c]);
        for (uint32_t j = 1; j < pl && k < sizeof(uri) - 1; j++) uri[k++] = (char)pa[j];
        uri[k] = 0;
      }
    } else if (tnf == 1 && tl == 1 && ty[0] == 'T' && pl >= 1 && !txt[0]) {
      uint8_t st = pa[0];
      uint8_t ll = st & 0x3F;
      if (!(st & 0x80) && (uint32_t)(1 + ll) <= pl) {         // solo UTF-8
        size_t k = 0;
        for (uint32_t j = 1 + ll; j < pl && k < sizeof(txt) - 1; j++) txt[k++] = (char)pa[j];
        txt[k] = 0;
      }
    }
    i += tl + idl + (int)pl;
    if (h & 0x40) break;                              // ME: ultimo registro
  }
  return uri[0] || txt[0];
}

}  // namespace ndef

// ===== fin de ndef.h =====


// ===== inicio de juegos_datos.h =====
// =====================================================================
//  Juegos descargados (.agm): formato, validacion y almacen en LittleFS.
//
//  FORMATO .agm (texto, ASCII, maximo 12 KB):
//     ARCGAME1
//     tipo=sokoban              (o snake)
//     titulo=CAJAS              (1 a 8 letras/numeros/espacio/guion)
//     color=FF8800              (RRGGBB)
//     portada=r,10,50,60,20,FF8800;c,40,30,12,FFFF00     (opcional, lienzo 80x80)
//     vel=150                   (solo snake: ms por paso, 60..500)
//     meta=8                    (solo snake: manzanas por nivel, 3..50)
//     [nivel]
//     #####
//     #@$.#
//     #####
//     [nivel]
//     ...
//  Portada: r,x,y,w,h,color | c,x,y,radio,color | l,x0,y0,x1,y1,color | t,x0,y0,x1,y1,x2,y2,color
//  Sokoban: # pared, @ jugador, + jugador sobre meta, $ caja, . meta, * caja en meta, espacio = suelo
//  Snake  : # pared, S inicio (obligatorio, uno solo), . o espacio = suelo
//  Maximo 13x13 por nivel y 12 niveles.
// =====================================================================
#define ARC_MAX_DESC   6        // juegos descargados como maximo
#define ARC_MAX_BYTES  12288    // tamano maximo de un .agm
#define ARC_MAX_NIV    12
#define ARC_DIM        13

namespace agm {

struct Desc {
  char     id[25];
  char     titulo[9];
  uint16_t color;
  uint8_t  tipo;               // 1 = sokoban, 2 = snake
  char     portada[200];
};

Desc    desc[ARC_MAX_DESC];
uint8_t n = 0;
bool    fsOk = false;

bool montar() {
  if (fsOk) return true;
  fsOk = LittleFS.begin(true);
  if (fsOk) LittleFS.mkdir("/g");
  return fsOk;
}

bool idValido(const char* s) {
  size_t l = strlen(s);
  if (l < 1 || l > 24) return false;
  for (size_t i = 0; i < l; i++) {
    char c = s[i];
    if (!((c >= 'a' && c <= 'z') || (c >= '0' && c <= '9') || c == '_' || c == '-')) return false;
  }
  return true;
}

int hexv(char c) {
  if (c >= '0' && c <= '9') return c - '0';
  if (c >= 'a' && c <= 'f') return c - 'a' + 10;
  if (c >= 'A' && c <= 'F') return c - 'A' + 10;
  return -1;
}
bool hex565(const char* s, uint16_t* out) {
  int v[6];
  for (int i = 0; i < 6; i++) { v[i] = hexv(s[i]); if (v[i] < 0) return false; }
  *out = C565(v[0] * 16 + v[1], v[2] * 16 + v[3], v[4] * 16 + v[5]);
  return true;
}

// Clave de Preferences para el record de un juego (hash FNV-1a del id)
void claveRec(const char* id, char* k) {
  uint32_t h = 2166136261UL;
  for (const char* p = id; *p; p++) { h ^= (uint8_t)*p; h *= 16777619UL; }
  snprintf(k, 12, "h%08lx", (unsigned long)h);
}

// Siguiente linea: devuelve su inicio y deja en *len su largo sin \r\n; avanza *p. nullptr = fin
const char* linea(const char** p, int* len) {
  const char* s = *p;
  if (!*s) return nullptr;
  const char* e = s;
  while (*e && *e != '\n') e++;
  int l = e - s;
  if (l > 0 && s[l - 1] == '\r') l--;
  *len = l;
  *p = *e ? e + 1 : e;
  return s;
}

// Valor de una clave de la cabecera (antes del primer '['), copiado en out. false si no esta.
bool valor(const char* b, const char* clave, char* out, int cap) {
  const char* p = b;
  int l;
  size_t kl = strlen(clave);
  const char* s;
  while ((s = linea(&p, &l)) != nullptr) {
    if (l > 0 && s[0] == '[') return false;
    if ((size_t)l > kl && strncmp(s, clave, kl) == 0 && s[kl] == '=') {
      int vl = l - kl - 1;
      if (vl >= cap) vl = cap - 1;
      memcpy(out, s + kl + 1, vl);
      out[vl] = 0;
      return true;
    }
  }
  return false;
}
int valorInt(const char* b, const char* clave, int def) {
  char t[12];
  if (!valor(b, clave, t, sizeof(t))) return def;
  return atoi(t);
}

// Lee la cabecera. b debe terminar en 0. true si es valida.
bool cabecera(const char* b, Desc& d) {
  if (strncmp(b, "ARCGAME1", 8) != 0 || (b[8] != '\n' && b[8] != '\r')) return false;
  char t[200];
  if (!valor(b, "tipo", t, sizeof(t))) return false;
  if (!strcmp(t, "sokoban")) d.tipo = 1; else if (!strcmp(t, "snake")) d.tipo = 2; else return false;
  if (!valor(b, "titulo", t, sizeof(t))) return false;
  size_t l = strlen(t);
  if (l < 1 || l > 8) return false;
  for (size_t i = 0; i < l; i++) {
    char c = t[i];
    if (c >= 'a' && c <= 'z') c -= 32;
    if (!((c >= 'A' && c <= 'Z') || (c >= '0' && c <= '9') || c == ' ' || c == '-')) return false;
    d.titulo[i] = c;
  }
  d.titulo[l] = 0;
  if (!valor(b, "color", t, sizeof(t)) || strlen(t) != 6 || !hex565(t, &d.color)) return false;
  d.portada[0] = 0;
  if (valor(b, "portada", t, sizeof(t))) {
    if (strlen(t) >= sizeof(d.portada)) return false;
    for (const char* q = t; *q; q++) {
      char c = *q;
      if (!((c >= '0' && c <= '9') || (c >= 'a' && c <= 'f') || (c >= 'A' && c <= 'F') ||
            c == ',' || c == ';' || c == 'r' || c == 'c' || c == 'l' || c == 't')) return false;
    }
    strcpy(d.portada, t);
  }
  return true;
}

// Copia el nivel k (0..) a filas[ARC_DIM][ARC_DIM + 1]; rellena con '#'. false si no existe o es invalido.
bool nivel(const char* b, int k, char filas[ARC_DIM][ARC_DIM + 1], int* w, int* h) {
  const char* p = b;
  int l, cuenta = -1;
  const char* s;
  *w = 0; *h = 0;
  bool dentro = false;
  while ((s = linea(&p, &l)) != nullptr) {
    if (l > 0 && s[0] == '[') {
      if (dentro) break;
      if (l == 7 && strncmp(s, "[nivel]", 7) == 0) { cuenta++; dentro = (cuenta == k); }
      continue;
    }
    if (!dentro) continue;
    if (l == 0) { if (*h > 0) break; else continue; }
    if (l > ARC_DIM || *h >= ARC_DIM) return false;
    memcpy(filas[*h], s, l);
    filas[*h][l] = 0;
    if (l > *w) *w = l;
    (*h)++;
  }
  if (!dentro || *w < 3 || *h < 3) return false;
  for (int r = 0; r < *h; r++) {
    int l2 = strlen(filas[r]);
    for (int c = l2; c < *w; c++) filas[r][c] = '#';
    filas[r][*w] = 0;
  }
  return true;
}

int contarNiveles(const char* b) {
  const char* p = b;
  int l, c = 0;
  const char* s;
  while ((s = linea(&p, &l)) != nullptr)
    if (l == 7 && strncmp(s, "[nivel]", 7) == 0) c++;
  return c;
}

// Validacion completa de un archivo descargado (b termina en 0, len = bytes). 0 = ok
//  1 = formato general, 2 = cabecera, 3 = niveles
int validar(const char* b, int len, Desc& d) {
  if (len < 20 || len > ARC_MAX_BYTES) return 1;
  for (int i = 0; i < len; i++) {
    uint8_t c = b[i];
    if (c == '\n' || c == '\r') continue;
    if (c < 32 || c > 126) return 1;
  }
  if (strlen(b) != (size_t)len) return 1;
  const char* c1 = strchr(b, '[');
  if (!c1 || c1 - b > 600) return 2;
  if (!cabecera(b, d)) return 2;
  if (d.tipo == 2) {
    int v = valorInt(b, "vel", 150), m = valorInt(b, "meta", 8);
    if (v < 60 || v > 500 || m < 3 || m > 50) return 2;
  }
  int nn = contarNiveles(b);
  if (nn < 1 || nn > ARC_MAX_NIV) return 3;
  static char f[ARC_DIM][ARC_DIM + 1];
  for (int k = 0; k < nn; k++) {
    int w, h;
    if (!nivel(b, k, f, &w, &h)) return 3;
    int jug = 0, cajas = 0, metas = 0, libres = 0;
    for (int r = 0; r < h; r++) for (int c = 0; c < w; c++) {
      char ch = f[r][c];
      if (d.tipo == 1) {
        if (!strchr("#@+$.* ", ch)) return 3;
        if (ch == '@' || ch == '+') jug++;
        if (ch == '$' || ch == '*') cajas++;
        if (ch == '.' || ch == '*' || ch == '+') metas++;
      } else {
        if (!strchr("#S. ", ch)) return 3;
        if (ch == 'S') jug++;
        if (ch != '#') libres++;
      }
    }
    if (jug != 1) return 3;
    if (d.tipo == 1 && (cajas < 1 || cajas != metas)) return 3;
    if (d.tipo == 2 && libres < 8) return 3;
  }
  return 0;
}

int buscar(const char* id) {
  for (int i = 0; i < n; i++) if (!strcmp(desc[i].id, id)) return i;
  return -1;
}

// Lee /g y reconstruye la lista de juegos instalados (ordenada por id)
void indexar() {
  n = 0;
  if (!montar()) return;
  File dir = LittleFS.open("/g");
  if (!dir) return;
  File f;
  while ((f = dir.openNextFile()) && n < ARC_MAX_DESC) {
    if (f.isDirectory()) { f.close(); continue; }
    String nm = f.name();
    if (!nm.endsWith(".agm")) { f.close(); continue; }
    nm = nm.substring(0, nm.length() - 4);
    char b[704];
    int k = f.read((uint8_t*)b, 700);
    f.close();
    if (k < 20 || nm.length() > 24) continue;
    b[k] = 0;
    Desc d;
    memset(&d, 0, sizeof(d));
    strcpy(d.id, nm.c_str());
    if (!idValido(d.id) || !cabecera(b, d)) continue;
    desc[n++] = d;
  }
  dir.close();
  for (int i = 1; i < n; i++)                          // orden por id (insercion)
    for (int j = i; j > 0 && strcmp(desc[j - 1].id, desc[j].id) > 0; j--) {
      Desc t = desc[j]; desc[j] = desc[j - 1]; desc[j - 1] = t;
    }
}

// Guarda un archivo ya validado. 0 = ok, 1 = sin espacio, 2 = error al escribir
int guardar(const char* id, const uint8_t* b, int len) {
  if (!montar()) return 2;
  if (LittleFS.totalBytes() - LittleFS.usedBytes() < (size_t)len + 4096) return 1;
  char ruta[40];
  snprintf(ruta, sizeof(ruta), "/g/%s.agm", id);
  File f = LittleFS.open(ruta, "w");
  if (!f) return 2;
  size_t w = f.write(b, len);
  f.close();
  if (w != (size_t)len) { LittleFS.remove(ruta); return 2; }
  return 0;
}

void borrar(const char* id) {
  char ruta[40];
  snprintf(ruta, sizeof(ruta), "/g/%s.agm", id);
  LittleFS.remove(ruta);
  char k[12]; claveRec(id, k);
  prefsA.remove(k);
  indexar();
}

// Carga el archivo completo en memoria (liberar con free). nullptr si falla.
char* cargar(const char* id, int* len) {
  char ruta[40];
  snprintf(ruta, sizeof(ruta), "/g/%s.agm", id);
  File f = LittleFS.open(ruta, "r");
  if (!f) return nullptr;
  int sz = f.size();
  if (sz < 20 || sz > ARC_MAX_BYTES) { f.close(); return nullptr; }
  char* b = (char*)malloc(sz + 1);
  if (!b) { f.close(); return nullptr; }
  int k = f.read((uint8_t*)b, sz);
  f.close();
  if (k != sz) { free(b); return nullptr; }
  b[sz] = 0;
  *len = sz;
  return b;
}

// Dibuja la portada (lienzo 80x80) a partir de la cadena "portada"
void portada(const Desc& d, GFXcanvas16* c) {
  c->fillScreen(mezclar565(d.color, 0x0000, 215));
  if (!d.portada[0]) {                                // portada por defecto segun el tipo
    uint16_t col = d.color;
    if (d.tipo == 1) {
      c->fillRect(18, 38, 18, 18, col); c->drawRect(18, 38, 18, 18, 0xFFFF);
      c->fillRect(44, 22, 18, 18, col); c->drawRect(44, 22, 18, 18, 0xFFFF);
      c->fillCircle(54, 58, 6, 0xFFFF);
    } else {
      for (int i = 0; i < 6; i++) c->fillRect(12 + i * 8, 44 - (i % 2) * 6, 8, 8, i == 5 ? 0xFFFF : col);
      c->fillCircle(66, 24, 5, C_RED);
    }
    return;
  }
  char tmp[200];
  strcpy(tmp, d.portada);
  char* p = tmp;
  for (int it = 0; it < 24 && *p; it++) {
    char* fin = strchr(p, ';');
    if (fin) *fin = 0;
    char* campos[9];
    int nc = 0;
    char* q = p;
    while (nc < 9) {
      campos[nc++] = q;
      char* co = strchr(q, ',');
      if (!co) break;
      *co = 0; q = co + 1;
    }
    if (nc >= 5) {
      uint16_t col;
      char tipo = campos[0][0];
      int v[8];
      for (int i = 1; i < nc - 1; i++) v[i - 1] = atoi(campos[i]);
      if (strlen(campos[nc - 1]) == 6 && hex565(campos[nc - 1], &col)) {
        if (tipo == 'r' && nc == 6)      c->fillRect(v[0], v[1], v[2], v[3], col);
        else if (tipo == 'c' && nc == 5) c->fillCircle(v[0], v[1], v[2], col);
        else if (tipo == 'l' && nc == 6) c->drawLine(v[0], v[1], v[2], v[3], col);
        else if (tipo == 't' && nc == 8) c->fillTriangle(v[0], v[1], v[2], v[3], v[4], v[5], col);
      }
    }
    if (!fin) break;
    p = fin + 1;
  }
}

}  // namespace agm

// ===== fin de juegos_datos.h =====

// ===== inicio de red_descarga.h =====
// =====================================================================
//  WiFi + descarga HTTPS. Solo se enciende en la pantalla AGREGAR JUEGO
//  y se apaga siempre al terminar.
//
//  >>> EDITA ESTAS CUATRO LINEAS <<<
// =====================================================================
#define ARC_HOST   "TU-USUARIO.github.io"      // dominio donde alojas los .agm (sin https://)
#define ARC_RUTA   "/arcade/"                  // carpeta; URL final: https://HOST/RUTA/<id>.agm
#define ARC_TLS_SIN_VERIFICAR 0                // 1 = NO validar el certificado (solo para pruebas)
static const char ARC_CA_PEM[] =               // CA raiz del dominio en formato PEM (si validas el certificado)
  "";
const char* const DOMINIOS_OK[] = { ARC_HOST };   // lista blanca: agrega aqui otros dominios permitidos

namespace red {

Preferences pw;

bool leerCred(char* ssid, char* pass) {
  ssid[0] = 0; pass[0] = 0;
  pw.begin("wifi", false);
  pw.getString("ssid", ssid, 33);
  pw.getString("pass", pass, 64);
  pw.end();
  return ssid[0] != 0;
}
void guardarCred(const char* s, const char* p) {
  pw.begin("wifi", false);
  pw.putString("ssid", s);
  pw.putString("pass", p);
  pw.end();
}

void apagar() {
  WiFi.disconnect(true);
  WiFi.mode(WIFI_OFF);
}

// 0 = ok, 1 = sin credenciales, 2 = no conecta, 3 = sin hora (necesaria para validar el certificado)
int conectar(void (*tick)()) {
  char s[33], p[64];
  if (!leerCred(s, p)) return 1;
  WiFi.persistent(false);
  WiFi.mode(WIFI_STA);
  WiFi.begin(s, p);
  uint32_t t = millis();
  while (WiFi.status() != WL_CONNECTED) {
    if (millis() - t > 15000) { apagar(); return 2; }
    if (tick) tick();
    delay(20);
  }
#if !ARC_TLS_SIN_VERIFICAR
  configTime(0, 0, "pool.ntp.org", "time.google.com");
  t = millis();
  while (time(nullptr) < 1700000000) {
    if (millis() - t > 10000) { apagar(); return 3; }
    if (tick) tick();
    delay(20);
  }
#endif
  return 0;
}

// Buffer en RAM con tope: write() devuelve 0 si se pasa del limite
class Buf : public Stream {
 public:
  uint8_t* d = nullptr;
  size_t   cap = 0, n = 0;
  int      tot = 0;
  void   (*prog)(int) = nullptr;
  size_t write(uint8_t c) override { if (n >= cap) return 0; d[n++] = c; return 1; }
  size_t write(const uint8_t* b, size_t k) override {
    if (n + k > cap) return 0;
    memcpy(d + n, b, k); n += k;
    if (prog && tot > 0) prog((int)(n * 100 / tot));
    return k;
  }
  int available() override { return 0; }
  int read() override { return -1; }
  int peek() override { return -1; }
};

// Descarga una URL https permitida. 0 = ok; si no:
//  10 URL no valida, 11 dominio no permitido, 12 sin conexion/TLS, 13 respuesta HTTP != 200,
//  14 archivo demasiado grande, 15 descarga incompleta, 16 falta la CA del certificado
int descargar(const char* url, uint8_t* dst, size_t cap, size_t* nOut, int* httpCode, void (*prog)(int)) {
  if (strlen(url) > 200 || strncmp(url, "https://", 8) != 0) return 10;
  const char* h = url + 8;
  const char* fin = h;
  while (*fin && *fin != '/') fin++;
  size_t hl = fin - h;
  if (hl == 0 || hl > 60 || *fin != '/') return 10;
  for (size_t k = 0; k < hl; k++)
    if (h[k] == ':' || h[k] == '@' || h[k] == '?' || h[k] == '#' || h[k] == '\\') return 10;
  bool ok = false;
  for (size_t i = 0; i < sizeof(DOMINIOS_OK) / sizeof(DOMINIOS_OK[0]); i++)
    if (strlen(DOMINIOS_OK[i]) == hl && strncasecmp(DOMINIOS_OK[i], h, hl) == 0) ok = true;
  if (!ok) return 11;

  WiFiClientSecure cli;
#if ARC_TLS_SIN_VERIFICAR
  cli.setInsecure();
#else
  if (!ARC_CA_PEM[0]) return 16;
  cli.setCACert(ARC_CA_PEM);
#endif
  HTTPClient http;
  http.setFollowRedirects(HTTPC_DISABLE_FOLLOW_REDIRECTS);
  http.setConnectTimeout(8000);
  http.setTimeout(10000);
  if (!http.begin(cli, url)) return 12;
  int code = http.GET();
  *httpCode = code;
  if (code <= 0) { http.end(); return 12; }
  if (code != 200) { http.end(); return 13; }
  int tot = http.getSize();
  if (tot > (int)cap) { http.end(); return 14; }
  Buf b;
  b.d = dst; b.cap = cap; b.tot = tot; b.prog = prog;
  int r = http.writeToStream(&b);
  http.end();
  if (b.n >= cap && r < 0) return 14;
  if (r < 0 || b.n == 0 || (tot > 0 && b.n != (size_t)tot)) return 15;
  *nOut = b.n;
  return 0;
}

}  // namespace red

// ===== fin de red_descarga.h =====


// ===== inicio de motor_sokoban.h =====
// =====================================================================
//  MOTOR SOKOBAN: ejecuta los niveles de un .agm de tipo sokoban.
//  Flechas = mover, OK = pausa (OK sigue, ARRIBA reinicia el nivel, IZQ sale)
// =====================================================================
namespace sok {

const int CEL = 12;
uint8_t t[ARC_DIM][ARC_DIM];          // bit0 pared, bit1 meta, bit2 caja
int w, h, px, py, ox, oy, pasos;
uint16_t cCaja, cAc;

void celda(int c, int r) {
  int x = ox + c * CEL, y = oy + r * CEL;
  uint8_t v = t[r][c];
  tft.fillRect(x, y, CEL, CEL, NEGRO);
  if (v & 1) {
    tft.fillRect(x, y, CEL, CEL, SK.wallFill);
    tft.drawRect(x, y, CEL, CEL, SK.wallLine);
  } else {
    if (v & 2) tft.fillRect(x + 4, y + 4, 4, 4, SK.dot);
    if (v & 4) {
      uint16_t cc = (v & 2) ? aclarar(cCaja) : cCaja;
      tft.fillRect(x + 1, y + 1, CEL - 2, CEL - 2, cc);
      tft.drawRect(x + 1, y + 1, CEL - 2, CEL - 2, oscurecer(cc));
    }
  }
  if (c == px && r == py) tft.fillCircle(x + 6, y + 6, 4, SK.pac);
}
void hud(int k, int total) {
  char b[24];
  tft.fillRect(60, 18, 120, 12, NEGRO);
  snprintf(b, sizeof(b), "NIVEL %d/%d", k + 1, total);
  printC(b, 22, 1, cAc);
  tft.fillRect(60, 204, 120, 12, NEGRO);
  snprintf(b, sizeof(b), "PASOS %d", pasos);
  printC(b, 206, 1, BLANCO);
}
void dibujarTodo(int k, int total) {
  tft.fillScreen(NEGRO);
  for (int r = 0; r < h; r++) for (int c = 0; c < w; c++) celda(c, r);
  hud(k, total);
}
bool cargar(const char* b, int k) {
  static char f[ARC_DIM][ARC_DIM + 1];
  if (!agm::nivel(b, k, f, &w, &h)) return false;
  for (int r = 0; r < h; r++) for (int c = 0; c < w; c++) {
    char ch = f[r][c];
    uint8_t v = 0;
    if (ch == '#') v = 1;
    else if (ch == '.') v = 2;
    else if (ch == '$') v = 4;
    else if (ch == '*') v = 6;
    else if (ch == '+') { v = 2; px = c; py = r; }
    else if (ch == '@') { px = c; py = r; }
    t[r][c] = v;
  }
  ox = (240 - w * CEL) / 2;
  oy = (240 - h * CEL) / 2;
  pasos = 0;
  return true;
}
bool resuelto() {
  for (int r = 0; r < h; r++) for (int c = 0; c < w; c++)
    if ((t[r][c] & 4) && !(t[r][c] & 2)) return false;
  return true;
}
bool mover(int dx, int dy) {
  int nx = px + dx, ny = py + dy;
  if (nx < 0 || ny < 0 || nx >= w || ny >= h || (t[ny][nx] & 1)) return false;
  if (t[ny][nx] & 4) {
    int bx = nx + dx, by = ny + dy;
    if (bx < 0 || by < 0 || bx >= w || by >= h || (t[by][bx] & 5)) return false;
    t[ny][nx] &= ~4;
    t[by][bx] |= 4;
    int ox0 = px, oy0 = py;
    px = nx; py = ny;
    celda(ox0, oy0); celda(nx, ny); celda(bx, by);
    click();
  } else {
    int ox0 = px, oy0 = py;
    px = nx; py = ny;
    celda(ox0, oy0); celda(nx, ny);
  }
  pasos++;
  return true;
}
// 0 = seguir, 1 = reiniciar nivel, 2 = salir
int pausa() {
  buzz(0);
  tft.fillRoundRect(40, 84, 160, 78, 6, NEGRO);
  tft.drawRoundRect(40, 84, 160, 78, 6, cAc);
  printC("PAUSA", 90, 2, cAc);
  printC("OK: SEGUIR", 114, 1, BLANCO);
  printC("^: REINICIAR", 128, 1, BLANCO);
  printC("<: SALIR", 142, 1, BLANCO);
  clearPresses();
  for (;;) {
    uint32_t now = millis();
    readButtons(now);
    updateSound(now);
    if (btnPress[B_OK])   { clearPresses(); return 0; }
    if (btnPress[B_UP])   { clearPresses(); return 1; }
    if (btnPress[B_LEFT]) { clearPresses(); return 2; }
    clearPresses();
    delay(5);
  }
}

// Juega los niveles. Devuelve cuantos se superaron en esta partida.
int partida(const char* b, int total, uint16_t ac) {
  cAc = ac;
  cCaja = skinTinte(ac);
  int hecho = 0;
  int k = 0;
  while (k < total) {
    if (!cargar(b, k)) return hecho;
    dibujarTodo(k, total);
    clearPresses();
    uint32_t last = 0;
    for (;;) {
      uint32_t now = millis();
      updateSound(now);
      readButtons(now);
      if (now - last < FRAME_MS) { delay(1); continue; }
      last = now;
      for (int d = 0; d < 4; d++)
        if (btnPress[d]) { if (mover(BDX[d], BDY[d])) hud(k, total); break; }
      if (btnPress[B_OK]) {
        int r = pausa();
        if (r == 2) return hecho;
        if (r == 1) { cargar(b, k); }
        dibujarTodo(k, total);
      }
      clearPresses();
      if (resuelto()) break;
    }
    playSeq(SND_LEVEL, NN(SND_LEVEL), 3);
    hecho++;
    k++;
    printC("NIVEL SUPERADO!", 104, 1, cAc);
    esperar(1100);
  }
  tft.fillScreen(NEGRO);
  printC("COMPLETADO!", 100, 2, cAc);
  playSeq(SND_LEVEL, NN(SND_LEVEL), 3);
  esperar(2000);
  return hecho;
}

}  // namespace sok

// ===== fin de motor_sokoban.h =====


// ===== inicio de motor_snake.h =====
// =====================================================================
//  MOTOR SNAKE: ejecuta los mapas de un .agm de tipo snake.
//  Flechas = girar, OK = pausa (en pausa: OK sigue, IZQ sale)
// =====================================================================
namespace snk {

const int CEL = 12;
const int MAXC = ARC_DIM * ARC_DIM;
uint8_t pared[ARC_DIM][ARC_DIM];
uint8_t ocup[ARC_DIM][ARC_DIM];
uint8_t sx[MAXC], sy[MAXC];
int w, h, ox, oy, cola, cabeza, largo, dir, mx, my;
uint32_t puntos;
uint16_t cAc;

void celda(int c, int r, uint16_t col) {
  tft.fillRect(ox + c * CEL + 1, oy + r * CEL + 1, CEL - 2, CEL - 2, col);
}
void borrarCelda(int c, int r) { tft.fillRect(ox + c * CEL, oy + r * CEL, CEL, CEL, NEGRO); }
void hud(int niv, int comidas, int meta) {
  char b[24];
  tft.fillRect(60, 18, 120, 12, NEGRO);
  snprintf(b, sizeof(b), "PUNTOS %lu", (unsigned long)puntos);
  printC(b, 22, 1, cAc);
  tft.fillRect(60, 204, 120, 12, NEGRO);
  snprintf(b, sizeof(b), "NIV %d  %d/%d", niv + 1, comidas, meta);
  printC(b, 206, 1, BLANCO);
}
void dibujarTodo(int niv, int comidas, int meta) {
  tft.fillScreen(NEGRO);
  for (int r = 0; r < h; r++) for (int c = 0; c < w; c++)
    if (pared[r][c]) {
      tft.fillRect(ox + c * CEL, oy + r * CEL, CEL, CEL, SK.wallFill);
      tft.drawRect(ox + c * CEL, oy + r * CEL, CEL, CEL, SK.wallLine);
    }
  for (int i = 0, k = cola; i < largo; i++, k = (k + 1) % MAXC)
    celda(sx[k], sy[k], (i == largo - 1) ? aclarar(cAc) : cAc);
  if (mx >= 0) tft.fillCircle(ox + mx * CEL + 6, oy + my * CEL + 6, 4, C_RED);
  hud(niv, comidas, meta);
}
bool libre(int c, int r) { return c >= 0 && r >= 0 && c < w && r < h && !pared[r][c] && !ocup[r][c]; }
bool nuevaManzana() {
  int libres = 0;
  for (int r = 0; r < h; r++) for (int c = 0; c < w; c++) if (libre(c, r)) libres++;
  if (!libres) { mx = -1; return false; }
  int k = random(libres);
  for (int r = 0; r < h; r++) for (int c = 0; c < w; c++)
    if (libre(c, r) && k-- == 0) { mx = c; my = r; return true; }
  return false;
}
bool cargar(const char* b, int k) {
  static char f[ARC_DIM][ARC_DIM + 1];
  if (!agm::nivel(b, k, f, &w, &h)) return false;
  int hx = 0, hy = 0;
  memset(ocup, 0, sizeof(ocup));
  for (int r = 0; r < h; r++) for (int c = 0; c < w; c++) {
    pared[r][c] = (f[r][c] == '#');
    if (f[r][c] == 'S') { hx = c; hy = r; }
  }
  ox = (240 - w * CEL) / 2;
  oy = (240 - h * CEL) / 2;
  // direccion inicial: 0 arriba, 1 abajo, 2 izq, 3 der; busca una con 2 celdas libres detras
  int mejor = -1;
  for (int d = 3; d >= 0 && mejor < 0; d--) {
    int dx = BDX[d], dy = BDY[d];
    int ax = hx + dx, ay = hy + dy;
    if (ax < 0 || ay < 0 || ax >= w || ay >= h || pared[ay][ax]) continue;
    int b1x = hx - dx, b1y = hy - dy, b2x = hx - 2 * dx, b2y = hy - 2 * dy;
    bool ok1 = b1x >= 0 && b1y >= 0 && b1x < w && b1y < h && !pared[b1y][b1x];
    bool ok2 = b2x >= 0 && b2y >= 0 && b2x < w && b2y < h && !pared[b2y][b2x];
    if (ok1 && ok2) mejor = d;
  }
  if (mejor < 0) {                                    // sin espacio detras: empieza con largo 1
    for (int d = 3; d >= 0 && mejor < 0; d--) {
      int ax = hx + BDX[d], ay = hy + BDY[d];
      if (ax >= 0 && ay >= 0 && ax < w && ay < h && !pared[ay][ax]) mejor = d;
    }
    if (mejor < 0) return false;
    dir = mejor; largo = 1; cola = 0; cabeza = 0;
    sx[0] = hx; sy[0] = hy; ocup[hy][hx] = 1;
  } else {
    dir = mejor;
    int dx = BDX[dir], dy = BDY[dir];
    largo = 3; cola = 0; cabeza = 2;
    sx[0] = hx - 2 * dx; sy[0] = hy - 2 * dy;
    sx[1] = hx - dx;     sy[1] = hy - dy;
    sx[2] = hx;          sy[2] = hy;
    for (int i = 0; i < 3; i++) ocup[sy[i]][sx[i]] = 1;
  }
  nuevaManzana();
  return true;
}

// Devuelve true si el jugador perdio, false si salio con la pausa
bool partida(const char* b, int total, uint16_t ac) {
  cAc = skinTinte(ac);
  int velBase = agm::valorInt(b, "vel", 150);
  int meta = agm::valorInt(b, "meta", 8);
  puntos = 0;
  int niv = 0, vuelta = 0;
  for (;;) {
    int k = niv % total;
    if (!cargar(b, k)) return false;
    int comidas = 0;
    float paso = velBase * DIF_PCT[diffIdx] / 100.0f;
    for (int i = 0; i < vuelta; i++) paso *= 0.9f;
    if (paso < 50) paso = 50;
    dibujarTodo(niv, comidas, meta);
    clearPresses();
    int pend = dir;
    uint32_t tPaso = millis() + 400;
    for (;;) {
      uint32_t now = millis();
      updateSound(now);
      readButtons(now);
      for (int d = 0; d < 4; d++)
        if (btnPress[d] && !(BDX[d] == -BDX[dir] && BDY[d] == -BDY[dir])) pend = d;
      if (btnPress[B_OK]) {
        if (menuPausa(ac)) return false;
        dibujarTodo(niv, comidas, meta);
        tPaso = millis() + 300;
      }
      clearPresses();
      if ((int32_t)(now - tPaso) < 0) { delay(1); continue; }
      tPaso = now + (uint32_t)paso;
      dir = pend;
      int hx = sx[cabeza], hy = sy[cabeza];
      int nx = hx + BDX[dir], ny = hy + BDY[dir];
      bool come = (nx == mx && ny == my);
      int colaX = sx[cola], colaY = sy[cola];
      bool choque = (nx < 0 || ny < 0 || nx >= w || ny >= h || pared[ny][nx] ||
                     (ocup[ny][nx] && !(nx == colaX && ny == colaY && !come)));
      if (choque) {
        playSeq(SND_DEATH, NN(SND_DEATH), 3);
        for (int i = 0, kk = cola; i < largo; i++, kk = (kk + 1) % MAXC) celda(sx[kk], sy[kk], C_RED);
        esperar(700);
        return true;
      }
      if (!come) {                                    // la cola avanza
        ocup[colaY][colaX] = 0;
        borrarCelda(colaX, colaY);
        cola = (cola + 1) % MAXC;
        largo--;
      }
      celda(hx, hy, cAc);
      cabeza = (cabeza + 1) % MAXC;
      sx[cabeza] = nx; sy[cabeza] = ny;
      ocup[ny][nx] = 1;
      largo++;
      celda(nx, ny, aclarar(cAc));
      if (come) {
        puntos += 10;
        comidas++;
        playSeq(SND_LIFE, NN(SND_LIFE), 2);
        bool hay = nuevaManzana();
        if (hay) tft.fillCircle(ox + mx * CEL + 6, oy + my * CEL + 6, 4, C_RED);
        hud(niv, comidas, meta);
        if (comidas >= meta || !hay) break;
      }
    }
    puntos += 50;
    playSeq(SND_LEVEL, NN(SND_LEVEL), 3);
    printC("NIVEL SUPERADO!", 104, 1, cAc);
    esperar(1100);
    niv++;
    if (niv % total == 0) vuelta++;                   // al dar la vuelta a todos los niveles, mas rapido
  }
}

}  // namespace snk

// ===== fin de motor_snake.h =====


// ===== inicio de motor_juegos.h =====
// Lanza un juego descargado (tipo sokoban / snake) con su menu JUGAR / OPCIONES de siempre
namespace mot {

int sel = 0;                       // indice en agm::desc

void jugar() {
  if (sel < 0 || sel >= agm::n) return;
  agm::Desc d = agm::desc[sel];
  int len = 0;
  char* b = agm::cargar(d.id, &len);
  if (!b) {
    tft.fillScreen(NEGRO);
    printC("ARCHIVO ILEGIBLE", 104, 1, C_RED);
    esperar(1500);
    return;
  }
  int total = agm::contarNiveles(b);
  char key[12];
  agm::claveRec(d.id, key);
  uint32_t rec = prefsA.getUInt(key, 0);
  for (;;) {
    rec = prefsA.getUInt(key, 0);
    if (!menuJuego(d.titulo, d.color, rec, d.tipo == 1 ? 0 : 1)) break;
    if (d.tipo == 1) {
      uint32_t hecho = sok::partida(b, total, d.color);
      if (hecho > rec) prefsA.putUInt(key, hecho);
    } else {
      for (;;) {
        bool perdio = snk::partida(b, total, d.color);
        if (!perdio) break;
        bool nuevo = snk::puntos > rec;
        if (nuevo) { rec = snk::puntos; prefsA.putUInt(key, rec); }
        if (!pantallaFin(snk::puntos, rec, nuevo, skinTinte(d.color))) break;
      }
    }
  }
  free(b);
}

}  // namespace mot

// ===== fin de motor_juegos.h =====

// ===== inicio de agregar_juego.h =====
// =====================================================================
//  PANTALLA "AGREGAR JUEGO" (la ultima caratula del arcade)
//  Espera una etiqueta NFC y, segun lo que lleve:
//    - texto  WIFI:S:red;P:clave;;   -> guarda las credenciales WiFi
//    - texto  ID  (o  juego:ID)      -> descarga https://HOST/RUTA/ID.agm
//    - URI    https://...            -> descarga esa URL (dominio permitido)
//  Controles: IZQUIERDA sale, ARRIBA abre BORRAR JUEGO.
// =====================================================================
namespace agr {

const uint16_t AC = C565(255, 170, 30);
const uint16_t GRIS = C565(150, 150, 150);
int selNuevo = -1;               // indice (en agm::desc) del juego recien instalado
const char* eA = "";
const char* eB = "";
char eBuf[28];

enum { K_NADA, K_WIFI, K_ID, K_URL };

// ---------- dibujo ----------
void anillo(int pct, int giro) {
  for (int k = 0; k < 36; k++) {
    float a = (-90 + k * 10) * 0.0174533f;
    int x = 120 + (int)(46 * cosf(a)), y = 100 + (int)(46 * sinf(a));
    bool on;
    if (pct >= 0) on = k < pct * 36 / 100;
    else          on = ((giro - k + 36) % 36) < 8;
    tft.fillCircle(x, y, 3, on ? AC : C565(50, 36, 0));
  }
}
void trabajo(const char* t1, const char* t2) {
  tft.fillScreen(NEGRO);
  anillo(0, 0);
  printC(t1, 96, 1, BLANCO);
  printC(t2, 164, 1, GRIS);
}
void tickRed() {
  static uint32_t t = 0;
  static int g = 0;
  updateSound(millis());
  if (millis() - t > 90) { t = millis(); g = (g + 1) % 36; anillo(-1, g); }
}
void progCb(int pct) {
  static int ult = -1;
  if (pct < ult) ult = -1;
  if (pct / 3 != ult) { ult = pct / 3; anillo(pct, 0); }
  updateSound(millis());
}
void icono(bool ok, uint16_t col) {
  tft.drawCircle(120, 80, 34, col);
  tft.drawCircle(120, 80, 33, col);
  for (int o = -1; o <= 1; o++) {
    if (ok) {
      tft.drawLine(104, 80 + o, 116, 92 + o, col);
      tft.drawLine(116, 92 + o, 138, 66 + o, col);
    } else {
      tft.drawLine(106, 66 + o, 134, 94 + o, col);
      tft.drawLine(134, 66 + o, 106, 94 + o, col);
    }
  }
}
void textos(const char* a, const char* b, uint16_t col) {
  printC(a, 128, strlen(a) <= 14 ? 2 : 1, col);
  printC(b, 152, 1, BLANCO);
}
void exito(const char* a, const char* b) {
  tft.fillScreen(NEGRO);
  icono(true, AC);
  textos(a, b, AC);
  playSeq(SND_LEVEL, NN(SND_LEVEL), 3);
  esperar(1800);
}
// Pantalla de error. true = reintentar (OK), false = salir (IZQUIERDA)
bool error(const char* a, const char* b) {
  tft.fillScreen(NEGRO);
  icono(false, C_RED);
  textos(a, b, C_RED);
  printC("OK: REINTENTAR", 184, 1, BLANCO);
  printC("<: SALIR", 198, 1, BLANCO);
  playSeq(SND_OVER, NN(SND_OVER), 3);
  uint32_t t0 = millis();
  clearPresses();
  for (;;) {
    uint32_t now = millis();
    readButtons(now);
    updateSound(now);
    if (now - t0 > 600) {
      if (btnPress[B_OK])   { clearPresses(); return true; }
      if (btnPress[B_LEFT]) { clearPresses(); return false; }
    }
    clearPresses();
    delay(5);
  }
}

void fondoEspera() {
  tft.fillScreen(NEGRO);
  printC("AGREGAR JUEGO", 26, 1, AC);
  printC("ACERCA LA ETIQUETA", 156, 1, BLANCO);
  printC("AL LECTOR", 170, 1, GRIS);
  printC("^ BORRAR    < SALIR", 200, 1, GRIS);
}
// Ondas de NFC alrededor de una tarjeta (lienzo 120x100)
void animEspera(GFXcanvas16* c, int fr) {
  c->fillScreen(0);
  for (int k = 0; k < 3; k++) {
    int ph = (fr * 2 + k * 20) % 60;
    uint8_t fade = 255 - ph * 255 / 60;
    c->drawCircle(60, 50, 16 + ph, mezclar565(0x0000, AC, fade));
  }
  c->fillRoundRect(40, 38, 40, 26, 4, C565(40, 26, 0));
  c->drawRoundRect(40, 38, 40, 26, 4, AC);
  c->drawRect(46, 44, 10, 8, AC);
  c->drawFastHLine(46, 57, 28, AC);
}

// ---------- lectura de la etiqueta ----------
int clasificar(char* out) {                          // out: 170 bytes
  if (strncmp(ndef::txt, "WIFI:", 5) == 0) { strcpy(out, ndef::txt); return K_WIFI; }
  if (ndef::uri[0]) { strcpy(out, ndef::uri); return K_URL; }
  const char* t = ndef::txt;
  while (*t == ' ' || *t == '\n' || *t == '\r') t++;
  if (strncasecmp(t, "juego:", 6) == 0) t += 6;
  size_t l = strlen(t);
  while (l > 0 && (t[l - 1] == ' ' || t[l - 1] == '\n' || t[l - 1] == '\r')) l--;
  if (l < 1 || l > 24) return K_NADA;
  for (size_t i = 0; i < l; i++) out[i] = tolower((unsigned char)t[i]);
  out[l] = 0;
  return agm::idValido(out) ? K_ID : K_NADA;
}

// "WIFI:T:WPA;S:red;P:clave;;"  (formato estandar de los QR; ; , : y \ se escapan con \)
bool parseWifi(const char* s, char* ssid, char* pass) {
  ssid[0] = pass[0] = 0;
  bool exceso = false;
  s += 5;
  while (*s) {
    char k = *s;
    char* dst = nullptr;
    int cap = 0;
    if (s[1] == ':') {
      if (k == 'S') { dst = ssid; cap = 33; }
      else if (k == 'P') { dst = pass; cap = 64; }
      s += 2;
    }
    int n = 0;
    while (*s && *s != ';') {
      char c = *s++;
      if (c == '\\' && *s) c = *s++;
      if (dst) { if (n < cap - 1) dst[n++] = c; else exceso = true; }
    }
    if (dst) dst[n] = 0;
    if (*s == ';') s++;
  }
  return ssid[0] && !exceso;
}

// Saca el id del nombre del archivo de una URL (.../id.agm)
bool idDeUrl(const char* url, char* id) {
  const char* p = strchr(url + 8, '/');
  if (!p) return false;
  const char* nom = strrchr(p, '/') + 1;
  char tmp[40];
  size_t k = 0;
  while (nom[k] && nom[k] != '?' && nom[k] != '#' && k < sizeof(tmp) - 1) { tmp[k] = tolower((unsigned char)nom[k]); k++; }
  tmp[k] = 0;
  if (k < 5 || strcmp(tmp + k - 4, ".agm") != 0) return false;
  tmp[k - 4] = 0;
  if (!agm::idValido(tmp)) return false;
  strcpy(id, tmp);
  return true;
}

void esperarRetirar() {
  uint32_t t0 = millis();
  int libres = 0;
  while (millis() - t0 < 4000 && libres < 3) {
    if (rc::detectar()) { rc::detener(); libres = 0; } else libres++;
    waitMs(120);
  }
}

// ---------- descarga e instalacion ----------
bool instalar(const char* url, const char* id) {
  bool nuevo = agm::buscar(id) < 0;
  if (nuevo && agm::n >= ARC_MAX_DESC) { eA = "LISTA LLENA"; eB = "BORRA UN JUEGO CON ^"; return false; }
  if (!agm::montar()) { eA = "ERROR DE MEMORIA FLASH"; eB = "NO SE PUDO MONTAR"; return false; }
  uint8_t* buf = (uint8_t*)malloc(ARC_MAX_BYTES + 1);
  if (!buf) { eA = "SIN MEMORIA"; eB = "REINICIA EL ARCADE"; return false; }
  bool ok = false;
  trabajo("WIFI", "CONECTANDO");
  int c = red::conectar(tickRed);
  if (c == 1)      { eA = "SIN WIFI GUARDADO"; eB = "LEE LA ETIQUETA WIFI"; }
  else if (c == 2) { eA = "NO CONECTA"; eB = "REVISA LA RED Y LA CLAVE"; }
  else if (c == 3) { eA = "SIN HORA DE INTERNET"; eB = "NECESARIA PARA HTTPS"; }
  else {
    trabajo("DESCARGANDO", "ESPERA...");
    size_t n = 0;
    int hc = 0;
    int r = red::descargar(url, buf, ARC_MAX_BYTES, &n, &hc, progCb);
    red::apagar();
    switch (r) {
      case 0: break;
      case 10: eA = "URL NO VALIDA"; eB = "DEBE SER HTTPS"; break;
      case 11: eA = "DOMINIO NO PERMITIDO"; eB = "NO ESTA EN LA LISTA"; break;
      case 12: eA = "SIN CONEXION"; eB = "O FALLA EL CERTIFICADO"; break;
      case 13: snprintf(eBuf, sizeof(eBuf), "RESPUESTA HTTP %d", hc); eA = "NO SE ENCONTRO"; eB = eBuf; break;
      case 14: eA = "ARCHIVO MUY GRANDE"; eB = "MAXIMO 12 KB"; break;
      case 15: eA = "DESCARGA INCOMPLETA"; eB = "INTENTA DE NUEVO"; break;
      default: eA = "FALTA EL CERTIFICADO"; eB = "VER ARC_CA_PEM EN EL CODIGO"; break;
    }
    if (r == 0) {
      buf[n] = 0;
      agm::Desc d;
      memset(&d, 0, sizeof(d));
      strcpy(d.id, id);
      int v = agm::validar((const char*)buf, (int)n, d);
      if (v == 1)      { eA = "ARCHIVO INVALIDO"; eB = "FORMATO NO RECONOCIDO"; }
      else if (v == 2) { eA = "CABECERA INVALIDA"; eB = "REVISA TIPO, TITULO, COLOR"; }
      else if (v == 3) { eA = "NIVELES INVALIDOS"; eB = "REVISA LOS MAPAS"; }
      else {
        int g = agm::guardar(id, buf, (int)n);
        if (g == 1)      { eA = "SIN ESPACIO"; eB = "BORRA UN JUEGO CON ^"; }
        else if (g == 2) { eA = "ERROR AL GUARDAR"; eB = "INTENTA DE NUEVO"; }
        else {
          agm::indexar();
          selNuevo = agm::buscar(id);
          exito("JUEGO AGREGADO", d.titulo);
          ok = true;
        }
      }
    }
  }
  red::apagar();
  free(buf);
  return ok;
}

// ---------- borrar juegos ----------
void pintarBorrar(int i) {
  tft.fillScreen(NEGRO);
  printC("BORRAR JUEGO", 30, 1, C_RED);
  printC(agm::desc[i].titulo, 86, 3, agm::desc[i].color);
  char b[24];
  snprintf(b, sizeof(b), "%d / %d", i + 1, agm::n);
  printC(b, 124, 1, GRIS);
  printC("< > ELEGIR   OK BORRAR", 160, 1, BLANCO);
  printC("^ VOLVER", 176, 1, GRIS);
}
void menuBorrar() {
  if (agm::n == 0) {
    tft.fillScreen(NEGRO);
    printC("NO HAY JUEGOS", 104, 1, GRIS);
    esperar(1200);
    return;
  }
  int i = 0;
  pintarBorrar(i);
  clearPresses();
  for (;;) {
    uint32_t now = millis();
    readButtons(now);
    updateSound(now);
    if (btnPress[B_UP]) { click(); clearPresses(); return; }
    if (btnPress[B_LEFT])  { click(); i = (i + agm::n - 1) % agm::n; pintarBorrar(i); }
    if (btnPress[B_RIGHT]) { click(); i = (i + 1) % agm::n; pintarBorrar(i); }
    if (btnPress[B_OK]) {
      click();
      tft.fillScreen(NEGRO);
      char b[24];
      snprintf(b, sizeof(b), "BORRAR %s?", agm::desc[i].titulo);
      printC(b, 96, 2, C_RED);
      printC("OK: SI     <: NO", 140, 1, BLANCO);
      clearPresses();
      bool decidido = false, si = false;
      while (!decidido) {
        readButtons(millis());
        updateSound(millis());
        if (btnPress[B_OK])   { decidido = true; si = true; }
        if (btnPress[B_LEFT]) { decidido = true; }
        clearPresses();
        delay(5);
      }
      if (si) {
        char id[25];
        strcpy(id, agm::desc[i].id);
        agm::borrar(id);
        tft.fillScreen(NEGRO);
        printC("BORRADO", 104, 2, AC);
        esperar(1000);
        return;
      }
      pintarBorrar(i);
    }
    clearPresses();
    delay(5);
  }
}

// ---------- flujo principal ----------
// Devuelve 0 = seguir esperando, 1 = salir de la pantalla
int err(const char* a, const char* b) {
  bool otra = error(a, b);
  esperarRetirar();
  return otra ? 0 : 1;
}

int procesar() {
  int r = rc::leerNdef();
  rc::detener();
  if (r == -2) return err("ETIQUETA NO VALIDA", "USA NTAG213 / NTAG215");
  if (r == -1) return err("ERROR DE LECTURA", "ACERCA MAS LA ETIQUETA");
  if (r == 0)  return err("ETIQUETA VACIA", "ESCRIBE UN ID O UNA URL");
  if (!ndef::parsear(rc::datos + rc::ndefOff, rc::ndefLen)) return err("NO ES UN JUEGO", "FORMATO NO RECONOCIDO");
  char dato[170];
  int k = clasificar(dato);
  if (k == K_NADA) return err("NO ES UN JUEGO", "FORMATO NO RECONOCIDO");
  if (k == K_WIFI) {
    char s[40], p[70];
    if (!parseWifi(dato, s, p)) return err("WIFI NO VALIDO", "REVISA LA ETIQUETA");
    red::guardarCred(s, p);
    exito("WIFI GUARDADO", s);
    esperarRetirar();
    return 0;
  }
  char id[25], url[200];
  if (k == K_ID) {
    strcpy(id, dato);
    snprintf(url, sizeof(url), "https://%s%s%s.agm", ARC_HOST, ARC_RUTA, id);
  } else {
    if (!idDeUrl(dato, id)) return err("URL NO VALIDA", "DEBE TERMINAR EN .agm");
    strncpy(url, dato, sizeof(url) - 1);
    url[sizeof(url) - 1] = 0;
  }
  if (!instalar(url, id)) return err(eA, eB);
  return 1;
}

void agregar() {
  selNuevo = -1;
  GFXcanvas16* cv = crearLienzo(120, 100);
  if (!cv) return;
  bool lector = rc::iniciar();
  bool salir = false;
  while (!salir) {
    if (!lector) {
      if (!error("SIN LECTOR", "REVISA EL CABLEADO DEL RC522")) break;
      lector = rc::iniciar();
      continue;
    }
    fondoEspera();
    clearPresses();
    uint32_t last = 0, poll = 0;
    int fr = 0;
    bool leido = false;
    while (!leido && !salir) {
      uint32_t now = millis();
      updateSound(now);
      readButtons(now);
      if (btnPress[B_LEFT]) { click(); salir = true; }
      else if (btnPress[B_UP]) { click(); clearPresses(); menuBorrar(); fondoEspera(); }
      clearPresses();
      if (salir) break;
      if (now - last >= FRAME_MS) { last = now; animEspera(cv, fr++); empujarLienzo(cv, 60, 44); }
      if (now - poll >= 120) { poll = now; if (rc::detectar()) leido = true; }
      delay(1);
    }
    if (salir) break;
    playSeq(SND_LIFE, NN(SND_LIFE), 2);
    if (procesar()) salir = true;
  }
  rc::apagar();
  red::apagar();
  delete cv;
  clearPresses();
}

}  // namespace agr

// ===== fin de agregar_juego.h =====


// ===== inicio de arcade_menu.h =====
// =====================================================================
//  MENU PRINCIPAL DEL ARCADE (por caratulas)
//  Cada juego es una caratula a pantalla completa: fondo = escena del juego
//  difuminada, titulo y boton START animado.
//  Controles: IZQUIERDA / DERECHA cambian de juego, OK entra al juego
// =====================================================================

struct JuegoInfo { const char* nombre; uint16_t color; void (*jugar)(); };

const JuegoInfo JUEGOS[] = {
  {"PAC-MAN",  C565(255, 230, 0),   runPacman},
  {"TETRIS",   C565(0, 230, 240),   tet::jugar},
  {"INVADERS", C565(80, 255, 100),  inv::jugar},
  {"DINO RUN", C565(120, 230, 120), dino::jugar},
};
const int NUM_JUEGOS = sizeof(JUEGOS) / sizeof(JUEGOS[0]);

int      selJuego = 0;
uint32_t recJuego[NUM_JUEGOS + ARC_MAX_DESC + 1];   // >>> NUEVO: + descargados + AGREGAR

void cargarRecords() {
  recJuego[0] = hiScore;
  recJuego[1] = prefsA.getUInt("hiTet", 0);
  recJuego[2] = prefsA.getUInt("hiInv", 0);
  recJuego[3] = prefsA.getUInt("hiDino", 0);
  // >>> NUEVO: juegos descargados (AGREGAR, la ultima caratula, no tiene record)
  for (int i = 0; i < agm::n; i++) {
    char k[12];
    agm::claveRec(agm::desc[i].id, k);
    recJuego[NUM_JUEGOS + i] = prefsA.getUInt(k, 0);
  }
  recJuego[NUM_JUEGOS + agm::n] = 0;
}

// >>> NUEVO: lista dinamica de caratulas = juegos incluidos + descargados + AGREGAR
int numJuegos() { return NUM_JUEGOS + agm::n + 1; }
bool esAgregar(int i) { return i == NUM_JUEGOS + agm::n; }
const char* jNombre(int i) {
  if (i < NUM_JUEGOS) return JUEGOS[i].nombre;
  if (i < NUM_JUEGOS + agm::n) return agm::desc[i - NUM_JUEGOS].titulo;
  return "AGREGAR";
}
uint16_t jColor(int i) {
  if (i < NUM_JUEGOS) return JUEGOS[i].color;
  if (i < NUM_JUEGOS + agm::n) return agm::desc[i - NUM_JUEGOS].color;
  return agr::AC;
}
void jLanzar(int i) {
  if (i < NUM_JUEGOS) {
    JUEGOS[i].jugar();
  } else if (i < NUM_JUEGOS + agm::n) {
    mot::sel = i - NUM_JUEGOS;
    mot::jugar();
  } else {
    agr::agregar();
    if (agr::selNuevo >= 0) { selJuego = NUM_JUEGOS + agr::selNuevo; agr::selNuevo = -1; }
  }
  if (selJuego >= numJuegos()) selJuego = numJuegos() - 1;
}


// ---------------------------------------------------------------------
//  PORTADAS: fondo = escena del juego en 80x80, difuminada y ampliada x3
//  (la ampliacion bilineal ya aporta el desenfoque). Se compone en un
//  lienzo de 240x240 y solo el boton START se repinta en cada cuadro.
// ---------------------------------------------------------------------
#define PT_W 80
#define PT_H 80
#define PT_BX0 54
#define PT_BX1 186
#define PT_BY0 146
#define PT_BY1 198

static GFXcanvas16 *cvM = nullptr, *cvA = nullptr, *cvB = nullptr;
static uint8_t ptX0[240], ptX1[240], ptWX[240], ptVig[120];
static bool    ptListo = false;

// mezcla a->b con w = 0..32 (truco RGB565 "separado")
static inline uint16_t lerp565(uint16_t a, uint16_t b, uint8_t w) {
  uint32_t A = (a | (uint32_t)a << 16) & 0x07E0F81F;
  uint32_t B = (b | (uint32_t)b << 16) & 0x07E0F81F;
  uint32_t r = ((((B - A) * w) >> 5) + A) & 0x07E0F81F;
  return (uint16_t)(r | (r >> 16));
}
// oscurece c con f = 0..32 (32 = igual)
static inline uint16_t mul565(uint16_t c, uint8_t f) {
  uint32_t A = (c | (uint32_t)c << 16) & 0x07E0F81F;
  A = ((A * f) >> 5) & 0x07E0F81F;
  return (uint16_t)(A | (A >> 16));
}

static void ptIniciarTablas() {
  if (ptListo) return;
  for (int i = 0; i < 240; i++) {
    int u = i - 1, i0, f;
    if (u < 0) { i0 = 0; f = 0; } else { i0 = u / 3; f = u % 3; }
    if (i0 > PT_W - 1) i0 = PT_W - 1;
    int i1 = i0 + 1; if (i1 > PT_W - 1) i1 = PT_W - 1;
    ptX0[i] = i0; ptX1[i] = i1; ptWX[i] = f * 32 / 3;   // las filas usan la misma tabla (80x80 -> 240x240)
  }
  for (int k = 0; k < 120; k++) {                         // viñeta: oscurece hacia el borde redondo
    float r = sqrtf((float)(k * 128 + 64));
    float f = (r < 64.0f) ? 32.0f : 32.0f - (r - 64.0f) * 20.0f / 56.0f;
    if (f < 12.0f) f = 12.0f;
    ptVig[k] = (uint8_t)f;
  }
  ptListo = true;
}

// Desenfoque 3x3 + oscurecido (para que el titulo se lea bien encima)
static void ptDifuminar(uint16_t* b, uint8_t dim) {
  static uint16_t tmp[PT_W * PT_H];
  for (int y = 0; y < PT_H; y++) for (int x = 0; x < PT_W; x++) {
    int sr = 0, sg = 0, sb = 0;
    for (int dy = -1; dy <= 1; dy++) {
      int yy = y + dy; if (yy < 0) yy = 0; if (yy > PT_H - 1) yy = PT_H - 1;
      for (int dx = -1; dx <= 1; dx++) {
        int xx = x + dx; if (xx < 0) xx = 0; if (xx > PT_W - 1) xx = PT_W - 1;
        uint16_t c = b[yy * PT_W + xx];
        sr += (c >> 11) & 31; sg += (c >> 5) & 63; sb += c & 31;
      }
    }
    uint16_t c = (uint16_t)((((sr * 57) >> 9) << 11) | (((sg * 57) >> 9) << 5) | ((sb * 57) >> 9));
    tmp[y * PT_W + x] = mul565(c, dim);
  }
  memcpy(b, tmp, sizeof(tmp));
}

// ----- ESCENAS (se dibujan a 80x80; todo es aproximado, luego se difumina) -----
static void ptSprite(GFXcanvas16* c, int x, int y, const char* const* f, int w, int h, uint16_t col) {
  for (int j = 0; j < h; j++) for (int i = 0; i < w; i++) if (f[j][i] == '#') c->drawPixel(x + i, y + j, col);
}
static void ptFantasma(GFXcanvas16* c, int cx, int cy, uint16_t col, uint16_t fondo) {
  c->fillCircle(cx, cy, 9, col);
  c->fillRect(cx - 9, cy, 19, 10, col);
  c->fillTriangle(cx - 6, cy + 9, cx - 2, cy + 9, cx - 4, cy + 5, fondo);
  c->fillTriangle(cx + 2, cy + 9, cx + 6, cy + 9, cx + 4, cy + 5, fondo);
  c->fillCircle(cx - 3, cy - 2, 3, 0xFFFF);
  c->fillCircle(cx + 4, cy - 2, 3, 0xFFFF);
  c->fillCircle(cx - 2, cy - 2, 1, C565(20, 20, 255));
  c->fillCircle(cx + 5, cy - 2, 1, C565(20, 20, 255));
}

static void ptEscPacman(GFXcanvas16* c) {
  const uint16_t fondo = C565(0, 0, 30), az = C565(50, 70, 255), pun = C565(255, 190, 180);
  c->fillScreen(fondo);
  c->drawRoundRect(5, 4, 30, 14, 5, az);   c->drawRoundRect(45, 4, 30, 14, 5, az);
  c->drawRoundRect(5, 64, 30, 14, 5, az);  c->drawRoundRect(45, 64, 30, 14, 5, az);
  for (int x = 6; x < 76; x += 8) c->fillRect(x, 56, 2, 2, pun);
  for (int x = 6; x < 76; x += 8) c->fillRect(x, 22, 2, 2, pun);
  c->fillCircle(24, 39, 15, C565(255, 230, 0));
  c->fillTriangle(24, 39, 44, 26, 44, 52, fondo);
  c->fillCircle(25, 31, 2, fondo);
  c->fillRect(45, 38, 3, 3, pun); c->fillRect(53, 38, 3, 3, pun);
  ptFantasma(c, 67, 39, C565(255, 30, 30), fondo);
}

static void ptCelda(GFXcanvas16* c, int x, int y, uint16_t col) {
  c->fillRect(x, y, 6, 6, col);
  c->drawFastHLine(x, y, 6, aclarar(col));
  c->drawFastVLine(x, y, 6, aclarar(col));
}
static void ptEscTetris(GFXcanvas16* c) {
  c->fillScreen(C565(0, 0, 24));
  const uint16_t rej = C565(16, 16, 56);
  for (int i = 0; i <= 10; i++) c->drawFastVLine(10 + i * 6, 2, 78, rej);
  for (int j = 0; j <= 13; j++) c->drawFastHLine(10, 2 + j * 6, 60, rej);
  static const char* const TP[6] = {
    "...5......",
    "..55..2...",
    "1.5.4422.7",
    "113.44.277",
    "1332.6677.",
    "1332666.77"
  };
  for (int j = 0; j < 6; j++) for (int i = 0; i < 10; i++) {
    char ch = TP[j][i];
    if (ch >= '1' && ch <= '7') ptCelda(c, 10 + i * 6, 2 + (7 + j) * 6, tet::COLORES0[ch - '0']);
  }
  // pieza T cayendo y palo I
  for (int i = 6; i <= 8; i++) ptCelda(c, 10 + i * 6, 2 + 2 * 6, tet::COLORES0[3]);
  ptCelda(c, 10 + 7 * 6, 2 + 1 * 6, tet::COLORES0[3]);
  for (int j = 0; j < 4; j++) ptCelda(c, 10 + 1 * 6, 2 + (1 + j) * 6, tet::COLORES0[1]);
}

static void ptEscInvaders(GFXcanvas16* c) {
  c->fillScreen(C565(0, 0, 12));
  static const uint8_t est[][2] = {{6,5},{20,22},{33,9},{47,27},{58,6},{70,20},{12,45},{74,48},{28,40},{52,44},{66,36},{40,2}};
  for (unsigned i = 0; i < sizeof(est) / 2; i++) c->drawPixel(est[i][0], est[i][1], C565(150, 150, 190));
  for (int i = 0; i < 4; i++) {
    ptSprite(c, 8 + i * 16 + 4, 8,  inv::SQUID_A, 8, 8,  inv::C_FILA0[0]);
    ptSprite(c, 8 + i * 16 + 2, 20, inv::CRAB_A, 11, 8,  inv::C_FILA0[1]);
    ptSprite(c, 8 + i * 16 + 2, 32, inv::OCTO_A, 12, 8, inv::C_FILA0[3]);
  }
  for (int s = 0; s < 3; s++) ptSprite(c, 7 + s * 28, 52, inv::FORMA_ESC, 11, 6, inv::C_ESC0);
  ptSprite(c, 14, 66, inv::NAVE, 13, 8, inv::C_NAVE0);
  c->fillRect(20, 44, 1, 18, inv::C_BALA0);
}

static void ptEscDino(GFXcanvas16* c) {
  const uint16_t c1 = C565(120, 200, 255), c2 = C565(205, 238, 255);
  for (int y = 0; y < 80; y++) c->drawFastHLine(0, y, 80, mezclar565(c1, c2, y * 255 / 58 > 255 ? 255 : y * 255 / 58));
  c->fillCircle(64, 15, 7, C565(255, 238, 130));
  c->fillCircle(14, 14, 5, 0xFFFF); c->fillCircle(21, 12, 6, 0xFFFF); c->fillCircle(28, 15, 4, 0xFFFF); c->fillRect(14, 14, 15, 5, 0xFFFF);
  c->fillCircle(20, 66, 26, C565(170, 222, 175));
  c->fillCircle(60, 70, 24, C565(105, 200, 120));
  c->fillRect(0, 58, 80, 22, C565(228, 192, 124));
  c->drawFastHLine(0, 58, 80, C565(140, 98, 48)); c->drawFastHLine(0, 59, 80, C565(140, 98, 48));
  const uint16_t cv1 = dino::C_CACTO0, cv2 = dino::C_CACTO_S0;
  c->fillRect(58, 38, 6, 21, cv1); c->fillRect(58, 38, 2, 21, cv2);
  c->fillRect(52, 46, 6, 3, cv1);  c->fillRect(52, 41, 3, 8, cv1);
  c->fillRect(64, 43, 5, 3, cv1);  c->fillRect(67, 38, 3, 8, cv1);
  c->fillRect(73, 46, 4, 13, cv1); c->fillRect(73, 46, 1, 13, cv2);
  const uint16_t d = dino::C_DINO0, ds = dino::C_DINO_S0;
  c->fillRect(16, 44, 13, 13, d);
  c->fillRect(22, 33, 13, 10, d);
  c->fillRect(18, 51, 8, 4, dino::C_PANZA0);
  c->fillTriangle(16, 45, 16, 54, 6, 56, d);
  c->fillRect(17, 57, 4, 5, ds); c->fillRect(24, 57, 4, 3, ds);
  c->fillRect(29, 48, 4, 2, d);
  c->fillRect(30, 35, 3, 3, 0xFFFF); c->drawPixel(32, 36, 0);
  c->drawFastHLine(26, 41, 8, ds);
}

// >>> NUEVO: escenas de los juegos descargados y de AGREGAR (lienzo 80x80)
static void ptEscExtra(int idx, GFXcanvas16* c) {
  int k = idx - NUM_JUEGOS;
  if (k >= 0 && k < agm::n) { agm::portada(agm::desc[k], c); return; }
  c->fillScreen(C565(24, 14, 0));
  for (int r = 14; r <= 38; r += 12) c->drawCircle(40, 40, r, mezclar565(0x0000, agr::AC, 255 - r * 4));
  c->fillRoundRect(26, 30, 28, 20, 3, C565(60, 36, 0));
  c->drawRoundRect(26, 30, 28, 20, 3, agr::AC);
  c->fillRect(38, 36, 4, 8, agr::AC);
  c->fillRect(36, 38, 8, 4, agr::AC);
}

static void ptEscena(int idx, GFXcanvas16* c) {
  switch (idx) {
    case 0:  ptEscPacman(c);   break;
    case 1:  ptEscTetris(c);   break;
    case 2:  ptEscInvaders(c); break;
    case 3:  ptEscDino(c);     break;
    default: ptEscExtra(idx, c); break;     // >>> NUEVO
  }
  ptDifuminar(c->getBuffer(), idx == 3 ? 14 : 21);   // el dino (cielo claro) se oscurece mas para que el titulo se lea
}

// ----- composicion -----
// Rellena dst (240x240) con el fondo: A en reposo, o A y B deslizandose (shift 0..240, dir +1 = entra B por la derecha)
static void ptRenderBg(uint16_t* dst, const uint16_t* A, const uint16_t* B, int dir, int shift, int y0, int y1, int x0, int x1) {
  for (int y = y0; y < y1; y++) {
    int dy = y - 120, dy2 = dy * dy;
    uint16_t* row = dst + y * 240;
    uint8_t wy = ptWX[y];
    int ya = ptX0[y] * PT_W, yb = ptX1[y] * PT_W;
    for (int x = x0; x < x1; x++) {
      int dx = x - 120, d2 = dx * dx + dy2;
      if (d2 > 14641) { row[x] = 0; continue; }
      const uint16_t* S = A; int cx = x;
      if (shift) {
        if (dir > 0) { int xv = x + shift; if (xv < 240) cx = xv; else { S = B; cx = xv - 240; } }
        else         { int xv = x - shift; if (xv >= 0) cx = xv; else { S = B; cx = xv + 240; } }
      }
      int a0 = ptX0[cx], a1 = ptX1[cx]; uint8_t wx = ptWX[cx];
      uint16_t top = lerp565(S[ya + a0], S[ya + a1], wx);
      uint16_t bot = lerp565(S[yb + a0], S[yb + a1], wx);
      row[x] = mul565(lerp565(top, bot, wy), ptVig[d2 >> 7]);
    }
  }
}

static void ptEmpujar(int x, int y, int w, int h) {
  uint16_t* buf = cvM->getBuffer();
  tft.startWrite();
  tft.setAddrWindow(x, y, w, h);
  for (int r = 0; r < h; r++) tft.writePixels(buf + (size_t)(y + r) * 240 + x, w);
  tft.endWrite();
}

static void ptTextoC(const char* s, int cx, int y, uint8_t sz, uint16_t col) {
  int w = strlen(s) * 6 * sz;
  cvM->setTextSize(sz); cvM->setTextColor(col);
  cvM->setCursor(cx - w / 2, y); cvM->print(s);
}

// Titulo con contorno oscuro suave + record
static void ptTitulo(int idx, int cx) {
  if (cx < -130 || cx > 370) return;
  const uint16_t ac = jColor(idx);          // >>> NUEVO (antes JUEGOS[idx].color)
  const char* t = jNombre(idx);
  for (int oy = -2; oy <= 2; oy++) for (int ox = -2; ox <= 2; ox++)
    if ((ox || oy) && ox * ox + oy * oy <= 5) ptTextoC(t, cx + ox, 90 + oy, 3, 0x0000);
  ptTextoC(t, cx, 90, 3, mezclar565(ac, 0xFFFF, 45));
  char b[24];
  if (esAgregar(idx)) snprintf(b, sizeof(b), "ETIQUETA NFC");   // >>> NUEVO
  else snprintf(b, sizeof(b), "RECORD %lu", (unsigned long)recJuego[idx]);
  ptTextoC(b, cx + 1, 119, 1, 0x0000);
  ptTextoC(b, cx, 118, 1, mezclar565(ac, 0xFFFF, 110));
}

static void ptIndicadores(int idx) {
  const int N = numJuegos();                // >>> NUEVO: cantidad dinamica
  const int sp = (N > 10) ? 12 : 14;        // los puntos se juntan un poco si hay muchos
  int x0 = 120 - (N - 1) * sp / 2;
  for (int i = 0; i < N; i++) {
    if (i == idx) cvM->fillCircle(x0 + i * sp, 32, 3, 0xFFFF);
    else          cvM->fillCircle(x0 + i * sp, 32, 2, C565(105, 105, 125));
  }
  const uint16_t fl = C565(150, 150, 170);
  cvM->fillTriangle(22, 120, 31, 113, 31, 127, fl);
  cvM->fillTriangle(218, 120, 209, 113, 209, 127, fl);
}

static void ptComponer(int idx) {
  ptRenderBg(cvM->getBuffer(), cvA->getBuffer(), nullptr, 0, 0, 0, 240, 0, 240);
  ptIndicadores(idx);
  ptTitulo(idx, 120);
}

// Boton START: cristal oscuro con borde y resplandor suaves que "respiran" + brillo que lo cruza.
// apar = 0..256 (aparicion), flash = realce al pulsar
static void ptBoton(uint32_t now, int apar, int flash) {
  const uint16_t ac = jColor(selJuego);      // >>> NUEVO
  uint16_t* buf = cvM->getBuffer();
  ptRenderBg(buf, cvA->getBuffer(), nullptr, 0, 0, PT_BY0, PT_BY1, PT_BX0, PT_BX1);
  float fase = 0.5f + 0.5f * sinf(now * 0.005f);
  float cyc = fmodf(now * 0.00055f, 1.0f);
  float brillo = (cyc < 0.55f) ? (-30.0f + cyc / 0.55f * 200.0f) : -999.0f;
  float ap = apar / 256.0f;
  for (int y = PT_BY0; y < PT_BY1; y++) {
    for (int x = PT_BX0; x < PT_BX1; x++) {
      float px = x + 0.5f - 120.0f, py = y + 0.5f - 172.0f;
      float qx = fabsf(px) - 42.0f, qy = fabsf(py) - 2.0f;
      if (qx < 0) qx = 0;
      if (qy < 0) qy = 0;
      float d = sqrtf(qx * qx + qy * qy) - 14.0f;
      float a = 0;
      uint16_t* p = &buf[y * 240 + x];
      if (d < 0) {
        *p = mul565(*p, 32 - (int)(9 * ap));
        a = (46 + 36 * fase + flash) * ap;
        float s = fabsf((px + 56.0f) - (py + 16.0f) * 0.6f - brillo);
        if (s < 10.0f) a += (10.0f - s) * 5.0f * ap;
      }
      float ad = fabsf(d);
      if (ad < 1.6f) { float b = (70.0f + 70.0f * fase + flash) * (1.0f - ad / 1.6f) * ap; if (b > a) a = b; }
      else if (d > 0 && d < 8.0f) { float g = (1.0f - d / 8.0f); g = 60.0f * g * g * (0.5f + 0.5f * fase) * ap; if (g > a) a = g; }
      if (a >= 8.0f) { if (a > 255.0f) a = 255.0f; *p = lerp565(*p, ac, (uint8_t)((int)a >> 3)); }
    }
  }
  if (ap > 0.5f) {
    uint16_t tc = mezclar565(0xFFFF, ac, 30 + (int)(70 * (1.0f - fase)));
    cvM->fillTriangle(86, 166, 86, 178, 95, 172, tc);
    cvM->setTextSize(2); cvM->setTextColor(tc); cvM->setCursor(102, 165); cvM->print(esAgregar(selJuego) ? "NUEVO" : "START");   // >>> NUEVO
  }
  ptEmpujar(PT_BX0, PT_BY0, PT_BX1 - PT_BX0, PT_BY1 - PT_BY0);
}

// Desliza a la portada anterior (dir = -1) o siguiente (dir = +1)
static void ptDeslizar(int dir) {
  int nuevo = (selJuego + dir + numJuegos()) % numJuegos();   // >>> NUEVO
  ptEscena(nuevo, cvB);
  const int N = 8;
  for (int k = 1; k <= N; k++) {
    float p = (float)k / N, e = 1.0f - (1.0f - p) * (1.0f - p) * (1.0f - p);
    int shift = (int)(240.0f * e + 0.5f);
    ptRenderBg(cvM->getBuffer(), cvA->getBuffer(), cvB->getBuffer(), dir, shift, 0, 240, 0, 240);
    ptIndicadores(nuevo);
    ptTitulo(selJuego, 120 - dir * shift);
    ptTitulo(nuevo, 120 + dir * (240 - shift));
    ptEmpujar(0, 0, 240, 240);
    updateSound(millis());
  }
  GFXcanvas16* t = cvA; cvA = cvB; cvB = t;
  selJuego = nuevo;
}

static bool ptAbrir() {
  ptIniciarTablas();
  cvM = crearLienzo(240, 240);
  if (!cvM) return false;
  cvA = crearLienzo(PT_W, PT_H);
  if (!cvA) { delete cvM; cvM = nullptr; return false; }
  cvB = crearLienzo(PT_W, PT_H);
  if (!cvB) { delete cvM; delete cvA; cvM = cvA = nullptr; return false; }
  return true;
}
static void ptCerrar() {
  delete cvM; delete cvA; delete cvB;
  cvM = cvA = cvB = nullptr;
}

void arcadeMenu() {
  prefsA.begin("arcade", false);
  cargarRecords();
  if (!ptAbrir()) { delay(300); return; }              // sin memoria: loop() lo vuelve a intentar
  ptEscena(selJuego, cvA);
  ptComponer(selJuego);
  ptEmpujar(0, 0, 240, 240);
  clearPresses();
  uint32_t tIni = millis(), last = 0;
  int flashN = 0;
  bool lanzar = false;
  for (;;) {
    uint32_t now = millis();
    updateSound(now);
    readButtons(now);
    if (now - last < 33) { delay(1); continue; }
    last = now;
    if (!lanzar) {
      if (btnPress[B_LEFT])       { click(); ptDeslizar(-1); tIni = millis(); }
      else if (btnPress[B_RIGHT]) { click(); ptDeslizar(1);  tIni = millis(); }
      else if (btnPress[B_OK])    { click(); lanzar = true; flashN = 0; }
    }
    clearPresses();
    now = millis();
    int apar = (int)((now - tIni) * 256UL / 300UL);
    if (apar > 256) apar = 256;
    ptBoton(now, apar, lanzar ? 130 : 0);
    if (lanzar && ++flashN >= 4) {                     // destello del boton y a jugar
      lanzar = false;
      ptCerrar();                                      // libera ~140 KB de RAM para el juego
      clearPresses();
      jLanzar(selJuego);                               // >>> NUEVO (juegos incluidos, descargados o AGREGAR)
      buzz(0);
      cargarRecords();
      clearPresses();
      if (!ptAbrir()) return;
      ptEscena(selJuego, cvA);
      ptComponer(selJuego);
      ptEmpujar(0, 0, 240, 240);
      tIni = millis();
    }
  }
}

// ===== fin de arcade_menu.h =====


// ============================== ANIMACION DE ARRANQUE ==============================
void bootAnimation() {
  prepararMascaraRobot();
  prepararAnillo();
  pantallaArranque();          // VEX + powered by ARDUINO
  animacionLogo();             // halo RGB + robot + logo entrando
  // el halo sigue girando un rato (o hasta pulsar OK) y luego pasa al menu
  uint32_t t0 = millis();
  while (millis() - t0 < VEX_HALO_MS && digitalRead(PIN_OK) == HIGH) {
    dibujarFrame(510, VEX_X_FINAL, true, true, faseRGB());
  }
  liberarAnillo();             // el halo ya no se usa: devuelve ~80 KB de RAM al menu de caratulas
}

// ============================== SETUP / LOOP ==============================
void setup() {
  for (int i = 0; i < 5; i++) pinMode(btnPins[i], INPUT_PULLUP);
  soundInit();
  prefs.begin("pacman", false);
  soundOn = prefs.getBool("snd", true);
  skinIdx = prefs.getUChar("skin", 0); if (skinIdx >= NUM_SKINS) skinIdx = 0;
  diffIdx = prefs.getUChar("diff", 1); if (diffIdx > 2) diffIdx = 1;
  hiScore = prefs.getUInt("hi", 0);
  pinMode(RC_SS, OUTPUT);  digitalWrite(RC_SS, HIGH);     // >>> NUEVO: RC522 deseleccionado antes de usar el bus
  pinMode(RC_RST, OUTPUT); digitalWrite(RC_RST, LOW);     // (dormido hasta entrar en AGREGAR)
  SPI.begin(TFT_SCK, RC_MISO, TFT_MOSI, TFT_CS);          // >>> NUEVO: MISO=13 para el RC522 (antes -1)
  tft.begin(40000000);        // si ves basura en pantalla, baja a 24000000 (o usa tft.begin();)
  tft.setRotation(0);
  bootAnimation();
  agm::indexar();              // >>> NUEVO: lee los juegos descargados (la 1a vez formatea LittleFS)
}

void loop() {
  arcadeMenu();      // no vuelve: el menu del arcade lanza los juegos y se queda esperando
}
